/**
 * @cliArgs --device "AM263x_beta" --package "ZCZ" --part "AM263x" --context "r5fss0-0" --product "MCU_PLUS_SDK@07.03.01"
 * @versions {"tool":"1.18.0+3266"}
 */

/**
 * Import the modules used in this configuration.
 */
const flash           = scripting.addModule("/board/flash/flash", {}, false);
const flash1          = flash.addInstance();
const bootloader      = scripting.addModule("/drivers/bootloader/bootloader", {}, false);
const bootloader1     = bootloader.addInstance();
const uart            = scripting.addModule("/drivers/uart/uart", {}, false);
const uart1           = uart.addInstance();
const debug_log       = scripting.addModule("/kernel/dpl/debug_log");
const dpl_cfg = scripting.addModule("/kernel/dpl/dpl_cfg");
const mpu_armv7       = scripting.addModule("/kernel/dpl/mpu_armv7", {}, false);
const mpu_armv71      = mpu_armv7.addInstance();
const mpu_armv72      = mpu_armv7.addInstance();
const mpu_armv73      = mpu_armv7.addInstance();
const mpu_armv74      = mpu_armv7.addInstance();
const default_linker  = scripting.addModule("/memory_configurator/default_linker", {}, false);
const default_linker1 = default_linker.addInstance();
const general         = scripting.addModule("/memory_configurator/general", {}, false);
const general1        = general.addInstance();
const region          = scripting.addModule("/memory_configurator/region", {}, false);
const region1         = region.addInstance();
const section         = scripting.addModule("/memory_configurator/section", {}, false);
const section1        = section.addInstance();
const section2        = section.addInstance();
const section3        = section.addInstance();
const section4        = section.addInstance();
const section5        = section.addInstance();

/**
 * Write custom configuration values to the imported modules.
 */
flash1.$name                               = "CONFIG_FLASH0";
flash1.peripheralDriver.$name              = "CONFIG_QSPI0";
flash1.peripheralDriver.dmaEnable          = true;
flash1.peripheralDriver.QSPI.QSPI_D2.pu_pd = "pu";
flash1.peripheralDriver.QSPI.QSPI_D3.pu_pd = "pu";

bootloader1.bootMedia = "MEM";
bootloader1.$name     = "CONFIG_BOOTLOADER_MEM";

const edma                         = scripting.addModule("/drivers/edma/edma", {}, false);
const edma1                        = edma.addInstance({}, false);
edma1.$name                        = "CONFIG_EDMA0";
flash1.peripheralDriver.edmaConfig = edma1;
edma1.edmaRmDmaCh[0].$name         = "CONFIG_EDMA_RM0";
edma1.edmaRmQdmaCh[0].$name        = "CONFIG_EDMA_RM1";
edma1.edmaRmTcc[0].$name           = "CONFIG_EDMA_RM2";
edma1.edmaRmParam[0].$name         = "CONFIG_EDMA_RM3";

uart1.$name            = "CONFIG_UART0";
uart1.intrEnable       = "DISABLE";
uart1.UART.$assign     = "UART0";
uart1.UART.RXD.$assign = "UART0_RXD";
uart1.UART.TXD.$assign = "UART0_TXD";

debug_log.enableCssLog      = false;
debug_log.enableLogZoneInfo = true;

mpu_armv71.$name             = "CONFIG_MPU_REGION0";
mpu_armv71.size              = 31;
mpu_armv71.attributes        = "Device";
mpu_armv71.accessPermissions = "Supervisor RD+WR, User RD";
mpu_armv71.allowExecute      = false;

mpu_armv72.$name             = "CONFIG_MPU_REGION1";
mpu_armv72.size              = 15;
mpu_armv72.accessPermissions = "Supervisor RD+WR, User RD";

mpu_armv73.$name             = "CONFIG_MPU_REGION2";
mpu_armv73.baseAddr          = 0x80000;
mpu_armv73.size              = 15;
mpu_armv73.accessPermissions = "Supervisor RD+WR, User RD";

mpu_armv74.$name             = "CONFIG_MPU_REGION3";
mpu_armv74.accessPermissions = "Supervisor RD+WR, User RD";
mpu_armv74.baseAddr          = 0x70000000;
mpu_armv74.size              = 21;

default_linker1.$name = "memory_configurator_default_linker0";

general1.$name          = "CONFIG_GENERAL0";
general1.irq_stack_size = 4096;
general1.linker.$name   = "TIARMCLANG0";

region1.$name                               = "MEMORY_REGION_CONFIGURATION";
region1.memory_region.create(6);
region1.memory_region[0].type               = "TCMA";
region1.memory_region[0].$name              = "R5F_VECS";
region1.memory_region[0].auto               = false;
region1.memory_region[0].size               = 0x100;
region1.memory_region[1].type               = "TCMA";
region1.memory_region[1].$name              = "R5F_TCMA";
region1.memory_region[1].auto               = false;
region1.memory_region[1].manualStartAddress = 0x100;
region1.memory_region[1].size               = 0x7F00;
region1.memory_region[2].type               = "TCMB";
region1.memory_region[2].size               = 0x8000;
region1.memory_region[2].$name              = "R5F_TCMB0";
region1.memory_region[2].manualStartAddress = 0x41010000;
region1.memory_region[3].$name              = "MSRAM_VECS";
region1.memory_region[3].auto               = false;
region1.memory_region[3].manualStartAddress = 0x70002000;
region1.memory_region[3].size               = 0x100;
region1.memory_region[4].$name              = "MSRAM_0";
region1.memory_region[4].auto               = false;
region1.memory_region[4].manualStartAddress = 0x70002100;
region1.memory_region[4].size               = 0x3DF00;
region1.memory_region[5].$name              = "MSRAM_1";
region1.memory_region[5].auto               = false;
region1.memory_region[5].manualStartAddress = 0x70040000;
region1.memory_region[5].size               = 0x190100;

section1.load_memory                              = "MSRAM_VECS";
section1.group                                    = false;
section1.$name                                    = "Sbl Initialization Code";
section1.output_section.create(1);
section1.output_section[0].$name                  = ".sbl_init_code";
section1.output_section[0].input_section.create(1);
section1.output_section[0].input_section[0].$name = "*(.vectors). = align(8);";

section2.load_memory                  = "MSRAM_0";
section2.$name                        = "Text Segments";
section2.output_section.create(7);
section2.output_section[0].$name      = ".text";
section2.output_section[0].palignment = true;
section2.output_section[1].$name      = ".text.hwi";
section2.output_section[1].palignment = true;
section2.output_section[2].$name      = ".text.cache";
section2.output_section[2].palignment = true;
section2.output_section[3].$name      = ".text.mpu";
section2.output_section[3].palignment = true;
section2.output_section[4].$name      = ".text.boot";
section2.output_section[4].palignment = true;
section2.output_section[5].$name      = ".data";
section2.output_section[5].palignment = true;
section2.output_section[6].$name      = ".rodata";
section2.output_section[6].palignment = true;

section3.load_memory                             = "MSRAM_0";
section3.group                                   = false;
section3.$name                                   = "Memory Segments";
section3.output_section.create(3);
section3.output_section[0].$name                 = ".bss";
section3.output_section[0].output_sections_start = "__BSS_START";
section3.output_section[0].output_sections_end   = "__BSS_END";
section3.output_section[0].palignment            = true;
section3.output_section[1].$name                 = ".sysmem";
section3.output_section[1].palignment            = true;
section3.output_section[2].$name                 = ".stack";
section3.output_section[2].palignment            = true;

section4.load_memory                              = "MSRAM_0";
section4.$name                                    = "Stack Segments";
section4.output_section.create(5);
section4.output_section[0].$name                  = ".irqstack";
section4.output_section[0].output_sections_start  = "__IRQ_STACK_START";
section4.output_section[0].output_sections_end    = "__IRQ_STACK_END";
section4.output_section[0].input_section.create(1);
section4.output_section[0].input_section[0].$name = ". = . + __IRQ_STACK_SIZE;";
section4.output_section[1].$name                  = ".fiqstack";
section4.output_section[1].output_sections_start  = "__FIQ_STACK_START";
section4.output_section[1].output_sections_end    = "__FIQ_STACK_END";
section4.output_section[1].input_section.create(1);
section4.output_section[1].input_section[0].$name = ". = . + __FIQ_STACK_SIZE;";
section4.output_section[2].$name                  = ".svcstack";
section4.output_section[2].output_sections_start  = "__SVC_STACK_START";
section4.output_section[2].output_sections_end    = "__SVC_STACK_END";
section4.output_section[2].input_section.create(1);
section4.output_section[2].input_section[0].$name = ". = . + __SVC_STACK_SIZE;";
section4.output_section[3].$name                  = ".abortstack";
section4.output_section[3].output_sections_start  = "__ABORT_STACK_START";
section4.output_section[3].output_sections_end    = "__ABORT_STACK_END";
section4.output_section[3].input_section.create(1);
section4.output_section[3].input_section[0].$name = ". = . + __ABORT_STACK_SIZE;";
section4.output_section[4].$name                  = ".undefinedstack";
section4.output_section[4].output_sections_start  = "__UNDEFINED_STACK_START";
section4.output_section[4].output_sections_end    = "__UNDEFINED_STACK_END";
section4.output_section[4].input_section.create(1);
section4.output_section[4].input_section[0].$name = ". = . + __UNDEFINED_STACK_SIZE;";

section5.group                       = false;
section5.type                        = "NOLOAD";
section5.load_memory                 = "MSRAM_1";
section5.$name                       = "Bss File Buffer";
section5.output_section.create(1);
section5.output_section[0].$name     = ".bss.filebuf";
section5.output_section[0].alignment = 0;

/**
 * Pinmux solution for unlocked pins/peripherals. This ensures that minor changes to the automatic solver in a future
 * version of the tool will not impact the pinmux you originally saw.  These lines can be completely deleted in order to
 * re-solve from scratch.
 */
flash1.peripheralDriver.QSPI.$suggestSolution           = "QSPI";
flash1.peripheralDriver.QSPI.QSPI_D0.$suggestSolution   = "QSPI_D0";
flash1.peripheralDriver.QSPI.QSPI_D1.$suggestSolution   = "QSPI_D1";
flash1.peripheralDriver.QSPI.QSPI_D2.$suggestSolution   = "QSPI_D2";
flash1.peripheralDriver.QSPI.QSPI_D3.$suggestSolution   = "QSPI_D3";
flash1.peripheralDriver.QSPI.QSPI_CLK.$suggestSolution  = "QSPI_CLK";
flash1.peripheralDriver.QSPI.QSPI_CSn0.$suggestSolution = "QSPI_CSn0";
