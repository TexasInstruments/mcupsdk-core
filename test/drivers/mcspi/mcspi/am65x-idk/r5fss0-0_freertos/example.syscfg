/**
 * @cliArgs --device "AM65xx_SR2.0_beta" --part "Default" --package "ACD" --context "r5fss0-0" --product "MCU_PLUS_SDK@07.03.01"
 * @versions {"tool":"1.21.0+3721"}
 */

/**
 * Import the modules used in this configuration.
 */
const mcspi      = scripting.addModule("/drivers/mcspi/mcspi", {}, false);
const mcspi1     = mcspi.addInstance();
const mcspi2     = mcspi.addInstance();
const mcspi3     = mcspi.addInstance();
const mcspi4     = mcspi.addInstance();
const mcspi5     = mcspi.addInstance();
const debug_log  = scripting.addModule("/kernel/dpl/debug_log");
const dpl_cfg    = scripting.addModule("/kernel/dpl/dpl_cfg");
const mpu_armv7  = scripting.addModule("/kernel/dpl/mpu_armv7", {}, false);
const mpu_armv71 = mpu_armv7.addInstance();
const mpu_armv72 = mpu_armv7.addInstance();
const mpu_armv73 = mpu_armv7.addInstance();
const mpu_armv74 = mpu_armv7.addInstance();
const mpu_armv75 = mpu_armv7.addInstance();
const mpu_armv76 = mpu_armv7.addInstance();

/**
 * Write custom configuration values to the imported modules.
 */
mcspi1.$name                 = "CONFIG_MCSPI0";
mcspi1.inputSelect           = "0";
mcspi1.SPI.$assign           = "SPI0";
mcspi1.mcspiChannel[0].$name = "CONFIG_MCSPI_CH0";
mcspi1.child.$name           = "drivers_mcspi_v0_mcspi_v0_template0";

mcspi2.$name                 = "CONFIG_MCSPI1";
mcspi2.advanced              = true;
mcspi2.inputSelect           = "0";
mcspi2.SPI.$assign           = "SPI1";
mcspi2.mcspiChannel[0].$name = "CONFIG_MCSPI_CH1";
mcspi2.child.$name           = "drivers_mcspi_v0_mcspi_v0_template1";

mcspi3.$name                 = "CONFIG_MCSPI2";
mcspi3.SPI.$assign           = "SPI2";
mcspi3.mcspiChannel[0].$name = "CONFIG_MCSPI_CH2";
mcspi3.child.$name           = "drivers_mcspi_v0_mcspi_v0_template2";

mcspi4.$name                   = "CONFIG_MCSPI3";
mcspi4.intrEnable              = "DMA";
mcspi4.mode                    = "MULTI_CONTROLLER";
mcspi4.inputSelect             = "0";
mcspi4.useMcuDomainPeripherals = true;
mcspi4.child.$name             = "drivers_mcspi_v0_mcspi_v0_template3";
mcspi4.mcspiChannel.create(4);
mcspi4.mcspiChannel[0].$name   = "CONFIG_MCSPI_CH3";
mcspi4.mcspiChannel[1].$name   = "CONFIG_MCSPI_CH5";
mcspi4.mcspiChannel[2].$name   = "CONFIG_MCSPI_CH6";
mcspi4.mcspiChannel[3].$name   = "CONFIG_MCSPI_CH7";

mcspi5.$name                           = "CONFIG_MCSPI4";
mcspi5.inputSelect                     = "0";
mcspi5.mode                            = "MULTI_CONTROLLER";
mcspi5.useMcuDomainPeripherals         = true;
mcspi5.child.$name                     = "drivers_mcspi_v0_mcspi_v0_template4";
mcspi5.mcspiChannel[0].$name           = "CONFIG_MCSPI_CH4";
mcspi5.mcspiChannel[0].MCU_CSn.$assign = "WKUP_GPIO0_3";
mcspi5.MCU_SPI.$assign                 = "MCU_SPI1";

const udma        = scripting.addModule("/drivers/udma/udma", {}, false);
const udma1       = udma.addInstance({}, false);
mcspi4.udmaDriver = udma1;
udma1.$name       = "CONFIG_UDMA0";

debug_log.enableUartLog                   = true;
debug_log.uartLog.$name                   = "CONFIG_UART0";
debug_log.uartLog.useMcuDomainPeripherals = true;

const uart_v0_template  = scripting.addModule("/drivers/uart/v0/uart_v0_template", {}, false);
const uart_v0_template1 = uart_v0_template.addInstance({}, false);
uart_v0_template1.$name = "drivers_uart_v0_uart_v0_template0";
debug_log.uartLog.child = uart_v0_template1;

mpu_armv71.size         = 31;
mpu_armv71.allowExecute = false;
mpu_armv71.attributes   = "Device";
mpu_armv71.$name        = "SOC_MEM_MAP";

mpu_armv72.size  = 15;
mpu_armv72.$name = "ATCM_MEM_MAP";

mpu_armv73.baseAddr          = 0x41010000;
mpu_armv73.size              = 15;
mpu_armv73.allowExecute      = false;
mpu_armv73.accessPermissions = "Supervisor RD+WR, User RD";
mpu_armv73.$name             = "BTCM_MEM_MAP";

mpu_armv74.size       = 19;
mpu_armv74.baseAddr   = 0x41C00000;
mpu_armv74.attributes = "NonCached";
mpu_armv74.$name      = "MSRAM_MEM_MAP";

mpu_armv75.baseAddr = 0x70000000;
mpu_armv75.size     = 21;
mpu_armv75.$name    = "MSMC_SRAM_MEM_MAP";

mpu_armv76.baseAddr = 0x80000000;
mpu_armv76.size     = 31;
mpu_armv76.$name    = "DDR_MEM_MAP";

/**
 * Pinmux solution for unlocked pins/peripherals. This ensures that minor changes to the automatic solver in a future
 * version of the tool will not impact the pinmux you originally saw.  These lines can be completely deleted in order to
 * re-solve from scratch.
 */
mcspi1.SPI.CLK.$suggestSolution                 = "SPI0_CLK";
mcspi1.SPI.D0.$suggestSolution                  = "SPI0_D0";
mcspi1.SPI.D1.$suggestSolution                  = "SPI0_D1";
mcspi1.mcspiChannel[0].CSn.$suggestSolution     = "SPI0_CS0";
mcspi2.SPI.CLK.$suggestSolution                 = "SPI1_CLK";
mcspi2.SPI.D0.$suggestSolution                  = "SPI1_D0";
mcspi2.SPI.D1.$suggestSolution                  = "SPI1_D1";
mcspi2.mcspiChannel[0].CSn.$suggestSolution     = "SPI1_CS0";
mcspi3.SPI.CLK.$suggestSolution                 = "PRG1_PRU1_GPO17";
mcspi3.SPI.D0.$suggestSolution                  = "PRG1_PRU1_GPO18";
mcspi3.SPI.D1.$suggestSolution                  = "PRG1_PRU1_GPO19";
mcspi3.mcspiChannel[0].CSn.$suggestSolution     = "PRG1_PRU1_GPO7";
mcspi4.mcspiChannel[0].MCU_CSn.$suggestSolution = "WKUP_GPIO0_4";
mcspi4.mcspiChannel[1].MCU_CSn.$suggestSolution = "MCU_OSPI1_CSn1";
mcspi4.mcspiChannel[2].MCU_CSn.$suggestSolution = "MCU_OSPI1_D3";
mcspi4.mcspiChannel[3].MCU_CSn.$suggestSolution = "MCU_SPI0_CS0";
mcspi4.MCU_SPI.$suggestSolution                 = "MCU_SPI0";
mcspi4.MCU_SPI.CLK.$suggestSolution             = "MCU_SPI0_CLK";
mcspi4.MCU_SPI.D0.$suggestSolution              = "MCU_SPI0_D0";
mcspi4.MCU_SPI.D1.$suggestSolution              = "MCU_SPI0_D1";
mcspi5.MCU_SPI.CLK.$suggestSolution             = "WKUP_GPIO0_0";
mcspi5.MCU_SPI.D0.$suggestSolution              = "WKUP_GPIO0_1";
mcspi5.MCU_SPI.D1.$suggestSolution              = "WKUP_GPIO0_2";
debug_log.uartLog.MCU_UART.$suggestSolution     = "MCU_USART0";
debug_log.uartLog.MCU_UART.RXD.$suggestSolution = "MCU_OSPI1_D1";
debug_log.uartLog.MCU_UART.TXD.$suggestSolution = "MCU_OSPI1_D2";
