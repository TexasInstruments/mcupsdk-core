/**
 * @cliArgs --device "AM64x" --package "ALV" --part "Default" --context "a53ss0-0" --product "MCU_PLUS_SDK@07.03.01"
 * @versions {"tool":"1.20.0+3587"}
 */

/**
 * Import the modules used in this configuration.
 */
const mcspi           = scripting.addModule("/drivers/mcspi/mcspi", {}, false);
const mcspi1          = mcspi.addInstance();
const mcspi2          = mcspi.addInstance();
const mcspi3          = mcspi.addInstance();
const mcspi4          = mcspi.addInstance();
const mcspi5          = mcspi.addInstance();
const mcspi6          = mcspi.addInstance();
const debug_log       = scripting.addModule("/kernel/dpl/debug_log");
const dpl_cfg = scripting.addModule("/kernel/dpl/dpl_cfg");
const mmu_armv8       = scripting.addModule("/kernel/dpl/mmu_armv8", {}, false);
const mmu_armv81      = mmu_armv8.addInstance();
const mmu_armv82      = mmu_armv8.addInstance();
const mmu_armv83      = mmu_armv8.addInstance();

/**
 * Write custom configuration values to the imported modules.
 */
mcspi1.$name                       = "CONFIG_MCSPI0";
mcspi1.inputSelect                 = "0";
mcspi1.SPI.$assign                 = "SPI0";
mcspi1.mcspiChannel[0].$name       = "CONFIG_MCSPI_CH0";
mcspi1.mcspiChannel[0].CSn.$assign = "SPI0_CS0";
mcspi1.child.$name                 = "drivers_mcspi_v0_mcspi_v0_template0";

mcspi2.$name                          = "CONFIG_MCSPI1";
mcspi2.inputSelect                    = "0";
mcspi2.advanced                       = true;
mcspi2.mode                           = "MULTI_CONTROLLER";
mcspi2.child.$name                    = "drivers_mcspi_v0_mcspi_v0_template1";
mcspi2.mcspiChannel.create(4);
mcspi2.mcspiChannel[0].$name          = "CONFIG_MCSPI_CH1";
mcspi2.mcspiChannel[0].CSn.$assign    = "SPI1_CS1";
mcspi2.mcspiChannel[1].$name          = "CONFIG_MCSPI_CH7";
mcspi2.mcspiChannel[1].advanced       = true;
mcspi2.mcspiChannel[1].startBitEnable = true;
mcspi2.mcspiChannel[1].CSn.$assign    = "SPI1_CS0";
mcspi2.mcspiChannel[2].$name          = "CONFIG_MCSPI_CH6";
mcspi2.mcspiChannel[2].CSn.$assign    = "UART1_RTSn";
mcspi2.mcspiChannel[3].$name          = "CONFIG_MCSPI_CH11";

mcspi3.$name                 = "CONFIG_MCSPI3";
mcspi3.inputSelect           = "0";
mcspi3.mode                  = "MULTI_CONTROLLER";
mcspi3.intrEnable            = "DMA";
mcspi3.SPI.$assign           = "SPI3";
mcspi3.child.$name           = "drivers_mcspi_v0_mcspi_v0_template2";
mcspi3.mcspiChannel.create(3);
mcspi3.mcspiChannel[0].$name = "CONFIG_MCSPI_CH3";
mcspi3.mcspiChannel[1].$name = "CONFIG_MCSPI_CH8";
mcspi3.mcspiChannel[2].$name = "CONFIG_MCSPI_CH9";

mcspi4.$name                 = "CONFIG_MCSPI4";
mcspi4.inputSelect           = "0";
mcspi4.SPI.$assign           = "SPI4";
mcspi4.SPI.D1.$used          = false;
mcspi4.mcspiChannel[0].$name = "CONFIG_MCSPI_CH4";
mcspi4.child.$name           = "drivers_mcspi_v0_mcspi_v0_template3";

mcspi5.$name                   = "CONFIG_MCSPI5";
mcspi5.useMcuDomainPeripherals = true;
mcspi5.inputSelect             = "0";
mcspi5.mcspiChannel[0].$name   = "CONFIG_MCSPI_CH5";
mcspi5.child.$name             = "drivers_mcspi_v0_mcspi_v0_template4";
mcspi5.MCU_SPI.$assign         = "MCU_SPI0";

mcspi6.$name                   = "CONFIG_MCSPI2";
mcspi6.useMcuDomainPeripherals = true;
mcspi6.mcspiChannel[0].$name   = "CONFIG_MCSPI_CH2";
mcspi6.child.$name             = "drivers_mcspi_v0_mcspi_v0_template5";
mcspi6.MCU_SPI.$assign         = "MCU_SPI1";

const udma        = scripting.addModule("/drivers/udma/udma", {}, false);
const udma1       = udma.addInstance({}, false);
udma1.$name       = "CONFIG_UDMA0";
mcspi1.udmaDriver = udma1;
mcspi2.udmaDriver = udma1;
mcspi3.udmaDriver = udma1;
mcspi4.udmaDriver = udma1;
mcspi5.udmaDriver = udma1;
mcspi6.udmaDriver = udma1;

debug_log.enableUartLog = true;
debug_log.enableCssLog  = false;
debug_log.uartLog.$name = "CONFIG_UART0";

const uart_v0_template  = scripting.addModule("/drivers/uart/v0/uart_v0_template", {}, false);
const uart_v0_template1 = uart_v0_template.addInstance({}, false);
uart_v0_template1.$name = "drivers_uart_v0_uart_v0_template0";
debug_log.uartLog.child = uart_v0_template1;

mmu_armv81.$name = "SOC_MEM_REGION";
mmu_armv81.size  = 0x80000000;

mmu_armv82.$name     = "MSRAM_REGION";
mmu_armv82.vAddr     = 0x70000000;
mmu_armv82.pAddr     = 0x70000000;
mmu_armv82.size      = 0x200000;
mmu_armv82.attribute = "MAIR7";

mmu_armv83.$name     = "DDR_REGION";
mmu_armv83.vAddr     = 0x80000000;
mmu_armv83.pAddr     = 0x80000000;
mmu_armv83.size      = 0x80000000;
mmu_armv83.attribute = "MAIR7";

/**
 * Pinmux solution for unlocked pins/peripherals. This ensures that minor changes to the automatic solver in a future
 * version of the tool will not impact the pinmux you originally saw.  These lines can be completely deleted in order to
 * re-solve from scratch.
 */
mcspi1.SPI.CLK.$suggestSolution                 = "SPI0_CLK";
mcspi1.SPI.D0.$suggestSolution                  = "SPI0_D0";
mcspi1.SPI.D1.$suggestSolution                  = "SPI0_D1";
mcspi2.SPI.$suggestSolution                     = "SPI1";
mcspi2.SPI.CLK.$suggestSolution                 = "SPI1_CLK";
mcspi2.SPI.D0.$suggestSolution                  = "SPI1_D0";
mcspi2.SPI.D1.$suggestSolution                  = "SPI1_D1";
mcspi2.mcspiChannel[3].CSn.$suggestSolution     = "UART1_CTSn";
mcspi3.SPI.CLK.$suggestSolution                 = "PRG0_PRU0_GPO16";
mcspi3.SPI.D0.$suggestSolution                  = "PRG0_PRU0_GPO13";
mcspi3.SPI.D1.$suggestSolution                  = "PRG0_PRU0_GPO14";
mcspi3.mcspiChannel[0].CSn.$suggestSolution     = "PRG1_PRU1_GPO19";
mcspi3.mcspiChannel[1].CSn.$suggestSolution     = "PRG0_PRU0_GPO15";
mcspi3.mcspiChannel[2].CSn.$suggestSolution     = "PRG0_PRU0_GPO17";
mcspi4.SPI.CLK.$suggestSolution                 = "UART0_CTSn";
mcspi4.SPI.D0.$suggestSolution                  = "UART0_RTSn";
mcspi4.mcspiChannel[0].CSn.$suggestSolution     = "MCAN0_TX";
mcspi5.mcspiChannel[0].MCU_CSn.$suggestSolution = "MCU_SPI0_CS0";
mcspi5.MCU_SPI.CLK.$suggestSolution             = "MCU_SPI0_CLK";
mcspi5.MCU_SPI.D0.$suggestSolution              = "MCU_SPI0_D0";
mcspi5.MCU_SPI.D1.$suggestSolution              = "MCU_SPI0_D1";
mcspi6.mcspiChannel[0].MCU_CSn.$suggestSolution = "MCU_SPI1_CS0";
mcspi6.MCU_SPI.CLK.$suggestSolution             = "MCU_SPI1_CLK";
mcspi6.MCU_SPI.D0.$suggestSolution              = "MCU_SPI1_D0";
mcspi6.MCU_SPI.D1.$suggestSolution              = "MCU_SPI1_D1";
debug_log.uartLog.UART.$suggestSolution         = "USART0";
debug_log.uartLog.UART.RXD.$suggestSolution     = "UART0_RXD";
debug_log.uartLog.UART.TXD.$suggestSolution     = "UART0_TXD";
