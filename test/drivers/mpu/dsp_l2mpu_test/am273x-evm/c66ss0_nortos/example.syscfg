/**
 * @cliArgs --device "AM273x" --part "Default" --package "ZCE" --context "c66ss0" --product "MCU_PLUS_SDK@07.03.01"
 * @versions {"tool":"1.27.0+4565"}
 */

/**
 * Import the modules used in this configuration.
 */
const cache_c6x       = scripting.addModule("/kernel/dpl/cache_c6x");
const debug_log       = scripting.addModule("/kernel/dpl/debug_log");
const dpl_cfg         = scripting.addModule("/kernel/dpl/dpl_cfg");
const default_linker  = scripting.addModule("/memory_configurator/default_linker", {}, false);
const default_linker1 = default_linker.addInstance();
const general         = scripting.addModule("/memory_configurator/general", {}, false);
const general1        = general.addInstance();
const region          = scripting.addModule("/memory_configurator/region", {}, false);
const region1         = region.addInstance();
const section         = scripting.addModule("/memory_configurator/section", {}, false);
const section1        = section.addInstance();
const section2        = section.addInstance();
const section3        = section.addInstance();
const section4        = section.addInstance();
const section5        = section.addInstance();
const section6        = section.addInstance();

/**
 * Write custom configuration values to the imported modules.
 */
debug_log.enableUartLog               = true;
debug_log.uartLog.$name               = "CONFIG_UART0";
debug_log.uartLog.DSS_UART.RX.$assign = "PAD_DD";
debug_log.uartLog.DSS_UART.TX.$assign = "PAD_DC";

const edma                         = scripting.addModule("/drivers/edma/edma", {}, false);
const edma1                        = edma.addInstance({}, false);
edma1.$name                        = "CONFIG_EDMA0";
debug_log.uartLog.edmaConfig       = edma1;
edma1.edmaRmDmaCh[0].$name         = "CONFIG_EDMA_RM0";
edma1.edmaRmQdmaCh[0].$name        = "CONFIG_EDMA_RM1";
edma1.edmaRmTcc[0].$name           = "CONFIG_EDMA_RM2";
edma1.edmaRmParam[0].$name         = "CONFIG_EDMA_RM3";
edma1.edmaRmReservedDmaCh[0].$name = "CONFIG_EDMA_RM4";

default_linker1.$name = "memory_configurator_default_linker0";

general1.$name        = "CONFIG_GENERAL0";
general1.linker.$name = "TIARMCLANG0";

region1.$name                               = "MEMORY_REGION_CONFIGURATION0";
region1.memory_region.create(3);
region1.memory_region[0].type               = "DSP_L2_C66";
region1.memory_region[0].$name              = "DSS_L2";
region1.memory_region[0].size               = 0x60000;
region1.memory_region[1].type               = "DSS_L3_ALL";
region1.memory_region[1].size               = 0x390000;
region1.memory_region[1].$name              = "DSS_L3";
region1.memory_region[2].$name              = "USER_SHM_MEM";
region1.memory_region[2].auto               = false;
region1.memory_region[2].manualStartAddress = 0xC02E8000;
region1.memory_region[2].size               = 0x4000;

section1.$name                       = "Program Memory";
section1.load_memory                 = "DSS_L2";
section1.group                       = false;
section1.output_section.create(6);
section1.output_section[0].$name     = ".text";
section1.output_section[0].alignment = 0;
section1.output_section[1].$name     = ".const";
section1.output_section[1].alignment = 0;
section1.output_section[2].$name     = ".cinit";
section1.output_section[2].alignment = 0;
section1.output_section[3].$name     = ".data";
section1.output_section[3].alignment = 0;
section1.output_section[4].$name     = ".rodata";
section1.output_section[4].alignment = 0;
section1.output_section[5].$name     = ".switch";
section1.output_section[5].alignment = 0;

section2.$name                       = "Memory - Stack";
section2.load_memory                 = "DSS_L2";
section2.group                       = false;
section2.output_section.create(5);
section2.output_section[0].$name     = ".stack";
section2.output_section[0].alignment = 0;
section2.output_section[1].$name     = ".bss";
section2.output_section[1].alignment = 0;
section2.output_section[2].$name     = ".sysmem";
section2.output_section[2].alignment = 0;
section2.output_section[3].$name     = ".neardata";
section2.output_section[3].alignment = 0;
section2.output_section[4].$name     = ".fardata";
section2.output_section[4].alignment = 0;

section3.$name                       = "Initialization";
section3.load_memory                 = "DSS_L2";
section3.group                       = false;
section3.output_section.create(4);
section3.output_section[0].$name     = ".c6xabi.exidx";
section3.output_section[0].alignment = 0;
section3.output_section[1].$name     = ".init_array";
section3.output_section[1].alignment = 0;
section3.output_section[2].$name     = ".fini_array";
section3.output_section[2].alignment = 0;
section3.output_section[3].$name     = ".cio";
section3.output_section[3].alignment = 0;

section4.$name                       = "BSS DSS L3";
section4.load_memory                 = "DSS_L3";
section4.group                       = false;
section4.output_section.create(1);
section4.output_section[0].$name     = ".bss.dss_l3";
section4.output_section[0].alignment = 0;

section5.$name                       = "Additional Sections";
section5.load_memory                 = "DSS_L2";
section5.group                       = false;
section5.output_section.create(1);
section5.output_section[0].$name     = ".far";
section5.output_section[0].alignment = 0;

section6.$name                       = "User Shared Memory";
section6.load_memory                 = "USER_SHM_MEM";
section6.type                        = "NOLOAD";
section6.group                       = false;
section6.output_section.create(1);
section6.output_section[0].$name     = ".bss.user_shared_mem";
section6.output_section[0].alignment = 0;

/**
 * Pinmux solution for unlocked pins/peripherals. This ensures that minor changes to the automatic solver in a future
 * version of the tool will not impact the pinmux you originally saw.  These lines can be completely deleted in order to
 * re-solve from scratch.
 */
debug_log.uartLog.DSS_UART.$suggestSolution = "DSS_UARTA";
