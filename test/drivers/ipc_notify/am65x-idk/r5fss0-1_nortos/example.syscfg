/**
 * @cliArgs --device "AM65xx_SR2.0_beta" --package "ACD" --part "Default" --context "r5fss0-1" --product "MCU_PLUS_SDK@07.03.01"
 * @versions {"tool":"1.20.0+3587"}
 */

/**
 * Import the modules used in this configuration.
 */
const ipc        = scripting.addModule("/drivers/ipc/ipc");
const debug_log  = scripting.addModule("/kernel/dpl/debug_log");
const dpl_cfg = scripting.addModule("/kernel/dpl/dpl_cfg");
const mpu_armv7  = scripting.addModule("/kernel/dpl/mpu_armv7", {}, false);
const mpu_armv71 = mpu_armv7.addInstance();
const mpu_armv72 = mpu_armv7.addInstance();
const mpu_armv73 = mpu_armv7.addInstance();
const mpu_armv74 = mpu_armv7.addInstance();
const mpu_armv75 = mpu_armv7.addInstance();
const mpu_armv76 = mpu_armv7.addInstance();
const mpu_armv77 = mpu_armv7.addInstance();
const mpu_armv78 = mpu_armv7.addInstance();

/**
 * Write custom configuration values to the imported modules.
 */
ipc.enableLinuxIpc = true;

mpu_armv71.size         = 31;
mpu_armv71.allowExecute = false;
mpu_armv71.attributes   = "Device";
mpu_armv71.$name        = "SOC_MEM_MAP";

mpu_armv72.size  = 15;
mpu_armv72.$name = "ATCM_MEM_MAP";

mpu_armv73.size              = 15;
mpu_armv73.allowExecute      = false;
mpu_armv73.accessPermissions = "Supervisor RD+WR, User RD";
mpu_armv73.$name             = "BTCM_MEM_MAP";
mpu_armv73.baseAddr          = 0x41410000;

mpu_armv74.size       = 19;
mpu_armv74.baseAddr   = 0x41C00000;
mpu_armv74.attributes = "NonCached";
mpu_armv74.$name      = "MSRAM_MEM_MAP";

mpu_armv75.baseAddr = 0x70000000;
mpu_armv75.size     = 21;
mpu_armv75.$name    = "MSMC_SRAM_MEM_MAP";

mpu_armv76.baseAddr = 0x80000000;
mpu_armv76.size     = 31;
mpu_armv76.$name    = "DDR_MEM_MAP";

mpu_armv77.$name        = "LINUX_IPC_MEM_MAP";
mpu_armv77.size         = 20;
mpu_armv77.attributes   = "NonCached";
mpu_armv77.allowExecute = false;
mpu_armv77.baseAddr     = 0xA1000000;

mpu_armv78.$name        = "IPC_VRING_MEM_MAP";
mpu_armv78.attributes   = "NonCached";
mpu_armv78.allowExecute = false;
mpu_armv78.baseAddr     = 0xA2000000;
mpu_armv78.size         = 21;
