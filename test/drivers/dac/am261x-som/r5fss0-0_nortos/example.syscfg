/**
 * @cliArgs --device "AM261x_ZCZ" --package "ZCZ" --part "AM2611" --context "r5fss0-0" --product "MCU_PLUS_SDK@07.03.01"
 * @versions {"tool":"1.20.0+3587"}
 */

/**
 * Import the modules used in this configuration.
 */
const edma       = scripting.addModule("/drivers/edma/edma", {}, false);
const edma1      = edma.addInstance();
const epwm       = scripting.addModule("/drivers/epwm/epwm", {}, false);
const epwm1      = epwm.addInstance();
const epwm2      = epwm.addInstance();
const epwm3      = epwm.addInstance();
const epwm4      = epwm.addInstance();
const epwm5      = epwm.addInstance();
const epwm6      = epwm.addInstance();
const epwm7      = epwm.addInstance();
const epwm8      = epwm.addInstance();
const epwm9      = epwm.addInstance();
const epwm10     = epwm.addInstance();
const epwm11     = epwm.addInstance();
const epwm12     = epwm.addInstance();
const epwm13     = epwm.addInstance();
const epwm14     = epwm.addInstance();
const epwm15     = epwm.addInstance();
const epwm16     = epwm.addInstance();
const epwm17     = epwm.addInstance();
const epwm18     = epwm.addInstance();
const epwm19     = epwm.addInstance();
const epwm20     = epwm.addInstance();
const epwm21     = epwm.addInstance();
const epwm22     = epwm.addInstance();
const epwm23     = epwm.addInstance();
const epwm24     = epwm.addInstance();
const epwm25     = epwm.addInstance();
const epwm26     = epwm.addInstance();
const epwm27     = epwm.addInstance();
const epwm28     = epwm.addInstance();
const epwm29     = epwm.addInstance();
const epwm30     = epwm.addInstance();
const epwm31     = epwm.addInstance();
const epwm32     = epwm.addInstance();
const clock      = scripting.addModule("/kernel/dpl/clock");
const debug_log  = scripting.addModule("/kernel/dpl/debug_log");
const dpl_cfg = scripting.addModule("/kernel/dpl/dpl_cfg");
const mpu_armv7  = scripting.addModule("/kernel/dpl/mpu_armv7", {}, false);
const mpu_armv71 = mpu_armv7.addInstance();
const mpu_armv72 = mpu_armv7.addInstance();
const mpu_armv73 = mpu_armv7.addInstance();
const mpu_armv74 = mpu_armv7.addInstance();
const timer      = scripting.addModule("/kernel/dpl/timer", {}, false);
const timer1     = timer.addInstance();
const general    = scripting.addModule("/memory_configurator/general", {}, false);
const general1   = general.addInstance();
const region     = scripting.addModule("/memory_configurator/region", {}, false);
const region1    = region.addInstance();
const section    = scripting.addModule("/memory_configurator/section", {}, false);
const section1   = section.addInstance();
const section2   = section.addInstance();
const section3   = section.addInstance();
const section4   = section.addInstance();
const section5   = section.addInstance();
const section6   = section.addInstance();
const section7   = section.addInstance();
const section8   = section.addInstance();
const section9   = section.addInstance();
const section10  = section.addInstance();
const section11  = section.addInstance();
const section12  = section.addInstance();

/**
 * Write custom configuration values to the imported modules.
 */
edma1.$name                 = "CONFIG_EDMA0";
edma1.edmaRmDmaCh[0].$name  = "CONFIG_EDMA_RM0";
edma1.edmaRmQdmaCh[0].$name = "CONFIG_EDMA_RM1";
edma1.edmaRmTcc[0].$name    = "CONFIG_EDMA_RM2";
edma1.edmaRmParam[0].$name  = "CONFIG_EDMA_RM3";

epwm1.$name        = "CONFIG_EPWM0";
epwm1.EPWM.$assign = "EPWM0";

epwm2.$name        = "CONFIG_EPWM1";
epwm2.EPWM.$assign = "EPWM1";

epwm3.$name = "CONFIG_EPWM2";

epwm4.$name = "CONFIG_EPWM3";

epwm5.$name = "CONFIG_EPWM4";

epwm6.$name = "CONFIG_EPWM5";

epwm7.$name = "CONFIG_EPWM6";

epwm8.$name = "CONFIG_EPWM7";

epwm9.$name = "CONFIG_EPWM8";

epwm10.$name = "CONFIG_EPWM9";

epwm11.$name = "CONFIG_EPWM10";

epwm12.$name = "CONFIG_EPWM11";

epwm13.$name = "CONFIG_EPWM12";

epwm14.$name = "CONFIG_EPWM13";

epwm15.$name = "CONFIG_EPWM14";

epwm16.$name = "CONFIG_EPWM15";

epwm17.$name = "CONFIG_EPWM16";

epwm18.$name = "CONFIG_EPWM17";

epwm19.$name = "CONFIG_EPWM18";

epwm20.$name = "CONFIG_EPWM19";

epwm21.$name = "CONFIG_EPWM20";

epwm22.$name = "CONFIG_EPWM21";

epwm23.$name = "CONFIG_EPWM22";

epwm24.$name = "CONFIG_EPWM23";

epwm25.$name = "CONFIG_EPWM24";

epwm26.$name = "CONFIG_EPWM25";

epwm27.$name = "CONFIG_EPWM26";

epwm28.$name = "CONFIG_EPWM27";

epwm29.$name = "CONFIG_EPWM28";

epwm30.$name = "CONFIG_EPWM29";

epwm31.$name = "CONFIG_EPWM30";

epwm32.$name = "CONFIG_EPWM31";

debug_log.enableUartLog            = true;
debug_log.uartLog.$name            = "CONFIG_UART0";
debug_log.uartLog.UART.RXD.$assign = "GPIO27";
debug_log.uartLog.UART.TXD.$assign = "GPIO28";
debug_log.uartLog.child.$name      = "drivers_uart_v2_uart_v2_template0";

mpu_armv71.$name             = "CONFIG_MPU_REGION0";
mpu_armv71.size              = 31;
mpu_armv71.attributes        = "Device";
mpu_armv71.accessPermissions = "Supervisor RD+WR, User RD";
mpu_armv71.allowExecute      = false;

mpu_armv72.$name             = "CONFIG_MPU_REGION1";
mpu_armv72.size              = 15;
mpu_armv72.accessPermissions = "Supervisor RD+WR, User RD";

mpu_armv73.$name             = "CONFIG_MPU_REGION2";
mpu_armv73.baseAddr          = 0x80000;
mpu_armv73.size              = 15;
mpu_armv73.accessPermissions = "Supervisor RD+WR, User RD";

mpu_armv74.$name             = "CONFIG_MPU_REGION3";
mpu_armv74.accessPermissions = "Supervisor RD+WR, User RD";
mpu_armv74.baseAddr          = 0x70000000;
mpu_armv74.size              = 21;

timer1.$name = "CONFIG_TIMER0";

general1.$name        = "CONFIG_GENERAL0";
general1.linker.$name = "TIARMCLANG0";

region1.$name                                = "MEMORY_REGION_CONFIGURATION";
region1.memory_region.create(12);
region1.memory_region[0].type                = "TCMA";
region1.memory_region[0].$name               = "R5F_VECS";
region1.memory_region[0].auto                = false;
region1.memory_region[0].size                = 0x40;
region1.memory_region[1].type                = "TCMA";
region1.memory_region[1].$name               = "R5F_TCMA";
region1.memory_region[1].size                = 0x7FC0;
region1.memory_region[2].type                = "TCMB";
region1.memory_region[2].$name               = "R5F_TCMB";
region1.memory_region[2].size                = 0x8000;
region1.memory_region[3].$name               = "SBL";
region1.memory_region[3].size                = 0x40000;
region1.memory_region[4].$name               = "OCRAM";
region1.memory_region[4].auto                = false;
region1.memory_region[4].manualStartAddress  = 0x70040000;
region1.memory_region[4].size                = 0x40000;
region1.memory_region[5].type                = "FLASH";
region1.memory_region[5].auto                = false;
region1.memory_region[5].manualStartAddress  = 0x60100000;
region1.memory_region[5].size                = 0x80000;
region1.memory_region[5].$name               = "FLASH";
region1.memory_region[6].$name               = "USER_SHM_MEM";
region1.memory_region[6].auto                = false;
region1.memory_region[6].manualStartAddress  = 0x70150000; 
region1.memory_region[6].size                = 0x4000;
region1.memory_region[6].isShared            = true;
region1.memory_region[6].shared_cores        = ["r5fss0-1"];
region1.memory_region[7].$name               = "LOG_SHM_MEM";
region1.memory_region[7].auto                = false;
region1.memory_region[7].manualStartAddress  = 0x70154000; 
region1.memory_region[7].size                = 0x4000;
region1.memory_region[7].isShared            = true;
region1.memory_region[7].shared_cores        = ["r5fss0-1"];
region1.memory_region[8].type                = "CUSTOM";
region1.memory_region[8].$name               = "RTOS_NORTOS_IPC_SHM_MEM";
region1.memory_region[8].auto                = false;
region1.memory_region[8].manualStartAddress  = 0x72000000;
region1.memory_region[8].isShared            = true;
region1.memory_region[8].shared_cores        = ["r5fss0-1"];
region1.memory_region[8].size                = 0x3E80;
region1.memory_region[9].type                = "CUSTOM";
region1.memory_region[9].$name               = "MAILBOX_HSM";
region1.memory_region[9].auto                = false;
region1.memory_region[9].manualStartAddress  = 0x44000000;
region1.memory_region[9].size                = 0x3CE;
region1.memory_region[9].isShared            = true;
region1.memory_region[9].shared_cores        = ["r5fss0-1"];
region1.memory_region[10].type               = "CUSTOM";
region1.memory_region[10].$name              = "MAILBOX_R5F";
region1.memory_region[10].auto               = false;
region1.memory_region[10].manualStartAddress = 0x44000400;
region1.memory_region[10].size               = 0x3CE;
region1.memory_region[10].isShared           = true;
region1.memory_region[10].shared_cores       = ["r5fss0-1"];
region1.memory_region[11].type               = "CUSTOM";
region1.memory_region[11].$name              = "MSS_CTRL";
region1.memory_region[11].auto               = false;
region1.memory_region[11].manualStartAddress = 0x50D00000;
region1.memory_region[11].size               = 0x4000;
region1.memory_region[11].isShared           = true;
region1.memory_region[11].shared_cores       = ["r5fss0-1"];

section1.load_memory             = "R5F_VECS";
section1.group                   = false;
section1.$name                   = "Vector Table";
section1.output_section.create(1);
section1.output_section[0].$name = ".vectors";

section2.load_memory             = "OCRAM";
section2.$name                   = "Text Segments";
section2.output_section.create(5);
section2.output_section[0].$name = ".text.hwi";
section2.output_section[1].$name = ".text.cache";
section2.output_section[2].$name = ".text.mpu";
section2.output_section[3].$name = ".text.boot";
section2.output_section[4].$name = ".text:abort";

section3.load_memory             = "OCRAM";
section3.$name                   = "Code and Read-Only Data";
section3.output_section.create(2);
section3.output_section[0].$name = ".text";
section3.output_section[1].$name = ".rodata";

section4.load_memory             = "OCRAM";
section4.$name                   = "Data Segment";
section4.output_section.create(1);
section4.output_section[0].$name = ".data";

section5.load_memory                             = "OCRAM";
section5.$name                                   = "Memory Segments";
section5.output_section.create(3);
section5.output_section[0].$name                 = ".bss";
section5.output_section[0].output_sections_start = "__BSS_START";
section5.output_section[0].output_sections_end   = "__BSS_END";
section5.output_section[1].$name                 = ".sysmem";
section5.output_section[2].$name                 = ".stack";

section6.load_memory                              = "OCRAM";
section6.$name                                    = "Stack Segments";
section6.output_section.create(5);
section6.output_section[0].$name                  = ".irqstack";
section6.output_section[0].output_sections_start  = "__IRQ_STACK_START";
section6.output_section[0].output_sections_end    = "__IRQ_STACK_END";
section6.output_section[0].input_section.create(1);
section6.output_section[0].input_section[0].$name = ". = . + __IRQ_STACK_SIZE;";
section6.output_section[1].$name                  = ".fiqstack";
section6.output_section[1].output_sections_start  = "__FIQ_STACK_START";
section6.output_section[1].output_sections_end    = "__FIQ_STACK_END";
section6.output_section[1].input_section.create(1);
section6.output_section[1].input_section[0].$name = ". = . + __FIQ_STACK_SIZE;";
section6.output_section[2].$name                  = ".svcstack";
section6.output_section[2].output_sections_start  = "__SVC_STACK_START";
section6.output_section[2].output_sections_end    = "__SVC_STACK_END";
section6.output_section[2].input_section.create(1);
section6.output_section[2].input_section[0].$name = ". = . + __SVC_STACK_SIZE;";
section6.output_section[3].$name                  = ".abortstack";
section6.output_section[3].output_sections_start  = "__ABORT_STACK_START";
section6.output_section[3].output_sections_end    = "__ABORT_STACK_END";
section6.output_section[3].input_section.create(1);
section6.output_section[3].input_section[0].$name = ". = . + __ABORT_STACK_SIZE;";
section6.output_section[4].$name                  = ".undefinedstack";
section6.output_section[4].output_sections_start  = "__UNDEFINED_STACK_START";
section6.output_section[4].output_sections_end    = "__UNDEFINED_STACK_END";
section6.output_section[4].input_section.create(1);
section6.output_section[4].input_section[0].$name = ". = . + __UNDEFINED_STACK_SIZE;";

section7.load_memory             = "OCRAM";
section7.$name                   = "Initialization and Exception Handling";
section7.output_section.create(3);
section7.output_section[0].$name = ".ARM.exidx";
section7.output_section[1].$name = ".init_array";
section7.output_section[2].$name = ".fini_array";

section8.load_memory             = "USER_SHM_MEM";
section8.type                    = "NOLOAD";
section8.$name                   = "User Shared Memory";
section8.group                   = false;
section8.output_section.create(1);
section8.output_section[0].$name = ".bss.user_shared_mem";

section9.load_memory             = "LOG_SHM_MEM";
section9.$name                   = "Log Shared Memory";
section9.group                   = false;
section9.output_section.create(1);
section9.output_section[0].$name = ".bss.log_shared_mem";

section10.load_memory             = "RTOS_NORTOS_IPC_SHM_MEM";
section10.type                    = "NOLOAD";
section10.$name                   = "IPC Shared Memory";
section10.group                   = false;
section10.output_section.create(1);
section10.output_section[0].$name = ".bss.ipc_vring_mem";

section11.load_memory             = "MAILBOX_HSM";
section11.type                    = "NOLOAD";
section11.$name                   = "SIPC HSM Queue Memory";
section11.group                   = false;
section11.output_section.create(1);
section11.output_section[0].$name = ".bss.sipc_hsm_queue_mem";

section12.load_memory             = "MAILBOX_R5F";
section12.$name                   = "SIPC R5F Queue Memory";
section12.group                   = false;
section12.output_section.create(1);
section12.output_section[0].$name = ".bss.sipc_secure_host_queue_mem";

/**
 * Pinmux solution for unlocked pins/peripherals. This ensures that minor changes to the automatic solver in a future
 * version of the tool will not impact the pinmux you originally saw.  These lines can be completely deleted in order to
 * re-solve from scratch.
 */
epwm1.EPWM.A.$suggestSolution           = "GPIO43";
epwm1.EPWM.B.$suggestSolution           = "GPIO44";
epwm2.EPWM.A.$suggestSolution           = "GPIO45";
epwm2.EPWM.B.$suggestSolution           = "GPIO52";
epwm3.EPWM.$suggestSolution             = "EPWM28";
epwm3.EPWM.A.$suggestSolution           = "GPIO99";
epwm3.EPWM.B.$suggestSolution           = "GPIO100";
epwm4.EPWM.$suggestSolution             = "EPWM31";
epwm4.EPWM.A.$suggestSolution           = "GPIO105";
epwm4.EPWM.B.$suggestSolution           = "GPIO106";
epwm5.EPWM.$suggestSolution             = "EPWM30";
epwm5.EPWM.A.$suggestSolution           = "GPIO103";
epwm5.EPWM.B.$suggestSolution           = "GPIO104";
epwm6.EPWM.$suggestSolution             = "EPWM29";
epwm6.EPWM.A.$suggestSolution           = "GPIO101";
epwm6.EPWM.B.$suggestSolution           = "GPIO102";
epwm7.EPWM.$suggestSolution             = "EPWM27";
epwm7.EPWM.A.$suggestSolution           = "GPIO97";
epwm7.EPWM.B.$suggestSolution           = "GPIO98";
epwm8.EPWM.$suggestSolution             = "EPWM26";
epwm8.EPWM.A.$suggestSolution           = "GPIO95";
epwm8.EPWM.B.$suggestSolution           = "GPIO96";
epwm9.EPWM.$suggestSolution             = "EPWM25";
epwm9.EPWM.A.$suggestSolution           = "GPIO93";
epwm9.EPWM.B.$suggestSolution           = "GPIO94";
epwm10.EPWM.$suggestSolution            = "EPWM24";
epwm10.EPWM.A.$suggestSolution          = "GPIO91";
epwm10.EPWM.B.$suggestSolution          = "GPIO92";
epwm11.EPWM.$suggestSolution            = "EPWM23";
epwm11.EPWM.A.$suggestSolution          = "GPIO109";
epwm11.EPWM.B.$suggestSolution          = "GPIO90";
epwm12.EPWM.$suggestSolution            = "EPWM22";
epwm12.EPWM.A.$suggestSolution          = "GPIO87";
epwm12.EPWM.B.$suggestSolution          = "GPIO89";
epwm13.EPWM.$suggestSolution            = "EPWM21";
epwm13.EPWM.A.$suggestSolution          = "GPIO85";
epwm13.EPWM.B.$suggestSolution          = "GPIO86";
epwm14.EPWM.$suggestSolution            = "EPWM20";
epwm14.EPWM.A.$suggestSolution          = "GPIO83";
epwm14.EPWM.B.$suggestSolution          = "GPIO84";
epwm15.EPWM.$suggestSolution            = "EPWM19";
epwm15.EPWM.A.$suggestSolution          = "GPIO81";
epwm15.EPWM.B.$suggestSolution          = "GPIO82";
epwm16.EPWM.$suggestSolution            = "EPWM18";
epwm16.EPWM.A.$suggestSolution          = "GPIO79";
epwm16.EPWM.B.$suggestSolution          = "GPIO80";
epwm17.EPWM.$suggestSolution            = "EPWM17";
epwm17.EPWM.A.$suggestSolution          = "GPIO77";
epwm17.EPWM.B.$suggestSolution          = "GPIO78";
epwm18.EPWM.$suggestSolution            = "EPWM16";
epwm18.EPWM.A.$suggestSolution          = "GPIO115";
epwm18.EPWM.B.$suggestSolution          = "GPIO116";
epwm19.EPWM.$suggestSolution            = "EPWM15";
epwm19.EPWM.A.$suggestSolution          = "GPIO37";
epwm19.EPWM.B.$suggestSolution          = "GPIO36";
epwm20.EPWM.$suggestSolution            = "EPWM14";
epwm20.EPWM.A.$suggestSolution          = "GPIO29";
epwm20.EPWM.B.$suggestSolution          = "GPIO35";
epwm21.EPWM.$suggestSolution            = "EPWM13";
epwm21.EPWM.A.$suggestSolution          = "EPWM13_A";
epwm21.EPWM.B.$suggestSolution          = "EPWM13_B";
epwm22.EPWM.$suggestSolution            = "EPWM12";
epwm22.EPWM.A.$suggestSolution          = "EPWM12_A";
epwm22.EPWM.B.$suggestSolution          = "GPIO3";
epwm23.EPWM.$suggestSolution            = "EPWM11";
epwm23.EPWM.A.$suggestSolution          = "EPWM11_A";
epwm23.EPWM.B.$suggestSolution          = "EPWM11_B";
epwm24.EPWM.$suggestSolution            = "EPWM10";
epwm24.EPWM.A.$suggestSolution          = "EPWM12_B";
epwm24.EPWM.B.$suggestSolution          = "EPWM10_B";
epwm25.EPWM.$suggestSolution            = "EPWM9";
epwm25.EPWM.A.$suggestSolution          = "GPIO61";
epwm25.EPWM.B.$suggestSolution          = "GPIO62";
epwm26.EPWM.$suggestSolution            = "EPWM8";
epwm26.EPWM.A.$suggestSolution          = "GPIO59";
epwm26.EPWM.B.$suggestSolution          = "GPIO60";
epwm27.EPWM.$suggestSolution            = "EPWM7";
epwm27.EPWM.A.$suggestSolution          = "GPIO57";
epwm27.EPWM.B.$suggestSolution          = "EPWM10_A";
epwm28.EPWM.$suggestSolution            = "EPWM6";
epwm28.EPWM.A.$suggestSolution          = "GPIO55";
epwm28.EPWM.B.$suggestSolution          = "GPIO56";
epwm29.EPWM.$suggestSolution            = "EPWM5";
epwm29.EPWM.A.$suggestSolution          = "GPIO53";
epwm29.EPWM.B.$suggestSolution          = "GPIO54";
epwm30.EPWM.$suggestSolution            = "EPWM4";
epwm30.EPWM.A.$suggestSolution          = "GPIO51";
epwm30.EPWM.B.$suggestSolution          = "GPIO46";
epwm31.EPWM.$suggestSolution            = "EPWM3";
epwm31.EPWM.A.$suggestSolution          = "GPIO49";
epwm31.EPWM.B.$suggestSolution          = "GPIO50";
epwm32.EPWM.$suggestSolution            = "EPWM2";
epwm32.EPWM.A.$suggestSolution          = "GPIO47";
epwm32.EPWM.B.$suggestSolution          = "GPIO48";
debug_log.uartLog.UART.$suggestSolution = "UART0";
timer1.RTI.$suggestSolution             = "RTI1";
