/**
 * @cliArgs --device "AM65xx_SR2.0_beta" --package "ACD" --part "Default" --context "r5fss0-0" --product "MCU_PLUS_SDK@07.03.01"
 * @versions {"tool":"1.14.0+2667"}
 */

/**
 * Import the modules used in this configuration.
 */
const uart       = scripting.addModule("/drivers/uart/uart", {}, false);
const uart1      = uart.addInstance();
const uart2      = uart.addInstance();
const debug_log  = scripting.addModule("/kernel/dpl/debug_log");
const dpl_cfg = scripting.addModule("/kernel/dpl/dpl_cfg");
const mpu_armv7  = scripting.addModule("/kernel/dpl/mpu_armv7", {}, false);
const mpu_armv71 = mpu_armv7.addInstance();
const mpu_armv72 = mpu_armv7.addInstance();
const mpu_armv73 = mpu_armv7.addInstance();
const mpu_armv74 = mpu_armv7.addInstance();
const mpu_armv75 = mpu_armv7.addInstance();
const mpu_armv76 = mpu_armv7.addInstance();

/**
 * Write custom configuration values to the imported modules.
 */
uart1.$name            = "CONFIG_UART0";
uart1.rxTrigLvl        = "56";
uart1.readReturnMode   = "PARTIAL";
uart1.UART.$assign     = "USART0";
uart1.UART.RXD.$assign = "ball.AF11";
uart1.UART.TXD.$assign = "ball.AE11";

uart2.$name                   = "CONFIG_UART1";
uart2.intrEnable              = "DMA";
uart2.useMcuDomainPeripherals = true;
uart2.readMode                = "CALLBACK";
uart2.readCallbackFxn         = "uart_echo_read_callback";
uart2.writeMode               = "CALLBACK";
uart2.writeCallbackFxn        = "uart_echo_write_callback";
uart2.MCU_UART.$assign        = "MCU_USART0";
uart2.MCU_UART.RXD.$assign    = "ball.P4";
uart2.MCU_UART.TXD.$assign    = "ball.P5";

const udma       = scripting.addModule("/drivers/udma/udma", {}, false);
const udma1      = udma.addInstance({}, false);
udma1.$name      = "CONFIG_UDMA0";
uart2.udmaDriver = udma1;

mpu_armv71.size         = 31;
mpu_armv71.allowExecute = false;
mpu_armv71.attributes   = "Device";
mpu_armv71.$name        = "SOC_MEM_MAP";

mpu_armv72.size  = 15;
mpu_armv72.$name = "ATCM_MEM_MAP";

mpu_armv73.baseAddr          = 0x41010000;
mpu_armv73.size              = 15;
mpu_armv73.allowExecute      = false;
mpu_armv73.accessPermissions = "Supervisor RD+WR, User RD";
mpu_armv73.$name             = "BTCM_MEM_MAP";

mpu_armv74.size       = 19;
mpu_armv74.baseAddr   = 0x41C00000;
mpu_armv74.attributes = "NonCached";
mpu_armv74.$name      = "MSRAM_MEM_MAP";

mpu_armv75.baseAddr = 0x70000000;
mpu_armv75.size     = 21;
mpu_armv75.$name    = "MSMC_SRAM_MEM_MAP";

mpu_armv76.baseAddr = 0x80000000;
mpu_armv76.size     = 31;
mpu_armv76.$name    = "DDR_MEM_MAP";
