/**
 * @cliArgs --device "AWR294X" --package "ETS" --part "Default" --context "c66ss0" --product "MCU_PLUS_SDK@07.03.01"
 * @versions {"tool":"1.10.0+2123"}
 */

/**
 * Import the modules used in this configuration.
 */
const ipc       = scripting.addModule("/drivers/ipc/ipc");
const cache_c6x = scripting.addModule("/kernel/dpl/cache_c6x");
const debug_log = scripting.addModule("/kernel/dpl/debug_log");
const dpl_cfg = scripting.addModule("/kernel/dpl/dpl_cfg");

/**
 * Write custom configuration values to the imported modules.
 */
ipc.r5fss0_1 = "NONE";
ipc.r5fss0_0 = "NONE";

cache_c6x.marRegionConfig.create(3);
cache_c6x.marRegionConfig[0].$name    = "kernel_dpl_cache_c6x_mar0";
cache_c6x.marRegionConfig[0].baseAddr = 0xC5000000;
cache_c6x.marRegionConfig[1].$name    = "kernel_dpl_cache_c6x_mar1";
cache_c6x.marRegionConfig[1].baseAddr = 0x83000000;
cache_c6x.marRegionConfig[2].$name    = "kernel_dpl_cache_c6x_mar2";
cache_c6x.marRegionConfig[2].baseAddr = 0xA4000000;

debug_log.enableUartLog               = true;
debug_log.uartLog.$name               = "CONFIG_UART0";
debug_log.uartLog.DSS_UART.$assign    = "DSS_UARTA";
debug_log.uartLog.DSS_UART.RX.$assign = "ball.B14";
debug_log.uartLog.DSS_UART.TX.$assign = "ball.A15";
