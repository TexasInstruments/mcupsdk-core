/**
 * @cliArgs --device "AM263Px" --package "ZCZ_S" --part "AM263P2" --context "r5fss0-0" --product "MCU_PLUS_SDK@07.03.01"
 * @versions {"tool":"1.12.1+2446"}
 */

/**
 * Import the modules used in this configuration.
 */
const edma           = scripting.addModule("/drivers/edma/edma", {}, false);
const edma1          = edma.addInstance();
const debug_log      = scripting.addModule("/kernel/dpl/debug_log");
const mpu_armv7      = scripting.addModule("/kernel/dpl/mpu_armv7", {}, false);
const mpu_armv71     = mpu_armv7.addInstance();
const mpu_armv72     = mpu_armv7.addInstance();
const mpu_armv73     = mpu_armv7.addInstance();
const mpu_armv74     = mpu_armv7.addInstance();
const timer          = scripting.addModule("/kernel/dpl/timer", {}, false);
const timer1         = timer.addInstance();
const dma_trig_xbar  = scripting.addModule("/xbar/dma_trig_xbar/dma_trig_xbar", {}, false);
const dma_trig_xbar1 = dma_trig_xbar.addInstance();

/**
 * Write custom configuration values to the imported modules.
 */
edma1.$name                 = "CONFIG_EDMA0";
edma1.edmaRmDmaCh[0].$name  = "CONFIG_EDMA_RM0";
edma1.edmaRmQdmaCh[0].$name = "CONFIG_EDMA_RM1";
edma1.edmaRmTcc[0].$name    = "CONFIG_EDMA_RM2";
edma1.edmaRmParam[0].$name  = "CONFIG_EDMA_RM3";

debug_log.enableUartLog            = true;
debug_log.uartLog.$name            = "CONFIG_UART0";
debug_log.uartLog.UART.RXD.$assign = "ball.A7";
debug_log.uartLog.UART.TXD.$assign = "ball.A6";

mpu_armv71.$name             = "CONFIG_MPU_REGION0";
mpu_armv71.size              = 31;
mpu_armv71.attributes        = "Device";
mpu_armv71.accessPermissions = "Supervisor RD+WR, User RD";
mpu_armv71.allowExecute      = false;

mpu_armv72.$name             = "CONFIG_MPU_REGION1";
mpu_armv72.size              = 15;
mpu_armv72.accessPermissions = "Supervisor RD+WR, User RD";

mpu_armv73.$name             = "CONFIG_MPU_REGION2";
mpu_armv73.baseAddr          = 0x80000;
mpu_armv73.size              = 15;
mpu_armv73.accessPermissions = "Supervisor RD+WR, User RD";

mpu_armv74.$name             = "CONFIG_MPU_REGION3";
mpu_armv74.accessPermissions = "Supervisor RD+WR, User RD";
mpu_armv74.baseAddr          = 0x70000000;
mpu_armv74.size              = 21;

timer1.$name            = "CONFIG_TIMER0";
timer1.usecPerTick      = 500000;
timer1.enableDmaTrigger = true;

dma_trig_xbar1.$name = "CONFIG_DMA_TRIG_XBAR0";

/**
 * Pinmux solution for unlocked pins/peripherals. This ensures that minor changes to the automatic solver in a future
 * version of the tool will not impact the pinmux you originally saw.  These lines can be completely deleted in order to
 * re-solve from scratch.
 */
debug_log.uartLog.UART.$suggestSolution = "UART0";
timer1.RTI.$suggestSolution             = "RTI1";
