/**
 * @cliArgs --device "AM243x_ALV_beta" --package "ALV" --part "ALV" --context "r5fss0-0" --product "MCU_PLUS_SDK@07.03.01"
 * @versions {"tool":"1.20.0+3587"}
 */

/**
 * Import the modules used in this configuration.
 */
const eeprom          = scripting.addModule("/board/eeprom/eeprom", {}, false);
const eeprom1         = eeprom.addInstance();
const ethphy          = scripting.addModule("/board/ethphy/ethphy", {}, false);
const ethphy1         = ethphy.addInstance();
const flash           = scripting.addModule("/board/flash/flash", {}, false);
const flash1          = flash.addInstance();
const led             = scripting.addModule("/board/led/led", {}, false);
const led1            = led.addInstance();
const adc             = scripting.addModule("/drivers/adc/adc", {}, false);
const adc1            = adc.addInstance();
const epwm            = scripting.addModule("/drivers/epwm/epwm", {}, false);
const epwm1           = epwm.addInstance();
const epwm2           = epwm.addInstance();
const epwm3           = epwm.addInstance();
const fsi_rx          = scripting.addModule("/drivers/fsi_rx/fsi_rx", {}, false);
const fsi_rx1         = fsi_rx.addInstance();
const fsi_rx2         = fsi_rx.addInstance();
const fsi_tx          = scripting.addModule("/drivers/fsi_tx/fsi_tx", {}, false);
const fsi_tx1         = fsi_tx.addInstance();
const gpio            = scripting.addModule("/drivers/gpio/gpio", {}, false);
const gpio1           = gpio.addInstance();
const gpio2           = gpio.addInstance();
const i2c             = scripting.addModule("/drivers/i2c/i2c", {}, false);
const i2c1            = i2c.addInstance();
const i2c2            = i2c.addInstance();
const i2c3            = i2c.addInstance();
const i2c4            = i2c.addInstance();
const ipc             = scripting.addModule("/drivers/ipc/ipc");
const mcan            = scripting.addModule("/drivers/mcan/mcan", {}, false);
const mcan1           = mcan.addInstance();
const mcspi           = scripting.addModule("/drivers/mcspi/mcspi", {}, false);
const mcspi1          = mcspi.addInstance();
const mcspi2          = mcspi.addInstance();
const mcspi3          = mcspi.addInstance();
const pruicss         = scripting.addModule("/drivers/pruicss/pruicss", {}, false);
const pruicss1        = pruicss.addInstance();
const debug_log       = scripting.addModule("/kernel/dpl/debug_log");
const dpl_cfg = scripting.addModule("/kernel/dpl/dpl_cfg");
const mpu_armv7       = scripting.addModule("/kernel/dpl/mpu_armv7", {}, false);
const mpu_armv71      = mpu_armv7.addInstance();
const mpu_armv72      = mpu_armv7.addInstance();
const mpu_armv73      = mpu_armv7.addInstance();
const mpu_armv74      = mpu_armv7.addInstance();
const mpu_armv75      = mpu_armv7.addInstance();
const timer           = scripting.addModule("/kernel/dpl/timer", {}, false);
const timer1          = timer.addInstance();
const timer2          = timer.addInstance();
const timer3          = timer.addInstance();
const timer4          = timer.addInstance();
const timer5          = timer.addInstance();
const timer6          = timer.addInstance();
const timer7          = timer.addInstance();
const timer8          = timer.addInstance();
const default_linker  = scripting.addModule("/memory_configurator/default_linker", {}, false);
const default_linker1 = default_linker.addInstance();
const general         = scripting.addModule("/memory_configurator/general", {}, false);
const general1        = general.addInstance();
const region          = scripting.addModule("/memory_configurator/region", {}, false);
const region1         = region.addInstance();
const section         = scripting.addModule("/memory_configurator/section", {}, false);
const section1        = section.addInstance();
const section2        = section.addInstance();
const section3        = section.addInstance();
const section4        = section.addInstance();
const section5        = section.addInstance();
const section6        = section.addInstance();
const section7        = section.addInstance();
const section8        = section.addInstance();
const section9        = section.addInstance();
const section10       = section.addInstance();
const section11       = section.addInstance();

/**
 * Write custom configuration values to the imported modules.
 */
eeprom1.$name = "CONFIG_EEPROM0";

ethphy1.$name = "CONFIG_ETHPHY0";

flash1.$name                  = "CONFIG_FLASH0";
flash1.peripheralDriver.$name = "CONFIG_OSPI0";

led1.$name = "CONFIG_LED0";

adc1.$name = "CONFIG_ADC0";

epwm1.$name = "CONFIG_EPWM0";

epwm2.$name = "CONFIG_EPWM1";

epwm3.$name = "CONFIG_EPWM2";

fsi_rx1.$name = "CONFIG_FSI_RX0";

fsi_rx2.$name = "CONFIG_FSI_RX1";

fsi_tx1.$name = "CONFIG_FSI_TX0";

gpio1.$name           = "CONFIG_GPIO0";
led1.peripheralDriver = gpio1;
gpio1.rx              = true;
gpio1.GPIO_n.$assign  = "ECAP0_IN_APWM_OUT";

gpio2.$name = "CONFIG_GPIO1";
gpio2.rx    = true;

i2c1.$name               = "CONFIG_I2C0";
eeprom1.peripheralDriver = i2c1;
i2c1.I2C_child.$name     = "drivers_i2c_v0_i2c_v0_template1";

i2c2.$name           = "CONFIG_I2C1";
i2c2.I2C_child.$name = "drivers_i2c_v0_i2c_v0_template2";

i2c3.$name           = "CONFIG_I2C2";
i2c3.I2C_child.$name = "drivers_i2c_v0_i2c_v0_template3";

i2c4.$name           = "CONFIG_I2C3";
i2c4.I2C_child.$name = "drivers_i2c_v0_i2c_v0_template4";

ipc.m4fss0_0 = "notify";
ipc.r5fss1_0 = "NONE";
ipc.r5fss1_1 = "NONE";
ipc.r5fss0_1 = "notify";

mcan1.$name = "CONFIG_MCAN0";

mcspi1.$name                 = "CONFIG_MCSPI0";
mcspi1.mcspiChannel[0].$name = "CONFIG_MCSPI_CH0";
mcspi1.child.$name           = "drivers_mcspi_v0_mcspi_v0_template0";

mcspi2.$name                 = "CONFIG_MCSPI1";
mcspi2.mcspiChannel[0].$name = "CONFIG_MCSPI_CH1";
mcspi2.child.$name           = "drivers_mcspi_v0_mcspi_v0_template1";

mcspi3.$name                 = "CONFIG_MCSPI2";
mcspi3.mcspiChannel[0].$name = "CONFIG_MCSPI_CH2";
mcspi3.child.$name           = "drivers_mcspi_v0_mcspi_v0_template2";

pruicss1.$name                           = "CONFIG_PRU_ICSS0";
pruicss1.AdditionalICSSSettings[0].$name = "CONFIG_PRU_ICSS_IO0";

const udma        = scripting.addModule("/drivers/udma/udma", {}, false);
const udma1       = udma.addInstance({}, false);
udma1.$name       = "CONFIG_UDMA0";
mcspi1.udmaDriver = udma1;
mcspi2.udmaDriver = udma1;
mcspi3.udmaDriver = udma1;

debug_log.enableUartLog            = true;
debug_log.enableSharedMemLogReader = true;
debug_log.enableSharedMemLog       = true;
debug_log.enableCssLog             = false;
debug_log.uartLog.$name            = "CONFIG_UART0";
debug_log.uartLog.UART.$assign     = "USART0";

const uart_v0_template  = scripting.addModule("/drivers/uart/v0/uart_v0_template", {}, false);
const uart_v0_template1 = uart_v0_template.addInstance({}, false);
uart_v0_template1.$name = "drivers_uart_v0_uart_v0_template0";
debug_log.uartLog.child = uart_v0_template1;

mpu_armv71.$name             = "CONFIG_MPU_REGION0";
mpu_armv71.size              = 31;
mpu_armv71.attributes        = "Device";
mpu_armv71.accessPermissions = "Supervisor RD+WR, User RD";
mpu_armv71.allowExecute      = false;

mpu_armv72.$name             = "CONFIG_MPU_REGION1";
mpu_armv72.size              = 15;
mpu_armv72.accessPermissions = "Supervisor RD+WR, User RD";

mpu_armv73.$name             = "CONFIG_MPU_REGION2";
mpu_armv73.baseAddr          = 0x41010000;
mpu_armv73.size              = 15;
mpu_armv73.accessPermissions = "Supervisor RD+WR, User RD";

mpu_armv74.$name             = "CONFIG_MPU_REGION3";
mpu_armv74.baseAddr          = 0x70000000;
mpu_armv74.size              = 21;
mpu_armv74.accessPermissions = "Supervisor RD+WR, User RD";

mpu_armv75.$name        = "CONFIG_MPU_REGION4";
mpu_armv75.attributes   = "NonCached";
mpu_armv75.allowExecute = false;
mpu_armv75.baseAddr     = 0x701D0000;
mpu_armv75.size         = 16;

timer1.$name = "CONFIG_TIMER0";

timer2.$name = "CONFIG_TIMER1";

timer3.$name = "CONFIG_TIMER2";

timer4.$name = "CONFIG_TIMER3";

timer5.$name = "CONFIG_TIMER4";

timer6.$name = "CONFIG_TIMER5";

timer7.$name = "CONFIG_TIMER6";

timer8.$name = "CONFIG_TIMER7";

default_linker1.$name = "memory_configurator_default_linker0";

general1.$name        = "CONFIG_GENERAL0";
general1.linker.$name = "TIARMCLANG0";

region1.$name                               = "MEMORY_REGION_CONFIGURATION0";
region1.memory_region.create(9);
region1.memory_region[0].type               = "TCMA_R5F";
region1.memory_region[0].$name              = "R5F_VECS";
region1.memory_region[0].size               = 0x40;
region1.memory_region[0].auto               = false;
region1.memory_region[1].type               = "TCMA_R5F";
region1.memory_region[1].$name              = "R5F_TCMA";
region1.memory_region[1].size               = 0x7FC0;
region1.memory_region[2].type               = "TCMB_R5F";
region1.memory_region[2].$name              = "R5F_TCMB0";
region1.memory_region[2].size               = 0x8000;
region1.memory_region[3].$name              = "NON_CACHE_MEM";
region1.memory_region[3].auto               = false;
region1.memory_region[3].manualStartAddress = 0x70060000;
region1.memory_region[3].size               = 0x8000;
region1.memory_region[4].$name              = "MSRAM";
region1.memory_region[4].auto               = false;
region1.memory_region[4].manualStartAddress = 0x70080000;
region1.memory_region[4].size               = 0x41000;
region1.memory_region[5].type               = "FLASH";
region1.memory_region[5].$name              = "FLASH";
region1.memory_region[5].auto               = false;
region1.memory_region[5].manualStartAddress = 0x60100000;
region1.memory_region[5].size               = 0x80000;
region1.memory_region[6].$name              = "USER_SHM_MEM";
region1.memory_region[6].auto               = false;
region1.memory_region[6].manualStartAddress = 0x701D0000;
region1.memory_region[6].size               = 0x180;
region1.memory_region[6].isShared           = true;
region1.memory_region[6].shared_cores       = ["m4fss0-0","r5fss0-1","r5fss1-0","r5fss1-1"];
region1.memory_region[7].auto               = false;
region1.memory_region[7].manualStartAddress = 0x701D0180;
region1.memory_region[7].size               = 0x3E80;
region1.memory_region[7].$name              = "LOG_SHM_MEM";
region1.memory_region[7].isShared           = true;
region1.memory_region[7].shared_cores       = ["m4fss0-0","r5fss0-1","r5fss1-0","r5fss1-1"];
region1.memory_region[8].auto               = false;
region1.memory_region[8].manualStartAddress = 0x701D4000;
region1.memory_region[8].size               = 0xC000;
region1.memory_region[8].$name              = "RTOS_NORTOS_IPC_SHM_MEM";
region1.memory_region[8].isShared           = true;
region1.memory_region[8].shared_cores       = ["m4fss0-0","r5fss0-1","r5fss1-0","r5fss1-1"];

section1.$name                        = "Vector Table";
section1.load_memory                  = "R5F_VECS";
section1.group                        = false;
section1.output_section.create(1);
section1.output_section[0].$name      = ".vectors";
section1.output_section[0].palignment = true;

section2.$name                        = "Text Segments";
section2.load_memory                  = "MSRAM";
section2.output_section.create(5);
section2.output_section[0].$name      = ".text.hwi";
section2.output_section[0].palignment = true;
section2.output_section[1].$name      = ".text.cache";
section2.output_section[1].palignment = true;
section2.output_section[2].$name      = ".text.mpu";
section2.output_section[2].palignment = true;
section2.output_section[3].$name      = ".text.boot";
section2.output_section[3].palignment = true;
section2.output_section[4].$name      = ".text:abort";
section2.output_section[4].palignment = true;

section3.$name                        = "Code and Read-Only Data";
section3.load_memory                  = "MSRAM";
section3.output_section.create(2);
section3.output_section[0].$name      = ".text";
section3.output_section[0].palignment = true;
section3.output_section[1].$name      = ".rodata";
section3.output_section[1].palignment = true;

section4.$name                        = "Data Segment";
section4.load_memory                  = "NON_CACHE_MEM";
section4.output_section.create(1);
section4.output_section[0].$name      = ".data";
section4.output_section[0].palignment = true;

section5.$name                                   = "Memory Segments";
section5.load_memory                             = "MSRAM";
section5.output_section.create(3);
section5.output_section[0].$name                 = ".bss";
section5.output_section[0].palignment            = true;
section5.output_section[0].output_sections_start = "__BSS_START";
section5.output_section[0].output_sections_end   = "__BSS_END";
section5.output_section[1].$name                 = ".sysmem";
section5.output_section[1].palignment            = true;
section5.output_section[2].$name                 = ".stack";
section5.output_section[2].palignment            = true;

section6.$name                                    = "Stack Segments";
section6.load_memory                              = "MSRAM";
section6.output_section.create(5);
section6.output_section[0].$name                  = ".irqstack";
section6.output_section[0].output_sections_start  = "__IRQ_STACK_START";
section6.output_section[0].output_sections_end    = "__IRQ_STACK_END";
section6.output_section[0].input_section.create(1);
section6.output_section[0].input_section[0].$name = ". = . + __IRQ_STACK_SIZE;";
section6.output_section[1].$name                  = ".fiqstack";
section6.output_section[1].output_sections_start  = "__FIQ_STACK_START";
section6.output_section[1].output_sections_end    = "__FIQ_STACK_END";
section6.output_section[1].input_section.create(1);
section6.output_section[1].input_section[0].$name = ". = . + __FIQ_STACK_SIZE;";
section6.output_section[2].$name                  = ".svcstack";
section6.output_section[2].output_sections_start  = "__SVC_STACK_START";
section6.output_section[2].output_sections_end    = "__SVC_STACK_END";
section6.output_section[2].input_section.create(1);
section6.output_section[2].input_section[0].$name = ". = . + __SVC_STACK_SIZE;";
section6.output_section[3].$name                  = ".abortstack";
section6.output_section[3].output_sections_start  = "__ABORT_STACK_START";
section6.output_section[3].output_sections_end    = "__ABORT_STACK_END";
section6.output_section[3].input_section.create(1);
section6.output_section[3].input_section[0].$name = ". = . + __ABORT_STACK_SIZE;";
section6.output_section[4].$name                  = ".undefinedstack";
section6.output_section[4].output_sections_start  = "__UNDEFINED_STACK_START";
section6.output_section[4].output_sections_end    = "__UNDEFINED_STACK_END";
section6.output_section[4].input_section.create(1);
section6.output_section[4].input_section[0].$name = ". = . + __UNDEFINED_STACK_SIZE;";

section7.$name                        = "Initialization and Exception Handling";
section7.load_memory                  = "MSRAM";
section7.output_section.create(3);
section7.output_section[0].$name      = ".ARM.exidx";
section7.output_section[0].palignment = true;
section7.output_section[1].$name      = ".init_array";
section7.output_section[1].palignment = true;
section7.output_section[2].$name      = ".fini_array";
section7.output_section[2].palignment = true;

section8.$name                       = "User Shared Memory";
section8.type                        = "NOLOAD";
section8.load_memory                 = "USER_SHM_MEM";
section8.group                       = false;
section8.output_section.create(1);
section8.output_section[0].$name     = ".bss.user_shared_mem";
section8.output_section[0].alignment = 0;

section9.$name                       = "Log Shared Memory";
section9.load_memory                 = "LOG_SHM_MEM";
section9.type                        = "NOLOAD";
section9.group                       = false;
section9.output_section.create(1);
section9.output_section[0].$name     = ".bss.log_shared_mem";
section9.output_section[0].alignment = 0;

section10.$name                       = "IPC Shared Memory";
section10.type                        = "NOLOAD";
section10.load_memory                 = "RTOS_NORTOS_IPC_SHM_MEM";
section10.group                       = false;
section10.output_section.create(1);
section10.output_section[0].$name     = ".bss.ipc_vring_mem";
section10.output_section[0].alignment = 0;

section11.$name                       = "Non Cacheable Memory";
section11.load_memory                 = "NON_CACHE_MEM";
section11.group                       = false;
section11.type                        = "NOLOAD";
section11.output_section.create(1);
section11.output_section[0].$name     = ".bss.nocache";
section11.output_section[0].alignment = 0;

/**
 * Pinmux solution for unlocked pins/peripherals. This ensures that minor changes to the automatic solver in a future
 * version of the tool will not impact the pinmux you originally saw.  These lines can be completely deleted in order to
 * re-solve from scratch.
 */
flash1.peripheralDriver.OSPI.$suggestSolution      = "OSPI0";
flash1.peripheralDriver.OSPI.CLK.$suggestSolution  = "OSPI0_CLK";
flash1.peripheralDriver.OSPI.CSn0.$suggestSolution = "OSPI0_CSn0";
flash1.peripheralDriver.OSPI.DQS.$suggestSolution  = "OSPI0_DQS";
flash1.peripheralDriver.OSPI.D7.$suggestSolution   = "OSPI0_D7";
flash1.peripheralDriver.OSPI.D6.$suggestSolution   = "OSPI0_D6";
flash1.peripheralDriver.OSPI.D5.$suggestSolution   = "OSPI0_D5";
flash1.peripheralDriver.OSPI.D4.$suggestSolution   = "OSPI0_D4";
flash1.peripheralDriver.OSPI.D3.$suggestSolution   = "OSPI0_D3";
flash1.peripheralDriver.OSPI.D2.$suggestSolution   = "OSPI0_D2";
flash1.peripheralDriver.OSPI.D1.$suggestSolution   = "OSPI0_D1";
flash1.peripheralDriver.OSPI.D0.$suggestSolution   = "OSPI0_D0";
adc1.ADC.$suggestSolution                          = "ADC0";
adc1.ADC.AIN0.$suggestSolution                     = "ADC0_AIN0";
adc1.ADC.AIN1.$suggestSolution                     = "ADC0_AIN1";
adc1.ADC.AIN2.$suggestSolution                     = "ADC0_AIN2";
adc1.ADC.AIN3.$suggestSolution                     = "ADC0_AIN3";
adc1.ADC.AIN4.$suggestSolution                     = "ADC0_AIN4";
adc1.ADC.AIN5.$suggestSolution                     = "ADC0_AIN5";
adc1.ADC.AIN6.$suggestSolution                     = "ADC0_AIN6";
adc1.ADC.AIN7.$suggestSolution                     = "ADC0_AIN7";
adc1.ADC.EXT_TRIGGER0.$suggestSolution             = "SPI0_CS1";
adc1.ADC.EXT_TRIGGER1.$suggestSolution             = "UART1_CTSn";
epwm1.EPWM.$suggestSolution                        = "EHRPWM0";
epwm1.EPWM.A.$suggestSolution                      = "GPMC0_AD3";
epwm1.EPWM.B.$suggestSolution                      = "GPMC0_AD4";
epwm1.EPWM.SYNCO.$suggestSolution                  = "GPMC0_AD1";
epwm1.EPWM.SYNCI.$suggestSolution                  = "GPMC0_AD0";
epwm2.EPWM.$suggestSolution                        = "EHRPWM3";
epwm2.EPWM.A.$suggestSolution                      = "GPMC0_AD13";
epwm2.EPWM.B.$suggestSolution                      = "GPMC0_AD14";
epwm2.EPWM.SYNCO.$suggestSolution                  = "GPMC0_CLK";
epwm2.EPWM.SYNCI.$suggestSolution                  = "GPMC0_AD15";
epwm3.EPWM.$suggestSolution                        = "EHRPWM6";
epwm3.EPWM.A.$suggestSolution                      = "SPI1_CS0";
epwm3.EPWM.B.$suggestSolution                      = "GPMC0_DIR";
epwm3.EPWM.SYNCO.$suggestSolution                  = "GPMC0_CSn1";
epwm3.EPWM.SYNCI.$suggestSolution                  = "GPMC0_CSn0";
fsi_rx1.FSI_RX.$suggestSolution                    = "FSI_RX5";
fsi_rx1.FSI_RX.CLK.$suggestSolution                = "GPMC0_ADVn_ALE";
fsi_rx1.FSI_RX.D0.$suggestSolution                 = "GPMC0_OEn_REn";
fsi_rx1.FSI_RX.D1.$suggestSolution                 = "GPMC0_WEn";
fsi_rx2.FSI_RX.$suggestSolution                    = "FSI_RX0";
fsi_rx2.FSI_RX.CLK.$suggestSolution                = "GPMC0_AD8";
fsi_rx2.FSI_RX.D0.$suggestSolution                 = "GPMC0_AD9";
fsi_rx2.FSI_RX.D1.$suggestSolution                 = "GPMC0_AD10";
fsi_tx1.FSI_TX.$suggestSolution                    = "FSI_TX1";
fsi_tx1.FSI_TX.CLK.$suggestSolution                = "GPMC0_WPn";
fsi_tx1.FSI_TX.D0.$suggestSolution                 = "GPMC0_BE0n_CLE";
fsi_tx1.FSI_TX.D1.$suggestSolution                 = "GPMC0_WAIT1";
gpio2.GPIO_n.$suggestSolution                      = "OSPI0_LBCLKO";
i2c1.I2C.$suggestSolution                          = "I2C3";
i2c1.I2C.SCL.$suggestSolution                      = "MCAN1_TX";
i2c1.I2C.SDA.$suggestSolution                      = "MCAN1_RX";
i2c2.I2C.$suggestSolution                          = "I2C0";
i2c2.I2C.SCL.$suggestSolution                      = "I2C0_SCL";
i2c2.I2C.SDA.$suggestSolution                      = "I2C0_SDA";
i2c3.I2C.$suggestSolution                          = "I2C2";
i2c3.I2C.SCL.$suggestSolution                      = "GPMC0_CSn2";
i2c3.I2C.SDA.$suggestSolution                      = "GPMC0_CSn3";
i2c4.I2C.$suggestSolution                          = "I2C1";
i2c4.I2C.SCL.$suggestSolution                      = "I2C1_SCL";
i2c4.I2C.SDA.$suggestSolution                      = "I2C1_SDA";
mcan1.MCAN.$suggestSolution                        = "MCAN0";
mcan1.MCAN.RX.$suggestSolution                     = "MCAN0_RX";
mcan1.MCAN.TX.$suggestSolution                     = "MCAN0_TX";
mcspi1.SPI.$suggestSolution                        = "SPI3";
mcspi1.SPI.CLK.$suggestSolution                    = "PRG0_PRU0_GPO16";
mcspi1.SPI.D0.$suggestSolution                     = "PRG0_PRU0_GPO13";
mcspi1.SPI.D1.$suggestSolution                     = "PRG0_PRU0_GPO14";
mcspi1.mcspiChannel[0].CSn.$suggestSolution        = "PRG0_PRU0_GPO17";
mcspi2.SPI.$suggestSolution                        = "SPI1";
mcspi2.SPI.CLK.$suggestSolution                    = "SPI1_CLK";
mcspi2.SPI.D0.$suggestSolution                     = "SPI1_D0";
mcspi2.SPI.D1.$suggestSolution                     = "SPI1_D1";
mcspi2.mcspiChannel[0].CSn.$suggestSolution        = "SPI1_CS1";
mcspi3.SPI.$suggestSolution                        = "SPI0";
mcspi3.SPI.CLK.$suggestSolution                    = "SPI0_CLK";
mcspi3.SPI.D0.$suggestSolution                     = "SPI0_D0";
mcspi3.SPI.D1.$suggestSolution                     = "SPI0_D1";
mcspi3.mcspiChannel[0].CSn.$suggestSolution        = "SPI0_CS0";
debug_log.uartLog.UART.RXD.$suggestSolution        = "UART0_RXD";
debug_log.uartLog.UART.TXD.$suggestSolution        = "UART0_TXD";
timer1.TIMER.$suggestSolution                      = "DMTIMER7";
timer2.TIMER.$suggestSolution                      = "DMTIMER6";
timer3.TIMER.$suggestSolution                      = "DMTIMER5";
timer4.TIMER.$suggestSolution                      = "DMTIMER4";
timer5.TIMER.$suggestSolution                      = "DMTIMER3";
timer6.TIMER.$suggestSolution                      = "DMTIMER2";
timer7.TIMER.$suggestSolution                      = "DMTIMER1";
timer8.TIMER.$suggestSolution                      = "DMTIMER0";
