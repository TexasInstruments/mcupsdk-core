/**
 * @cliArgs --device "AM263x_beta" --package "ZCZ" --part "AM263x" --context "r5fss0-0" --product "MCU_PLUS_SDK@07.03.01"
 * @versions {"tool":"1.10.0+2163"}
 */

/**
 * Import the modules used in this configuration.
 */
const ipc            = scripting.addModule("/drivers/ipc/ipc");
const debug_log      = scripting.addModule("/kernel/dpl/debug_log");
const mpu_armv7      = scripting.addModule("/kernel/dpl/mpu_armv7", {}, false);
const mpu_armv71     = mpu_armv7.addInstance();
const mpu_armv72     = mpu_armv7.addInstance();
const mpu_armv73     = mpu_armv7.addInstance();
const mpu_armv74     = mpu_armv7.addInstance();
const mpu_armv75     = mpu_armv7.addInstance();
const mpu_armv76     = mpu_armv7.addInstance();
const mpu_armv77     = mpu_armv7.addInstance();
const dma_trig_xbar  = scripting.addModule("/xbar/dma_trig_xbar/dma_trig_xbar", {}, false);
const dma_trig_xbar1 = dma_trig_xbar.addInstance();
const dma_trig_xbar2 = dma_trig_xbar.addInstance();
const dma_trig_xbar3 = dma_trig_xbar.addInstance();
const dma_trig_xbar4 = dma_trig_xbar.addInstance();
const dma_trig_xbar5 = dma_trig_xbar.addInstance();
const dma_trig_xbar6 = dma_trig_xbar.addInstance();
const icss_xbar      = scripting.addModule("/xbar/icss_xbar/icss_xbar", {}, false);
const icss_xbar1     = icss_xbar.addInstance();
const icss_xbar2     = icss_xbar.addInstance();

/**
 * Write custom configuration values to the imported modules.
 */
debug_log.enableUartLog            = true;
debug_log.enableSharedMemLog       = true;
debug_log.enableSharedMemLogReader = true;
debug_log.uartLog.$name            = "CONFIG_UART0";
debug_log.uartLog.UART.RXD.$assign = "UART0_RXD";
debug_log.uartLog.UART.TXD.$assign = "UART0_TXD";

mpu_armv71.$name             = "CONFIG_MPU_REGION0";
mpu_armv71.size              = 31;
mpu_armv71.attributes        = "Device";
mpu_armv71.accessPermissions = "Supervisor RD+WR, User RD";
mpu_armv71.allowExecute      = false;

mpu_armv72.$name             = "CONFIG_MPU_REGION1";
mpu_armv72.size              = 15;
mpu_armv72.accessPermissions = "Supervisor RD+WR, User RD";

mpu_armv73.$name             = "CONFIG_MPU_REGION2";
mpu_armv73.baseAddr          = 0x80000;
mpu_armv73.size              = 15;
mpu_armv73.accessPermissions = "Supervisor RD+WR, User RD";

mpu_armv74.$name             = "CONFIG_MPU_REGION3";
mpu_armv74.accessPermissions = "Supervisor RD+WR, User RD";
mpu_armv74.baseAddr          = 0x70000000;
mpu_armv74.size              = 21;

mpu_armv75.$name        = "CONFIG_MPU_REGION4";
mpu_armv75.size         = 14;
mpu_armv75.baseAddr     = 0x50D00000;
mpu_armv75.allowExecute = false;
mpu_armv75.attributes   = "Device";

mpu_armv76.$name        = "CONFIG_MPU_REGION5";
mpu_armv76.size         = 14;
mpu_armv76.allowExecute = false;
mpu_armv76.attributes   = "NonCached";
mpu_armv76.baseAddr     = 0x72000000;

mpu_armv77.$name        = "CONFIG_MPU_REGION6";
mpu_armv77.baseAddr     = 0x701D0000;
mpu_armv77.size         = 16;
mpu_armv77.allowExecute = false;
mpu_armv77.attributes   = "NonCached";

dma_trig_xbar1.$name = "CONFIG_DMA_TRIG_XBAR0";

dma_trig_xbar2.$name               = "CONFIG_DMA_TRIG_XBAR1";
dma_trig_xbar2.instance            = "DMA_TRIG_XBAR_EDMA_MODULE_1";
dma_trig_xbar2.xbarOutput          = "GPIO_INT_XBAR_GPIO_MUX_0";
dma_trig_xbar2.xbarConfig.$name    = "CONFIG_GPIO_INT_XBAR0";
dma_trig_xbar2.xbarConfig.instance = "GPIO_INT_XBAR_DMA_TRIG_XBAR_0";

dma_trig_xbar3.$name               = "CONFIG_DMA_TRIG_XBAR2";
dma_trig_xbar3.instance            = "DMA_TRIG_XBAR_EDMA_MODULE_2";
dma_trig_xbar3.xbarOutput          = "SOC_TIMESYNC_XBAR0_PR1_IEP0_CMP_INTR_REQ_4";
dma_trig_xbar3.xbarConfig.$name    = "CONFIG_SOC_TIMESYNC_XBAR00";
dma_trig_xbar3.xbarConfig.instance = "SOC_TIMESYNC_XBAR0_DMA_TRIG_XBAR_0";

dma_trig_xbar4.$name            = "CONFIG_DMA_TRIG_XBAR3";
dma_trig_xbar4.instance         = "DMA_TRIG_XBAR_EDMA_MODULE_3";
dma_trig_xbar4.xbarOutput       = "SOC_TIMESYNC_XBAR1_PR1_EDC0_SYNC_OUT_0";
dma_trig_xbar4.xbarConfig.$name = "CONFIG_SOC_TIMESYNC_XBAR10";

dma_trig_xbar5.$name                          = "CONFIG_DMA_TRIG_XBAR4";
dma_trig_xbar5.xbarOutput                     = "GPIO_INT_XBAR_GPIO_MUX_123###0";
dma_trig_xbar5.instance                       = "DMA_TRIG_XBAR_EDMA_MODULE_4";
dma_trig_xbar5.xbarConfig.$name               = "CONFIG_SOC_TIMESYNC_XBAR11";
dma_trig_xbar5.xbarConfig.instance            = "SOC_TIMESYNC_XBAR1_DMA_TRIG_XBAR_1";
dma_trig_xbar5.xbarConfig.xbarConfig.$name    = "CONFIG_GPIO_INT_XBAR1";
dma_trig_xbar5.xbarConfig.xbarConfig.instance = "GPIO_INT_XBAR_SOC_TIMESYNC_XBAR1_0";

dma_trig_xbar6.$name            = "CONFIG_DMA_TRIG_XBAR5";
dma_trig_xbar6.instance         = "DMA_TRIG_XBAR_EDMA_MODULE_5";
dma_trig_xbar6.xbarOutput       = "EPWM26_SOCA";
dma_trig_xbar6.xbarConfig.$name = "CONFIG_DMA_XBAR0";

icss_xbar1.$name      = "CONFIG_ICSS_XBAR0";
icss_xbar1.xbarOutput = "ICSS_XBAR_LIN3_INTR_REQ1";

icss_xbar2.$name            = "CONFIG_ICSS_XBAR1";
icss_xbar2.instance         = "ICSS_XBAR_ICSS_MODULE_1";
icss_xbar2.xbarOutput       = "GPIO_INT_XBAR_GPIO_MUX_67";
icss_xbar2.xbarConfig.$name = "CONFIG_GPIO_INT_XBAR2";

/**
 * Pinmux solution for unlocked pins/peripherals. This ensures that minor changes to the automatic solver in a future
 * version of the tool will not impact the pinmux you originally saw.  These lines can be completely deleted in order to
 * re-solve from scratch.
 */
debug_log.uartLog.UART.$suggestSolution = "UART0";
