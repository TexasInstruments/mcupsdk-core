/**
 * @cliArgs --device "AM64x" --package "ALV" --part "Default" --context "m4fss0-0" --product "MCU_PLUS_SDK@07.03.01"
 * @versions {"tool":"1.13.0+2553"}
 */

/**
 * Import the modules used in this configuration.
 */
const ipc             = scripting.addModule("/drivers/ipc/ipc");
const mcspi           = scripting.addModule("/drivers/mcspi/mcspi", {}, false);
const mcspi1          = mcspi.addInstance();
const addr_translate  = scripting.addModule("/kernel/dpl/addr_translate", {}, false);
const addr_translate1 = addr_translate.addInstance();
const addr_translate2 = addr_translate.addInstance();
const addr_translate3 = addr_translate.addInstance();
const addr_translate4 = addr_translate.addInstance();
const clock           = scripting.addModule("/kernel/dpl/clock");
const debug_log       = scripting.addModule("/kernel/dpl/debug_log");
const mpu_armv7       = scripting.addModule("/kernel/dpl/mpu_armv7", {}, false);
const mpu_armv71      = mpu_armv7.addInstance();
const mpu_armv72      = mpu_armv7.addInstance();
const timer           = scripting.addModule("/kernel/dpl/timer", {}, false);
const timer1          = timer.addInstance();

/**
 * Write custom configuration values to the imported modules.
 */
ipc.r5fss0_0 = "notify";
ipc.r5fss0_1 = "notify";
ipc.r5fss1_0 = "notify";
ipc.r5fss1_1 = "notify";
ipc.a53ss0_0 = "notify";

mcspi1.$name                 = "CONFIG_MCSPI0";
mcspi1.inputSelect           = "0";
mcspi1.MCU_SPI.$assign       = "MCU_SPI0";
mcspi1.mcspiChannel[0].$name = "CONFIG_MCSPI_CH0";

addr_translate1.$name     = "CONFIG_ADDR_TRANSLATE_REGION0";
addr_translate1.localAddr = 0x80000000;

addr_translate2.$name      = "CONFIG_ADDR_TRANSLATE_REGION1";
addr_translate2.systemAddr = 0x20000000;
addr_translate2.localAddr  = 0xA0000000;

addr_translate3.$name      = "CONFIG_ADDR_TRANSLATE_REGION2";
addr_translate3.systemAddr = 0x40000000;
addr_translate3.localAddr  = 0xC0000000;

addr_translate4.$name      = "CONFIG_ADDR_TRANSLATE_REGION3";
addr_translate4.systemAddr = 0x60000000;
addr_translate4.localAddr  = 0x60000000;

debug_log.enableUartLog                = true;
debug_log.uartLog.$name                = "CONFIG_UART_CONSOLE";
debug_log.uartLog.MCU_UART.$assign     = "MCU_USART0";
debug_log.uartLog.MCU_UART.RXD.$assign = "ball.A9";
debug_log.uartLog.MCU_UART.TXD.$assign = "ball.A8";

mpu_armv71.$name        = "CONFIG_MPU_REGION0";
mpu_armv71.attributes   = "Device";
mpu_armv71.allowExecute = false;

mpu_armv72.$name = "CONFIG_MPU_REGION1";
mpu_armv72.size  = 18;

timer1.$name             = "CONFIG_TIMER_ESM_TEST_Pin";
timer1.enableOneShotMode = true;
timer1.usecPerTick       = 10000;
timer1.MCU_TIMER.$assign = "MCU_DMTIMER1";
