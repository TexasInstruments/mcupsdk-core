/**
 * @cliArgs --device "AM263x_beta" --package "ZCZ" --part "AM263x" --context "r5fss0-0" --product "MCU_PLUS_SDK@07.03.01"
 * @versions {"tool":"1.15.0+2826"}
 */

/**
 * Import the modules used in this configuration.
 */
const edma           = scripting.addModule("/drivers/edma/edma", {}, false);
const edma1          = edma.addInstance();
const debug_log      = scripting.addModule("/kernel/dpl/debug_log");
const mpu_armv7      = scripting.addModule("/kernel/dpl/mpu_armv7", {}, false);
const mpu_armv71     = mpu_armv7.addInstance();
const mpu_armv72     = mpu_armv7.addInstance();
const mpu_armv73     = mpu_armv7.addInstance();
const mpu_armv74     = mpu_armv7.addInstance();
const mpu_armv75     = mpu_armv7.addInstance();
const mpu_armv76     = mpu_armv7.addInstance();
const dma_trig_xbar  = scripting.addModule("/xbar/dma_trig_xbar/dma_trig_xbar", {}, false);
const dma_trig_xbar1 = dma_trig_xbar.addInstance();
const dma_trig_xbar2 = dma_trig_xbar.addInstance();
const dma_trig_xbar3 = dma_trig_xbar.addInstance();
const dma_trig_xbar4 = dma_trig_xbar.addInstance();

/**
 * Write custom configuration values to the imported modules.
 */
edma1.$name                 = "CONFIG_EDMA0";
edma1.edmaRmDmaCh[0].$name  = "CONFIG_EDMA_RM0";
edma1.edmaRmQdmaCh[0].$name = "CONFIG_EDMA_RM1";
edma1.edmaRmTcc[0].$name    = "CONFIG_EDMA_RM2";
edma1.edmaRmParam[0].$name  = "CONFIG_EDMA_RM3";

debug_log.enableSharedMemLog = true;

mpu_armv71.$name             = "CONFIG_MPU_REGION0";
mpu_armv71.size              = 31;
mpu_armv71.attributes        = "Device";
mpu_armv71.accessPermissions = "Supervisor RD+WR, User RD";
mpu_armv71.allowExecute      = false;

mpu_armv72.$name             = "CONFIG_MPU_REGION1";
mpu_armv72.size              = 15;
mpu_armv72.accessPermissions = "Supervisor RD+WR, User RD";

mpu_armv73.$name             = "CONFIG_MPU_REGION2";
mpu_armv73.baseAddr          = 0x80000;
mpu_armv73.size              = 15;
mpu_armv73.accessPermissions = "Supervisor RD+WR, User RD";

mpu_armv74.$name             = "CONFIG_MPU_REGION3";
mpu_armv74.accessPermissions = "Supervisor RD+WR, User RD";
mpu_armv74.baseAddr          = 0x70000000;
mpu_armv74.size              = 21;

mpu_armv75.$name        = "CONFIG_MPU_REGION4";
mpu_armv75.baseAddr     = 0x50D00000;
mpu_armv75.size         = 14;
mpu_armv75.allowExecute = false;
mpu_armv75.attributes   = "Device";

mpu_armv76.$name        = "CONFIG_MPU_REGION5";
mpu_armv76.baseAddr     = 0x72000000;
mpu_armv76.size         = 14;
mpu_armv76.attributes   = "NonCached";
mpu_armv76.allowExecute = false;

dma_trig_xbar1.$name      = "CONFIG_DMA_TRIG_XBAR0";
dma_trig_xbar1.xbarOutput = "DMA_TRIG_XBAR_MCRC_DMA_EVENT_0";

dma_trig_xbar2.$name      = "CONFIG_DMA_TRIG_XBAR1";
dma_trig_xbar2.xbarOutput = "DMA_TRIG_XBAR_MCRC_DMA_EVENT_1";
dma_trig_xbar2.instance   = "DMA_TRIG_XBAR_EDMA_MODULE_1";

dma_trig_xbar3.$name      = "CONFIG_DMA_TRIG_XBAR2";
dma_trig_xbar3.xbarOutput = "DMA_TRIG_XBAR_MCRC_DMA_EVENT_2";
dma_trig_xbar3.instance   = "DMA_TRIG_XBAR_EDMA_MODULE_2";

dma_trig_xbar4.$name      = "CONFIG_DMA_TRIG_XBAR3";
dma_trig_xbar4.xbarOutput = "DMA_TRIG_XBAR_MCRC_DMA_EVENT_3";
dma_trig_xbar4.instance   = "DMA_TRIG_XBAR_EDMA_MODULE_3";
