/**
 * @cliArgs --device "AM263x_beta" --package "ZCZ" --part "AM263x" --context "r5fss0-0" --product "MCU_PLUS_SDK@07.03.01"
 * @versions {"tool":"1.12.0+2406"}
 */

/**
 * Import the modules used in this configuration.
 */
const ethphy     = scripting.addModule("/board/ethphy/ethphy", {}, false);
const ethphy1    = ethphy.addInstance();
const ethphy2    = ethphy.addInstance();
const gpio       = scripting.addModule("/drivers/gpio/gpio", {}, false);
const gpio1      = gpio.addInstance();
const pruicss    = scripting.addModule("/drivers/pruicss/pruicss", {}, false);
const pruicss1   = pruicss.addInstance();
const debug_log  = scripting.addModule("/kernel/dpl/debug_log");
const mpu_armv7  = scripting.addModule("/kernel/dpl/mpu_armv7", {}, false);
const mpu_armv71 = mpu_armv7.addInstance();
const mpu_armv72 = mpu_armv7.addInstance();
const mpu_armv73 = mpu_armv7.addInstance();
const mpu_armv74 = mpu_armv7.addInstance();
const mpu_armv75 = mpu_armv7.addInstance();
const mpu_armv76 = mpu_armv7.addInstance();
const mpu_armv77 = mpu_armv7.addInstance();
const icss_emac  = scripting.addModule("/networking/icss_emac/icss_emac", {}, false);
const icss_emac1 = icss_emac.addInstance();
const icss_emac2 = icss_emac.addInstance();

/**
 * Write custom configuration values to the imported modules.
 */
ethphy1.$name    = "CONFIG_ETHPHY0";
ethphy1.mdioPort = 12;

ethphy2.$name    = "CONFIG_ETHPHY1";
ethphy2.mdioPort = 3;

gpio1.$name                = "CONFIG_GPIO0";
gpio1.pinDir               = "OUTPUT";
gpio1.GPIO.gpioPin.$assign = "ball.D17";

pruicss1.$name = "CONFIG_PRU_ICSS1";

mpu_armv71.$name             = "CONFIG_MPU_REGION0";
mpu_armv71.size              = 31;
mpu_armv71.attributes        = "Device";
mpu_armv71.accessPermissions = "Supervisor RD+WR, User RD";
mpu_armv71.allowExecute      = false;

mpu_armv72.$name             = "CONFIG_MPU_REGION1";
mpu_armv72.size              = 15;
mpu_armv72.accessPermissions = "Supervisor RD+WR, User RD";

mpu_armv73.$name             = "CONFIG_MPU_REGION2";
mpu_armv73.baseAddr          = 0x80000;
mpu_armv73.size              = 15;
mpu_armv73.accessPermissions = "Supervisor RD+WR, User RD";

mpu_armv74.$name             = "CONFIG_MPU_REGION3";
mpu_armv74.accessPermissions = "Supervisor RD+WR, User RD";
mpu_armv74.baseAddr          = 0x70000000;
mpu_armv74.size              = 21;

mpu_armv75.$name        = "CONFIG_MPU_REGION4";
mpu_armv75.size         = 14;
mpu_armv75.baseAddr     = 0x50D00000;
mpu_armv75.allowExecute = false;
mpu_armv75.attributes   = "Device";

mpu_armv76.$name        = "CONFIG_MPU_REGION5";
mpu_armv76.size         = 14;
mpu_armv76.allowExecute = false;
mpu_armv76.attributes   = "NonCached";
mpu_armv76.baseAddr     = 0x72000000;

mpu_armv77.$name      = "CONFIG_MPU_REGION6";
mpu_armv77.baseAddr   = 0x70000000;
mpu_armv77.size       = 16;
mpu_armv77.attributes = "Cached+Sharable";

icss_emac1.$name            = "CONFIG_ICSS_EMAC0";
icss_emac1.mode             = "DUAL MAC | MAC1";
icss_emac1.phyAddr1         = 0;
icss_emac1.phyAddr0         = 12;
icss_emac1.linkTaskPriority = 12;
icss_emac1.rxTaskPriority   = 10;
icss_emac1.txTaskPriority   = 10;

icss_emac2.$name            = "CONFIG_ICSS_EMAC1";
icss_emac2.mode             = "DUAL MAC | MAC2";
icss_emac2.phyAddr1         = 0;
icss_emac2.phyAddr0         = 3;
icss_emac2.linkTaskPriority = 12;
icss_emac2.rxTaskPriority   = 10;
icss_emac2.txTaskPriority   = 10;

/**
 * Pinmux solution for unlocked pins/peripherals. This ensures that minor changes to the automatic solver in a future
 * version of the tool will not impact the pinmux you originally saw.  These lines can be completely deleted in order to
 * re-solve from scratch.
 */
gpio1.GPIO.$suggestSolution = "GPIO0";
