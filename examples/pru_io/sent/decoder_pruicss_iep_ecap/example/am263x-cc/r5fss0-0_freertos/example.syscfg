/**
 * @cliArgs --device "AM263x_beta" --package "ZCZ" --part "AM263x" --context "r5fss0-0" --product "MCU_PLUS_SDK@07.03.01"
 * @versions {"tool":"1.20.0+3587"}
 */

/**
 * Import the modules used in this configuration.
 */
const gpio                = scripting.addModule("/drivers/gpio/gpio", {}, false);
const gpio1               = gpio.addInstance();
const gpio2               = gpio.addInstance();
const gpio3               = gpio.addInstance();
const gpio4               = gpio.addInstance();
const gpio5               = gpio.addInstance();
const gpio6               = gpio.addInstance();
const i2c                 = scripting.addModule("/drivers/i2c/i2c", {}, false);
const i2c1                = i2c.addInstance();
const pruicss             = scripting.addModule("/drivers/pruicss/pruicss", {}, false);
const pruicss1            = pruicss.addInstance();
const debug_log           = scripting.addModule("/kernel/dpl/debug_log");
const dpl_cfg = scripting.addModule("/kernel/dpl/dpl_cfg");
const mpu_armv7           = scripting.addModule("/kernel/dpl/mpu_armv7", {}, false);
const mpu_armv71          = mpu_armv7.addInstance();
const mpu_armv72          = mpu_armv7.addInstance();
const mpu_armv73          = mpu_armv7.addInstance();
const mpu_armv74          = mpu_armv7.addInstance();
const mpu_armv75          = mpu_armv7.addInstance();
const mpu_armv76          = mpu_armv7.addInstance();
const default_linker      = scripting.addModule("/memory_configurator/default_linker", {}, false);
const default_linker1     = default_linker.addInstance();
const general             = scripting.addModule("/memory_configurator/general", {}, false);
const general1            = general.addInstance();
const region              = scripting.addModule("/memory_configurator/region", {}, false);
const region1             = region.addInstance();
const section             = scripting.addModule("/memory_configurator/section", {}, false);
const section1            = section.addInstance();
const section2            = section.addInstance();
const section3            = section.addInstance();
const section4            = section.addInstance();
const section5            = section.addInstance();
const section6            = section.addInstance();
const section7            = section.addInstance();
const section8            = section.addInstance();
const section9            = section.addInstance();
const section10           = section.addInstance();
const section11           = section.addInstance();
const section12           = section.addInstance();
const soc_timesync_xbar1  = scripting.addModule("/xbar/soc_timesync_xbar1/soc_timesync_xbar1", {}, false);
const soc_timesync_xbar11 = soc_timesync_xbar1.addInstance();
const soc_timesync_xbar12 = soc_timesync_xbar1.addInstance();
const soc_timesync_xbar13 = soc_timesync_xbar1.addInstance();
const soc_timesync_xbar14 = soc_timesync_xbar1.addInstance();
const soc_timesync_xbar15 = soc_timesync_xbar1.addInstance();
const soc_timesync_xbar16 = soc_timesync_xbar1.addInstance();

/**
 * Write custom configuration values to the imported modules.
 */
gpio1.$name          = "CHANNEL0_GPIO93";
gpio1.enableIntr     = true;
gpio1.trigType       = "FALL_EDGE";
gpio1.rx             = true;
gpio1.GPIO_n.$assign = "PR0_PRU0_GPIO0";

gpio2.$name          = "CHANNEL1_GPIO94";
gpio2.trigType       = "FALL_EDGE";
gpio2.enableIntr     = true;
gpio2.rx             = true;
gpio2.GPIO_n.$assign = "PR0_PRU0_GPIO1";

gpio3.$name          = "CHANNEL2_GPIO95";
gpio3.trigType       = "FALL_EDGE";
gpio3.enableIntr     = true;
gpio3.rx             = true;
gpio3.GPIO_n.$assign = "PR0_PRU0_GPIO2";

gpio4.$name          = "CHANNEL3_GPIO96";
gpio4.enableIntr     = true;
gpio4.trigType       = "FALL_EDGE";
gpio4.rx             = true;
gpio4.GPIO_n.$assign = "PR0_PRU0_GPIO3";

gpio5.$name          = "CHANNEL4_GPIO92";
gpio5.enableIntr     = true;
gpio5.trigType       = "FALL_EDGE";
gpio5.rx             = true;
gpio5.GPIO_n.$assign = "PR0_PRU0_GPIO4";

gpio6.$name          = "CHANNEL5_GPIO87";
gpio6.enableIntr     = true;
gpio6.trigType       = "FALL_EDGE";
gpio6.rx             = true;
gpio6.GPIO_n.$assign = "PR0_PRU0_GPIO5";

i2c1.$name           = "CONFIG_I2C2";
i2c1.I2C.$assign     = "I2C2";
i2c1.I2C.SCL.$assign = "UART0_RTSn";
i2c1.I2C.SDA.$assign = "UART0_CTSn";
i2c1.I2C_child.$name = "drivers_i2c_v1_i2c_v1_template0";

pruicss1.$name                           = "CONFIG_PRU_ICSS0";
pruicss1.AdditionalICSSSettings[0].$name = "CONFIG_PRU_ICSS_IO0";

debug_log.enableUartLog            = true;
debug_log.enableSharedMemLog       = true;
debug_log.enableSharedMemLogReader = true;
debug_log.enableCssLog             = false;
debug_log.uartLog.$name            = "CONFIG_UART0";
debug_log.uartLog.UART.$assign     = "UART0";
debug_log.uartLog.UART.RXD.$assign = "UART0_RXD";
debug_log.uartLog.UART.TXD.$assign = "UART0_TXD";
debug_log.uartLog.child.$name      = "drivers_uart_v2_uart_v2_template0";

mpu_armv71.$name             = "CONFIG_MPU_REGION0";
mpu_armv71.size              = 31;
mpu_armv71.attributes        = "Device";
mpu_armv71.accessPermissions = "Supervisor RD+WR, User RD";
mpu_armv71.allowExecute      = false;

mpu_armv72.$name             = "CONFIG_MPU_REGION1";
mpu_armv72.size              = 15;
mpu_armv72.accessPermissions = "Supervisor RD+WR, User RD";

mpu_armv73.$name             = "CONFIG_MPU_REGION2";
mpu_armv73.baseAddr          = 0x80000;
mpu_armv73.size              = 15;
mpu_armv73.accessPermissions = "Supervisor RD+WR, User RD";

mpu_armv74.$name             = "CONFIG_MPU_REGION3";
mpu_armv74.accessPermissions = "Supervisor RD+WR, User RD";
mpu_armv74.baseAddr          = 0x70000000;
mpu_armv74.size              = 21;

mpu_armv75.$name        = "CONFIG_MPU_REGION4";
mpu_armv75.size         = 14;
mpu_armv75.baseAddr     = 0x50D00000;
mpu_armv75.allowExecute = false;
mpu_armv75.attributes   = "Device";

mpu_armv76.$name        = "CONFIG_MPU_REGION5";
mpu_armv76.size         = 14;
mpu_armv76.allowExecute = false;
mpu_armv76.attributes   = "NonCached";
mpu_armv76.baseAddr     = 0x72000000;

default_linker1.$name = "memory_configurator_default_linker0";

general1.$name        = "CONFIG_GENERAL0";
general1.linker.$name = "TIARMCLANG0";

region1.$name                                = "MEMORY_REGION_CONFIGURATION0";
region1.memory_region.create(11);
region1.memory_region[0].type                = "TCMA";
region1.memory_region[0].$name               = "R5F_VECS";
region1.memory_region[0].size                = 0x40;
region1.memory_region[0].auto                = false;
region1.memory_region[1].type                = "TCMA";
region1.memory_region[1].$name               = "R5F_TCMA";
region1.memory_region[1].size                = 0x7FC0;
region1.memory_region[2].type                = "TCMB";
region1.memory_region[2].size                = 0x8000;
region1.memory_region[2].$name               = "R5F_TCMB";
region1.memory_region[3].$name               = "SBL";
region1.memory_region[3].auto                = false;
region1.memory_region[3].size                = 0x40000;
region1.memory_region[4].$name               = "OCRAM";
region1.memory_region[4].auto                = false;
region1.memory_region[4].manualStartAddress  = 0x70040000;
region1.memory_region[4].size                = 0x40000;
region1.memory_region[5].type                = "FLASH";
region1.memory_region[5].auto                = false;
region1.memory_region[5].size                = 0x80000;
region1.memory_region[5].$name               = "FLASH";
region1.memory_region[6].$name               = "USER_SHM_MEM";
region1.memory_region[6].auto                = false;
region1.memory_region[6].manualStartAddress  = 0x701D0000;
region1.memory_region[6].size                = 0x4000;
region1.memory_region[6].isShared            = true;
region1.memory_region[6].shared_cores        = ["r5fss0-1","r5fss1-0","r5fss1-1"];
region1.memory_region[7].$name               = "LOG_SHM_MEM";
region1.memory_region[7].auto                = false;
region1.memory_region[7].manualStartAddress  = 0x701D4000;
region1.memory_region[7].size                = 0x4000;
region1.memory_region[7].isShared            = true;
region1.memory_region[7].shared_cores        = ["r5fss0-1","r5fss1-0","r5fss1-1"];
region1.memory_region[8].type                = "CUSTOM";
region1.memory_region[8].$name               = "RTOS_NORTOS_IPC_SHM_MEM";
region1.memory_region[8].auto                = false;
region1.memory_region[8].manualStartAddress  = 0x72000000;
region1.memory_region[8].size                = 0x3E80;
region1.memory_region[8].isShared            = true;
region1.memory_region[8].shared_cores        = ["r5fss0-1","r5fss1-0","r5fss1-1"];
region1.memory_region[9].type                = "CUSTOM";
region1.memory_region[9].$name               = "MAILBOX_HSM";
region1.memory_region[9].auto                = false;
region1.memory_region[9].manualStartAddress  = 0x44000000;
region1.memory_region[9].size                = 0x3CE;
region1.memory_region[9].isShared            = true;
region1.memory_region[9].shared_cores        = ["r5fss0-1","r5fss1-0","r5fss1-1"];
region1.memory_region[10].type               = "CUSTOM";
region1.memory_region[10].$name              = "MAILBOX_R5F";
region1.memory_region[10].auto               = false;
region1.memory_region[10].manualStartAddress = 0x44000400;
region1.memory_region[10].size               = 0x3CE;
region1.memory_region[10].isShared           = true;
region1.memory_region[10].shared_cores       = ["r5fss0-1","r5fss1-0","r5fss1-1"];

section1.load_memory                  = "R5F_VECS";
section1.group                        = false;
section1.$name                        = "Vector Table";
section1.output_section.create(1);
section1.output_section[0].$name      = ".vectors";
section1.output_section[0].palignment = true;

section2.load_memory                  = "OCRAM";
section2.$name                        = "Text Segments";
section2.output_section.create(5);
section2.output_section[0].$name      = ".text.hwi";
section2.output_section[0].palignment = true;
section2.output_section[1].$name      = ".text.cache";
section2.output_section[1].palignment = true;
section2.output_section[2].$name      = ".text.mpu";
section2.output_section[2].palignment = true;
section2.output_section[3].$name      = ".text.boot";
section2.output_section[3].palignment = true;
section2.output_section[4].$name      = ".text:abort";
section2.output_section[4].palignment = true;

section3.load_memory                  = "OCRAM";
section3.$name                        = "Code and Read-Only Data";
section3.output_section.create(2);
section3.output_section[0].$name      = ".text";
section3.output_section[0].palignment = true;
section3.output_section[1].$name      = ".rodata";
section3.output_section[1].palignment = true;

section4.load_memory                  = "OCRAM";
section4.$name                        = "Data Segment";
section4.output_section.create(1);
section4.output_section[0].$name      = ".data";
section4.output_section[0].palignment = true;

section5.load_memory                             = "OCRAM";
section5.$name                                   = "Memory Segments";
section5.output_section.create(3);
section5.output_section[0].$name                 = ".bss";
section5.output_section[0].output_sections_start = "__BSS_START";
section5.output_section[0].output_sections_end   = "__BSS_END";
section5.output_section[0].palignment            = true;
section5.output_section[1].$name                 = ".sysmem";
section5.output_section[1].palignment            = true;
section5.output_section[2].$name                 = ".stack";
section5.output_section[2].palignment            = true;

section6.load_memory                              = "OCRAM";
section6.$name                                    = "Stack Segments";
section6.output_section.create(5);
section6.output_section[0].$name                  = ".irqstack";
section6.output_section[0].output_sections_start  = "__IRQ_STACK_START";
section6.output_section[0].output_sections_end    = "__IRQ_STACK_END";
section6.output_section[0].input_section.create(1);
section6.output_section[0].input_section[0].$name = ". = . + __IRQ_STACK_SIZE;";
section6.output_section[1].$name                  = ".fiqstack";
section6.output_section[1].output_sections_start  = "__FIQ_STACK_START";
section6.output_section[1].output_sections_end    = "__FIQ_STACK_END";
section6.output_section[1].input_section.create(1);
section6.output_section[1].input_section[0].$name = ". = . + __FIQ_STACK_SIZE;";
section6.output_section[2].$name                  = ".svcstack";
section6.output_section[2].output_sections_start  = "__SVC_STACK_START";
section6.output_section[2].output_sections_end    = "__SVC_STACK_END";
section6.output_section[2].input_section.create(1);
section6.output_section[2].input_section[0].$name = ". = . + __SVC_STACK_SIZE;";
section6.output_section[3].$name                  = ".abortstack";
section6.output_section[3].output_sections_start  = "__ABORT_STACK_START";
section6.output_section[3].output_sections_end    = "__ABORT_STACK_END";
section6.output_section[3].input_section.create(1);
section6.output_section[3].input_section[0].$name = ". = . + __ABORT_STACK_SIZE;";
section6.output_section[4].$name                  = ".undefinedstack";
section6.output_section[4].output_sections_start  = "__UNDEFINED_STACK_START";
section6.output_section[4].output_sections_end    = "__UNDEFINED_STACK_END";
section6.output_section[4].input_section.create(1);
section6.output_section[4].input_section[0].$name = ". = . + __UNDEFINED_STACK_SIZE;";

section7.load_memory                  = "OCRAM";
section7.$name                        = "Initialization and Exception Handling";
section7.output_section.create(3);
section7.output_section[0].$name      = ".ARM.exidx";
section7.output_section[0].palignment = true;
section7.output_section[1].$name      = ".init_array";
section7.output_section[1].palignment = true;
section7.output_section[2].$name      = ".fini_array";
section7.output_section[2].palignment = true;

section8.load_memory                 = "USER_SHM_MEM";
section8.type                        = "NOLOAD";
section8.$name                       = "User Shared Memory";
section8.group                       = false;
section8.output_section.create(1);
section8.output_section[0].$name     = ".bss.user_shared_mem";
section8.output_section[0].alignment = 0;

section9.load_memory                 = "LOG_SHM_MEM";
section9.$name                       = "Log Shared Memory";
section9.group                       = false;
section9.type                        = "NOLOAD";
section9.output_section.create(1);
section9.output_section[0].$name     = ".bss.log_shared_mem";
section9.output_section[0].alignment = 0;

section10.load_memory                 = "RTOS_NORTOS_IPC_SHM_MEM";
section10.type                        = "NOLOAD";
section10.$name                       = "IPC Shared Memory";
section10.group                       = false;
section10.output_section.create(1);
section10.output_section[0].$name     = ".bss.ipc_vring_mem";
section10.output_section[0].alignment = 0;

section11.load_memory                 = "MAILBOX_HSM";
section11.type                        = "NOLOAD";
section11.$name                       = "SIPC HSM Queue Memory";
section11.group                       = false;
section11.output_section.create(1);
section11.output_section[0].$name     = ".bss.sipc_hsm_queue_mem";
section11.output_section[0].alignment = 0;

section12.load_memory                 = "MAILBOX_R5F";
section12.$name                       = "SIPC R5F Queue Memory";
section12.group                       = false;
section12.type                        = "NOLOAD";
section12.output_section.create(1);
section12.output_section[0].$name     = ".bss.sipc_secure_host_queue_mem";
section12.output_section[0].alignment = 0;

soc_timesync_xbar11.xbarOutput          = "GPIO_INT_XBAR_GPIO_MUX_93";
soc_timesync_xbar11.instance            = "SOC_TIMESYNC_XBAR1_ICSS_MODULE_2";
soc_timesync_xbar11.$name               = "CONFIG_GPIO93_SYNCEV10_CAP0";
soc_timesync_xbar11.xbarConfig.$name    = "CONFIG_GPIO_INT_XBAR0";
soc_timesync_xbar11.xbarConfig.instance = "GPIO_INT_XBAR_SOC_TIMESYNC_XBAR1_0";

soc_timesync_xbar12.xbarOutput          = "GPIO_INT_XBAR_GPIO_MUX_94";
soc_timesync_xbar12.instance            = "SOC_TIMESYNC_XBAR1_ICSS_MODULE_3";
soc_timesync_xbar12.$name               = "CONFIG_GPIO94_SYNCEV11_CAP1";
soc_timesync_xbar12.xbarConfig.$name    = "CONFIG_GPIO_INT_XBAR1";
soc_timesync_xbar12.xbarConfig.instance = "GPIO_INT_XBAR_SOC_TIMESYNC_XBAR1_1";

soc_timesync_xbar13.xbarOutput          = "GPIO_INT_XBAR_GPIO_MUX_95";
soc_timesync_xbar13.instance            = "SOC_TIMESYNC_XBAR1_ICSS_MODULE_4";
soc_timesync_xbar13.$name               = "CONFIG_GPIO95_SYNCEV12_CAP2";
soc_timesync_xbar13.xbarConfig.$name    = "CONFIG_GPIO_INT_XBAR2";
soc_timesync_xbar13.xbarConfig.instance = "GPIO_INT_XBAR_SOC_TIMESYNC_XBAR1_2";

soc_timesync_xbar14.xbarOutput          = "GPIO_INT_XBAR_GPIO_MUX_96";
soc_timesync_xbar14.instance            = "SOC_TIMESYNC_XBAR1_ICSS_MODULE_5";
soc_timesync_xbar14.$name               = "CONFIG_GPIO96_SYNCEV13_CAP3";
soc_timesync_xbar14.xbarConfig.$name    = "CONFIG_GPIO_INT_XBAR3";
soc_timesync_xbar14.xbarConfig.instance = "GPIO_INT_XBAR_SOC_TIMESYNC_XBAR1_3";

soc_timesync_xbar15.xbarOutput          = "GPIO_INT_XBAR_GPIO_MUX_92";
soc_timesync_xbar15.instance            = "SOC_TIMESYNC_XBAR1_ICSS_MODULE_6";
soc_timesync_xbar15.$name               = "CONFIG_GPIO92_SYNCEV14_CAP4";
soc_timesync_xbar15.xbarConfig.$name    = "CONFIG_GPIO_INT_XBAR4";
soc_timesync_xbar15.xbarConfig.instance = "GPIO_INT_XBAR_SOC_TIMESYNC_XBAR1_4";

soc_timesync_xbar16.xbarOutput          = "GPIO_INT_XBAR_GPIO_MUX_87";
soc_timesync_xbar16.instance            = "SOC_TIMESYNC_XBAR1_ICSS_MODULE_7";
soc_timesync_xbar16.$name               = "CONFIG_GPIO87_SYNCEV15_CAP5";
soc_timesync_xbar16.xbarConfig.$name    = "CONFIG_GPIO_INT_XBAR5";
soc_timesync_xbar16.xbarConfig.instance = "GPIO_INT_XBAR_SOC_TIMESYNC_XBAR1_5";
