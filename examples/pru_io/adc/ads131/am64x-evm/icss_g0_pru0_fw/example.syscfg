/**
 * These arguments were used when this file was generated. They will be automatically applied on subsequent loads
 * via the GUI or CLI. Run CLI with '--help' for additional information on how to override these arguments.
 * @cliArgs --device "AM64x" --package "ALV" --part "Default" --context "icss_g0_pru0" --product "MCU_PLUS_SDK@07.03.01"
 * @versions {"tool":"1.20.0+3587"}
 */

/**
 * Import the modules used in this configuration.
 */
const pru_ipc = scripting.addModule("/pru_io/pru_ipc/pru_ipc");
const adc  = scripting.addModule("/pru_io/adc/adc", {}, false);
const adc1 = adc.addInstance();
const pru_ipc1 = pru_ipc.addInstance();

/**
 * Write custom configuration values to the imported modules.
 */
pru_ipc1.$name = "CONFIG_PRU_IPC0";

adc1.$name              = "CONFIG_ADC0";
adc1.adcIC              = "ADS131M08";
adc1.adcConfig[0].$name = "CONFIG_ADS131_PINMUX0";
