/**
 * @cliArgs --device "AM273x" --package "ZCE" --part "Default" --context "c66ss0" --product "MCU_PLUS_SDK@07.03.01"
 * @versions {"tool":"1.8.1+1900","templates":null}
 */

/**
 * Import the modules used in this configuration.
 */
const cache_c6x = scripting.addModule("/kernel/dpl/cache_c6x");
const debug_log = scripting.addModule("/kernel/dpl/debug_log");

/**
 * Write custom configuration values to the imported modules.
 */
cache_c6x.marRegionConfig.create(2);
cache_c6x.marRegionConfig[0].$name    = "kernel_dpl_cache_c6x_mar0";
cache_c6x.marRegionConfig[0].baseAddr = 0xC5000000;
cache_c6x.marRegionConfig[1].$name    = "kernel_dpl_cache_c6x_mar1";
cache_c6x.marRegionConfig[1].baseAddr = 0x83000000;

debug_log.enableUartLog               = true;
debug_log.uartLog.$name               = "CONFIG_UART0";
debug_log.uartLog.DSS_UART.RX.$assign = "PAD_DD";
debug_log.uartLog.DSS_UART.TX.$assign = "PAD_DC";

/**
 * Pinmux solution for unlocked pins/peripherals. This ensures that minor changes to the automatic solver in a future
 * version of the tool will not impact the pinmux you originally saw.  These lines can be completely deleted in order to
 * re-solve from scratch.
 */
debug_log.uartLog.DSS_UART.$suggestSolution = "DSS_UARTA";
