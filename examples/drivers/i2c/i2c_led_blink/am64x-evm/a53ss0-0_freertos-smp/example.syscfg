/**
 * @cliArgs --device "AM64x" --package "ALV" --part "Default" --context "a53ss0-0" --product "MCU_PLUS_SDK@07.03.01"
 * @versions {"tool":"1.19.0+3426"}
 */

/**
 * Import the modules used in this configuration.
 */
const led        = scripting.addModule("/board/led/led", {}, false);
const led1       = led.addInstance();
const i2c        = scripting.addModule("/drivers/i2c/i2c", {}, false);
const i2c1       = i2c.addInstance();
const debug_log  = scripting.addModule("/kernel/dpl/debug_log");
const dpl_cfg = scripting.addModule("/kernel/dpl/dpl_cfg");
const mmu_armv8  = scripting.addModule("/kernel/dpl/mmu_armv8", {}, false);
const mmu_armv81 = mmu_armv8.addInstance();
const mmu_armv82 = mmu_armv8.addInstance();
const mmu_armv83 = mmu_armv8.addInstance();
const mmu_armv84 = mmu_armv8.addInstance();

/**
 * Write custom configuration values to the imported modules.
 */
led1.$name = "CONFIG_LED0";
led1.name  = "TPIC2810";

i2c1.$name            = "CONFIG_I2C0";
led1.peripheralDriver = i2c1;
i2c1.I2C.$assign      = "I2C1";
i2c1.I2C.SCL.$assign  = "I2C1_SCL";
i2c1.I2C.SDA.$assign  = "I2C1_SDA";
i2c1.I2C_child.$name  = "drivers_i2c_v0_i2c_v0_template0";

debug_log.enableUartLog        = true;
debug_log.enableCssLog         = false;
debug_log.uartLog.$name        = "CONFIG_UART_CONSOLE";
debug_log.uartLog.UART.$assign = "USART0";

const uart_v0_template  = scripting.addModule("/drivers/uart/v0/uart_v0_template", {}, false);
const uart_v0_template1 = uart_v0_template.addInstance({}, false);
uart_v0_template1.$name = "drivers_uart_v0_uart_v0_template0";
debug_log.uartLog.child = uart_v0_template1;

mmu_armv81.$name = "CONFIG_MMU_REGION0";
mmu_armv81.size  = 0x80000000;

mmu_armv82.$name     = "CONFIG_MMU_REGION1";
mmu_armv82.vAddr     = 0x70000000;
mmu_armv82.pAddr     = 0x70000000;
mmu_armv82.size      = 0x200000;
mmu_armv82.attribute = "MAIR7";

mmu_armv83.$name     = "CONFIG_MMU_REGION2";
mmu_armv83.vAddr     = 0x701D0000;
mmu_armv83.pAddr     = 0x701D0000;
mmu_armv83.size      = 0x10000;
mmu_armv83.attribute = "MAIR4";

mmu_armv84.$name     = "CONFIG_MMU_REGION3";
mmu_armv84.vAddr     = 0x80000000;
mmu_armv84.pAddr     = 0x80000000;
mmu_armv84.size      = 0x80000000;
mmu_armv84.attribute = "MAIR7";

/**
 * Pinmux solution for unlocked pins/peripherals. This ensures that minor changes to the automatic solver in a future
 * version of the tool will not impact the pinmux you originally saw.  These lines can be completely deleted in order to
 * re-solve from scratch.
 */
debug_log.uartLog.UART.RXD.$suggestSolution = "UART0_RXD";
debug_log.uartLog.UART.TXD.$suggestSolution = "UART0_TXD";
