/**
 * @cliArgs --device "AM261x_ZFG" --part "AM2612" --package "ZFG" --context "r5fss0-0" --product "MCU_PLUS_SDK@07.03.01"
 * @versions {"tool":"1.26.0+4407"}
 */

/**
 * Import the modules used in this configuration.
 */
const ioexp           = scripting.addModule("/board/ioexp/ioexp", {}, false);
const ioexp1          = ioexp.addInstance();
const edma            = scripting.addModule("/drivers/edma/edma", {}, false);
const edma1           = edma.addInstance();
const i2c             = scripting.addModule("/drivers/i2c/i2c", {}, false);
const i2c1            = i2c.addInstance();
const littlefs        = scripting.addModule("/fs/littlefs/littlefs", {}, false);
const littlefs1       = littlefs.addInstance();
const clock           = scripting.addModule("/kernel/dpl/clock");
const debug_log       = scripting.addModule("/kernel/dpl/debug_log");
const dpl_cfg         = scripting.addModule("/kernel/dpl/dpl_cfg");
const mpu_armv7       = scripting.addModule("/kernel/dpl/mpu_armv7", {}, false);
const mpu_armv71      = mpu_armv7.addInstance();
const mpu_armv72      = mpu_armv7.addInstance();
const mpu_armv73      = mpu_armv7.addInstance();
const mpu_armv74      = mpu_armv7.addInstance();
const mpu_armv75      = mpu_armv7.addInstance();
const default_linker  = scripting.addModule("/memory_configurator/default_linker", {}, false);
const default_linker1 = default_linker.addInstance();
const general         = scripting.addModule("/memory_configurator/general", {}, false);
const general1        = general.addInstance();
const region          = scripting.addModule("/memory_configurator/region", {}, false);
const region1         = region.addInstance();
const section         = scripting.addModule("/memory_configurator/section", {}, false);
const section1        = section.addInstance();
const section2        = section.addInstance();
const section3        = section.addInstance();
const section4        = section.addInstance();
const section5        = section.addInstance();
const section6        = section.addInstance();
const section7        = section.addInstance();
const section8        = section.addInstance();
const section9        = section.addInstance();
const section10       = section.addInstance();

/**
 * Write custom configuration values to the imported modules.
 */
ioexp1.$name = "CONFIG_IOEXP0";

const divider33       = system.clockTree["OSPI0_CLK_GCM_CLKDIV"];
divider33.divideValue = 2;

edma1.$name                 = "CONFIG_EDMA0";
edma1.edmaRmDmaCh[0].$name  = "CONFIG_EDMA_RM0";
edma1.edmaRmQdmaCh[0].$name = "CONFIG_EDMA_RM1";
edma1.edmaRmTcc[0].$name    = "CONFIG_EDMA_RM2";
edma1.edmaRmParam[0].$name  = "CONFIG_EDMA_RM3";

i2c1.$name              = "CONFIG_I2C0";
ioexp1.peripheralDriver = i2c1;
i2c1.I2C.$assign        = "I2C0";
i2c1.I2C.SCL.$assign    = "GPIO135";
i2c1.I2C.SDA.$assign    = "GPIO134";
i2c1.I2C_child.$name    = "drivers_i2c_v1_i2c_v1_template0";

littlefs1.$name                                                     = "CONFIG_LITTLEFS0";
littlefs1.flashOffset                                               = "0x400000";
littlefs1.peripheralDriver.$name                                    = "CONFIG_FLASH0";
littlefs1.peripheralDriver.protocol                                 = "1s_1s_1s";
littlefs1.peripheralDriver.addressByteSupport                       = "1";
littlefs1.peripheralDriver.enable4BAddr                             = false;
littlefs1.peripheralDriver.enableFlashReset                         = true;
littlefs1.peripheralDriver.peripheralDriver.$name                   = "CONFIG_OSPI0";
littlefs1.peripheralDriver.peripheralDriver.OSPI.$assign            = "OSPI0";
littlefs1.peripheralDriver.peripheralDriver.OSPI.CLK.$assign        = "GPIO10";
littlefs1.peripheralDriver.peripheralDriver.OSPI.CSn0.$assign       = "GPIO62";
littlefs1.peripheralDriver.peripheralDriver.OSPI.DQS.$assign        = "GPIO9";
littlefs1.peripheralDriver.peripheralDriver.OSPI.D7.$assign         = "GPIO68";
littlefs1.peripheralDriver.peripheralDriver.OSPI.D6.$assign         = "GPIO8";
littlefs1.peripheralDriver.peripheralDriver.OSPI.D5.$assign         = "GPIO67";
littlefs1.peripheralDriver.peripheralDriver.OSPI.D4.$assign         = "GPIO76";
littlefs1.peripheralDriver.peripheralDriver.OSPI.D3.$assign         = "GPIO69";
littlefs1.peripheralDriver.peripheralDriver.OSPI.D2.$assign         = "GPIO7";
littlefs1.peripheralDriver.peripheralDriver.OSPI.D1.$assign         = "GPIO70";
littlefs1.peripheralDriver.peripheralDriver.OSPI.D0.$assign         = "GPIO2";
littlefs1.peripheralDriver.peripheralDriver.OSPI.RESET_OUT0.$assign = "GPIO61";
littlefs1.peripheralDriver.peripheralDriver.child.$name             = "drivers_ospi_v0_ospi_v0_am261x_template0";

debug_log.enableUartLog            = true;
debug_log.uartLog.$name            = "CONFIG_UART_LOG";
debug_log.uartLog.UART.$assign     = "UART0";
debug_log.uartLog.UART.RXD.$assign = "GPIO27";
debug_log.uartLog.UART.TXD.$assign = "GPIO28";
debug_log.uartLog.child.$name      = "drivers_uart_v2_uart_v2_template0";

mpu_armv71.$name             = "CONFIG_MPU_REGION0";
mpu_armv71.size              = 31;
mpu_armv71.attributes        = "Device";
mpu_armv71.accessPermissions = "Supervisor RD+WR, User RD";
mpu_armv71.allowExecute      = false;

mpu_armv72.$name             = "CONFIG_MPU_REGION1";
mpu_armv72.size              = 15;
mpu_armv72.accessPermissions = "Supervisor RD+WR, User RD";

mpu_armv73.$name             = "CONFIG_MPU_REGION2";
mpu_armv73.baseAddr          = 0x41010000;
mpu_armv73.size              = 15;
mpu_armv73.accessPermissions = "Supervisor RD+WR, User RD";

mpu_armv74.$name             = "CONFIG_MPU_REGION3";
mpu_armv74.baseAddr          = 0x70000000;
mpu_armv74.size              = 21;
mpu_armv74.accessPermissions = "Supervisor RD+WR, User RD";

mpu_armv75.$name    = "CONFIG_MPU_REGION5";
mpu_armv75.baseAddr = 0x80000000;
mpu_armv75.size     = 31;

default_linker1.$name    = "memory_configurator_default_linker0";
default_linker1.compiler = "iar-arm";

general1.$name           = "CONFIG_GENERAL0";
general1.choose_compiler = "iar-arm";
general1.linker.$name    = "IARARM0";

region1.$name                                = "MEMORY_REGION_CONFIGURATION0";
region1.memory_region.create(11);
region1.memory_region[0].type                = "TCMA";
region1.memory_region[0].$name               = "R5F_VECS";
region1.memory_region[0].size                = 0x40;
region1.memory_region[0].auto                = false;
region1.memory_region[1].type                = "TCMA";
region1.memory_region[1].$name               = "R5F_TCMA";
region1.memory_region[1].size                = 0x7FC0;
region1.memory_region[2].type                = "TCMB";
region1.memory_region[2].size                = 0x8000;
region1.memory_region[2].$name               = "R5F_TCMB";
region1.memory_region[3].$name               = "SBL";
region1.memory_region[3].auto                = false;
region1.memory_region[3].size                = 0x40000;
region1.memory_region[4].$name               = "OCRAM";
region1.memory_region[4].auto                = false;
region1.memory_region[4].manualStartAddress  = 0x70040000;
region1.memory_region[4].size                = 0x40000;
region1.memory_region[5].type                = "FLASH";
region1.memory_region[5].auto                = false;
region1.memory_region[5].manualStartAddress  = 0x60100000;
region1.memory_region[5].size                = 0x80000;
region1.memory_region[5].$name               = "FLASH";
region1.memory_region[6].$name               = "USER_SHM_MEM";
region1.memory_region[6].auto                = false;
region1.memory_region[6].manualStartAddress  = 0x70150000;
region1.memory_region[6].size                = 0x4000;
region1.memory_region[6].isShared            = true;
region1.memory_region[6].shared_cores        = ["r5fss0-1"];
region1.memory_region[7].$name               = "LOG_SHM_MEM";
region1.memory_region[7].auto                = false;
region1.memory_region[7].manualStartAddress  = 0x70154000;
region1.memory_region[7].size                = 0x4000;
region1.memory_region[7].isShared            = true;
region1.memory_region[7].shared_cores        = ["r5fss0-1"];
region1.memory_region[8].type                = "CUSTOM";
region1.memory_region[8].$name               = "RTOS_NORTOS_IPC_SHM_MEM";
region1.memory_region[8].auto                = false;
region1.memory_region[8].manualStartAddress  = 0x72000000;
region1.memory_region[8].size                = 0x3E80;
region1.memory_region[8].isShared            = true;
region1.memory_region[8].shared_cores        = ["r5fss0-1"];
region1.memory_region[9].type                = "CUSTOM";
region1.memory_region[9].$name               = "MAILBOX_HSM";
region1.memory_region[9].auto                = false;
region1.memory_region[9].manualStartAddress  = 0x44000000;
region1.memory_region[9].size                = 0x3CE;
region1.memory_region[9].isShared            = true;
region1.memory_region[9].shared_cores        = ["r5fss0-1"];
region1.memory_region[10].type               = "CUSTOM";
region1.memory_region[10].$name              = "MAILBOX_R5F";
region1.memory_region[10].auto               = false;
region1.memory_region[10].manualStartAddress = 0x44000400;
region1.memory_region[10].size               = 0x3CE;
region1.memory_region[10].isShared           = true;
region1.memory_region[10].shared_cores       = ["r5fss0-1"];

section1.load_memory                  = "R5F_VECS";
section1.group                        = false;
section1.$name                        = "Vector Table";
section1.place_at_start               = true;
section1.output_section.create(1);
section1.output_section[0].$name      = ".intvec";
section1.output_section[0].palignment = true;

section2.load_memory                  = "OCRAM";
section2.$name                        = "Text Segments";
section2.output_section.create(6);
section2.output_section[0].$name      = ".text.hwi";
section2.output_section[0].palignment = true;
section2.output_section[1].$name      = ".text.cache";
section2.output_section[1].palignment = true;
section2.output_section[2].$name      = ".text.mpu";
section2.output_section[2].palignment = true;
section2.output_section[3].$name      = ".text.boot";
section2.output_section[3].palignment = true;
section2.output_section[4].$name      = ".text.abort";
section2.output_section[4].palignment = true;
section2.output_section[5].$name      = ".text.pmu";
section2.output_section[5].palignment = true;

section3.load_memory                  = "OCRAM";
section3.$name                        = "Code and Read-Only Data";
section3.output_section.create(4);
section3.output_section[0].$name      = ".text";
section3.output_section[0].palignment = true;
section3.output_section[1].$name      = ".rodata";
section3.output_section[1].palignment = true;
section3.output_section[2].$name      = ".rodata.cfg";
section3.output_section[2].palignment = true;
section3.output_section[3].$name      = ".iar.init_table";
section3.output_section[3].palignment = true;

section4.load_memory                             = "OCRAM";
section4.$name                                   = "Data & BSS Segment";
section4.output_section.create(3);
section4.output_section[0].$name                 = ".data";
section4.output_section[0].palignment            = true;
section4.output_section[1].$name                 = ".data.pmu";
section4.output_section[1].palignment            = true;
section4.output_section[2].$name                 = ".bss";
section4.output_section[2].output_sections_start = "__BSS_START";
section4.output_section[2].output_sections_end   = "__BSS_END";
section4.output_section[2].palignment            = true;

section5.load_memory = "OCRAM";
section5.$name       = "Stack Segments";
section5.type        = "STACK";

section6.load_memory                 = "USER_SHM_MEM";
section6.type                        = "NOLOAD";
section6.$name                       = "User Shared Memory";
section6.group                       = false;
section6.output_section.create(1);
section6.output_section[0].$name     = ".bss.user_shared_mem";
section6.output_section[0].alignment = 0;

section7.load_memory                 = "LOG_SHM_MEM";
section7.$name                       = "Log Shared Memory";
section7.group                       = false;
section7.type                        = "NOLOAD";
section7.output_section.create(1);
section7.output_section[0].$name     = ".bss.log_shared_mem";
section7.output_section[0].alignment = 0;

section8.load_memory                 = "RTOS_NORTOS_IPC_SHM_MEM";
section8.type                        = "NOLOAD";
section8.$name                       = "IPC Shared Memory";
section8.group                       = false;
section8.output_section.create(1);
section8.output_section[0].$name     = ".bss.ipc_vring_mem";
section8.output_section[0].alignment = 0;

section9.load_memory                 = "MAILBOX_HSM";
section9.type                        = "NOLOAD";
section9.$name                       = "SIPC HSM Queue Memory";
section9.group                       = false;
section9.output_section.create(1);
section9.output_section[0].$name     = ".bss.sipc_hsm_queue_mem";
section9.output_section[0].alignment = 0;

section10.load_memory                 = "MAILBOX_R5F";
section10.$name                       = "SIPC R5F Queue Memory";
section10.group                       = false;
section10.type                        = "NOLOAD";
section10.output_section.create(1);
section10.output_section[0].$name     = ".bss.sipc_secure_host_queue_mem";
section10.output_section[0].alignment = 0;
