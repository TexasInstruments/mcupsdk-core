/**
 * @cliArgs --device "AM263Px" --package "ZCZ_C" --part "AM263P1" --context "r5fss0-0" --product "MCU_PLUS_SDK@07.03.01"
 * @versions {"tool":"1.17.0+3128"}
 */

/**
 * Import the modules used in this configuration.
 */
const ospi       = scripting.addModule("/drivers/ospi/ospi", {}, false);
const ospi1      = ospi.addInstance();
const clock      = scripting.addModule("/kernel/dpl/clock");
const debug_log  = scripting.addModule("/kernel/dpl/debug_log");
const mpu_armv7  = scripting.addModule("/kernel/dpl/mpu_armv7", {}, false);
const mpu_armv71 = mpu_armv7.addInstance();
const mpu_armv72 = mpu_armv7.addInstance();
const mpu_armv73 = mpu_armv7.addInstance();
const mpu_armv74 = mpu_armv7.addInstance();
const mpu_armv75 = mpu_armv7.addInstance();

/**
 * Write custom configuration values to the imported modules.
 */
ospi1.$name        = "CONFIG_OSPI0";
ospi1.inputClkFreq = 80000000;

mpu_armv71.$name             = "CONFIG_MPU_REGION0";
mpu_armv71.size              = 31;
mpu_armv71.attributes        = "Device";
mpu_armv71.accessPermissions = "Supervisor RD+WR, User RD";
mpu_armv71.allowExecute      = false;

mpu_armv72.$name             = "CONFIG_MPU_REGION1";
mpu_armv72.size              = 15;
mpu_armv72.accessPermissions = "Supervisor RD+WR, User RD";

mpu_armv73.$name             = "CONFIG_MPU_REGION2";
mpu_armv73.baseAddr          = 0x41010000;
mpu_armv73.size              = 15;
mpu_armv73.accessPermissions = "Supervisor RD+WR, User RD";

mpu_armv74.$name             = "CONFIG_MPU_REGION3";
mpu_armv74.baseAddr          = 0x70000000;
mpu_armv74.size              = 21;
mpu_armv74.accessPermissions = "Supervisor RD+WR, User RD";

mpu_armv75.$name    = "CONFIG_MPU_REGION5";
mpu_armv75.baseAddr = 0x80000000;
mpu_armv75.size     = 31;

/**
 * Pinmux solution for unlocked pins/peripherals. This ensures that minor changes to the automatic solver in a future
 * version of the tool will not impact the pinmux you originally saw.  These lines can be completely deleted in order to
 * re-solve from scratch.
 */
ospi1.OSPI.$suggestSolution      = "OSPI0";
ospi1.OSPI.CLK.$suggestSolution  = "OSPI0_CLK";
ospi1.OSPI.CSn0.$suggestSolution = "OSPI0_CSn0";
ospi1.OSPI.DQS.$suggestSolution  = "UART1_TXD";
ospi1.OSPI.D7.$suggestSolution   = "EPWM12_B";
ospi1.OSPI.D6.$suggestSolution   = "MCAN1_RX";
ospi1.OSPI.D5.$suggestSolution   = "EPWM12_A";
ospi1.OSPI.D4.$suggestSolution   = "MCAN0_RX";
ospi1.OSPI.D3.$suggestSolution   = "OSPI0_D3";
ospi1.OSPI.D2.$suggestSolution   = "OSPI0_D2";
ospi1.OSPI.D1.$suggestSolution   = "OSPI0_D1";
ospi1.OSPI.D0.$suggestSolution   = "OSPI0_D0";
