/**
 * @cliArgs --device "AM65xx_SR2.0_beta" --package "ACD" --part "Default" --context "r5fss0-0" --product "MCU_PLUS_SDK@07.03.01"
 * @versions {"tool":"1.18.0+3266"}
 */

/**
 * Import the modules used in this configuration.
 */
const ospi       = scripting.addModule("/drivers/ospi/ospi", {}, false);
const ospi1      = ospi.addInstance();
const debug_log  = scripting.addModule("/kernel/dpl/debug_log");
const dpl_cfg    = scripting.addModule("/kernel/dpl/dpl_cfg");
const mpu_armv7  = scripting.addModule("/kernel/dpl/mpu_armv7", {}, false);
const mpu_armv71 = mpu_armv7.addInstance();
const mpu_armv72 = mpu_armv7.addInstance();
const mpu_armv73 = mpu_armv7.addInstance();
const mpu_armv74 = mpu_armv7.addInstance();
const mpu_armv75 = mpu_armv7.addInstance();
const mpu_armv76 = mpu_armv7.addInstance();

/**
 * Write custom configuration values to the imported modules.
 */
ospi1.$name = "CONFIG_OSPI0";

debug_log.enableUartLog                   = true;
debug_log.uartLog.$name                   = "CONFIG_UART0";
debug_log.uartLog.useMcuDomainPeripherals = true;
debug_log.uartLog.MCU_UART.$assign        = "MCU_USART0";
debug_log.uartLog.MCU_UART.RXD.$assign    = "MCU_OSPI1_D1";
debug_log.uartLog.MCU_UART.TXD.$assign    = "MCU_OSPI1_D2";

mpu_armv71.$name        = "CONFIG_MPU_REGION0";
mpu_armv71.size         = 31;
mpu_armv71.allowExecute = false;
mpu_armv71.attributes   = "Device";

mpu_armv72.$name = "CONFIG_MPU_REGION1";
mpu_armv72.size  = 15;

mpu_armv73.$name             = "CONFIG_MPU_REGION2";
mpu_armv73.baseAddr          = 0x41010000;
mpu_armv73.size              = 15;
mpu_armv73.allowExecute      = false;
mpu_armv73.accessPermissions = "Supervisor RD+WR, User RD";

mpu_armv74.$name      = "CONFIG_MPU_REGION3";
mpu_armv74.size       = 19;
mpu_armv74.baseAddr   = 0x41C00000;
mpu_armv74.attributes = "NonCached";

mpu_armv75.$name    = "CONFIG_MPU_REGION4";
mpu_armv75.baseAddr = 0x70000000;
mpu_armv75.size     = 21;

mpu_armv76.$name    = "CONFIG_MPU_REGION5";
mpu_armv76.baseAddr = 0x80000000;
mpu_armv76.size     = 31;

/**
 * Pinmux solution for unlocked pins/peripherals. This ensures that minor changes to the automatic solver in a future
 * version of the tool will not impact the pinmux you originally saw.  These lines can be completely deleted in order to
 * re-solve from scratch.
 */
ospi1.MCU_FSS0_OSPI.$suggestSolution      = "MCU_OSPI0";
ospi1.MCU_FSS0_OSPI.CLK.$suggestSolution  = "MCU_OSPI0_CLK";
ospi1.MCU_FSS0_OSPI.CSn0.$suggestSolution = "MCU_OSPI0_CSn0";
ospi1.MCU_FSS0_OSPI.DQS.$suggestSolution  = "MCU_OSPI0_DQS";
ospi1.MCU_FSS0_OSPI.D7.$suggestSolution   = "MCU_OSPI0_D7";
ospi1.MCU_FSS0_OSPI.D6.$suggestSolution   = "MCU_OSPI0_D6";
ospi1.MCU_FSS0_OSPI.D5.$suggestSolution   = "MCU_OSPI0_D5";
ospi1.MCU_FSS0_OSPI.D4.$suggestSolution   = "MCU_OSPI0_D4";
ospi1.MCU_FSS0_OSPI.D3.$suggestSolution   = "MCU_OSPI0_D3";
ospi1.MCU_FSS0_OSPI.D2.$suggestSolution   = "MCU_OSPI0_D2";
ospi1.MCU_FSS0_OSPI.D1.$suggestSolution   = "MCU_OSPI0_D1";
ospi1.MCU_FSS0_OSPI.D0.$suggestSolution   = "MCU_OSPI0_D0";
