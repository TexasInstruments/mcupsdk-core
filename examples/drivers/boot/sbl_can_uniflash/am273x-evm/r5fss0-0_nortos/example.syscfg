/**
 * @cliArgs --device "AM273x" --package "ZCE" --part "Default" --context "r5fss0-0" --product "MCU_PLUS_SDK@07.03.01"
 * @versions {"tool":"1.12.1+2446"}
 */

/**
 * Import the modules used in this configuration.
 */
const flash       = scripting.addModule("/board/flash/flash", {}, false);
const flash1      = flash.addInstance();
const bootloader  = scripting.addModule("/drivers/bootloader/bootloader", {}, false);
const bootloader1 = bootloader.addInstance();
const mcan       = scripting.addModule("/drivers/mcan/mcan", {}, false);
const mcan1      = mcan.addInstance();
const edma        = scripting.addModule("/drivers/edma/edma", {}, false);
const edma1       = edma.addInstance();
const hsmclient   = scripting.addModule("/drivers/hsmclient/hsmclient", {}, false);
const hsmclient1  = hsmclient.addInstance();
const clock       = scripting.addModule("/kernel/dpl/clock");
const debug_log   = scripting.addModule("/kernel/dpl/debug_log");
const mpu_armv7   = scripting.addModule("/kernel/dpl/mpu_armv7", {}, false);
const mpu_armv71  = mpu_armv7.addInstance();
const mpu_armv72  = mpu_armv7.addInstance();
const mpu_armv73  = mpu_armv7.addInstance();
const mpu_armv74  = mpu_armv7.addInstance();
const mpu_armv75  = mpu_armv7.addInstance();
const mpu_armv76  = mpu_armv7.addInstance();
const mpu_armv77  = mpu_armv7.addInstance();

/**
 * Write custom configuration values to the imported modules.
 */
bootloader1.$name          = "CONFIG_BOOTLOADER0";
bootloader1.appImageOffset = "0x000A0000";

hsmclient1.$name = "CONFIG_HSMCLIENT0";

mcan1.$name               = "CONFIG_MCAN0";
mcan1.MSS_MCAN.$assign    = "MSS_MCANA";
mcan1.MSS_MCAN.RX.$assign = "ball.B2";
mcan1.MSS_MCAN.TX.$assign = "ball.A2";

debug_log.enableUartLog               = true;
debug_log.uartLog.$name               = "CONFIG_UART_CONSOLE";
debug_log.uartLog.MSS_UART.$assign    = "MSS_UARTA";
debug_log.uartLog.MSS_UART.RX.$assign = "ball.U3";
debug_log.uartLog.MSS_UART.TX.$assign = "ball.W2";

flash1.$name                      = "CONFIG_FLASH0";
bootloader1.flashDriver           = flash1;
flash1.peripheralDriver.$name     = "CONFIG_QSPI0";
flash1.peripheralDriver.dmaEnable = true;

debug_log.enableUartLog               = true;
debug_log.enableCssLog                = false;
debug_log.uartLog.$name               = "CONFIG_UART0";
debug_log.uartLog.intrEnable          = "DISABLE";
debug_log.uartLog.MSS_UART.$assign    = "MSS_UARTA";
debug_log.uartLog.MSS_UART.RX.$assign = "ball.U3";
debug_log.uartLog.MSS_UART.TX.$assign = "ball.W2";

debug_log.uartLog.edmaConfig       = edma1;
edma1.$name                        = "CONFIG_EDMA0";
edma1.instance                     = "EDMA_MSS_A";
flash1.peripheralDriver.edmaConfig = edma1;
edma1.edmaRmDmaCh[0].resourceType  = scripting.forceWrite("ownDmaCh");
edma1.edmaRmDmaCh[0].$name         = "CONFIG_EDMA_RM0";
edma1.edmaRmQdmaCh[0].$name        = "CONFIG_EDMA_RM1";
edma1.edmaRmTcc[0].$name           = "CONFIG_EDMA_RM2";
edma1.edmaRmParam[0].$name         = "CONFIG_EDMA_RM3";
edma1.edmaRmReservedDmaCh[0].$name = "CONFIG_EDMA_RM4";

mpu_armv71.$name        = "CONFIG_MPU_REGION0";
mpu_armv71.attributes   = "Device";
mpu_armv71.allowExecute = false;

mpu_armv72.$name = "CONFIG_MPU_REGION1";
mpu_armv72.size  = 15;

mpu_armv73.$name    = "CONFIG_MPU_REGION2";
mpu_armv73.baseAddr = 0x80000;
mpu_armv73.size     = 15;

mpu_armv74.$name    = "CONFIG_MPU_REGION3";
mpu_armv74.baseAddr = 0x10200000;
mpu_armv74.size     = 20;

mpu_armv75.$name        = "CONFIG_MPU_REGION4";
mpu_armv75.baseAddr     = 0x102E0000;
mpu_armv75.size         = 16;
mpu_armv75.attributes   = "NonCached";
mpu_armv75.allowExecute = false;

mpu_armv76.$name    = "CONFIG_MPU_REGION5";
mpu_armv76.baseAddr = 0xC3000000;
mpu_armv76.size     = 14;

mpu_armv77.$name    = "CONFIG_MPU_REGION6";
mpu_armv77.size     = 14;
mpu_armv77.baseAddr = 0xC3800000;

/**
 * Pinmux solution for unlocked pins/peripherals. This ensures that minor changes to the automatic solver in a future
 * version of the tool will not impact the pinmux you originally saw.  These lines can be completely deleted in order to
 * re-solve from scratch.
 */
flash1.peripheralDriver.MSS_QSPI["0"].$suggestSolution = "ball.C2";
flash1.peripheralDriver.MSS_QSPI["1"].$suggestSolution = "ball.D2";
flash1.peripheralDriver.MSS_QSPI["2"].$suggestSolution = "ball.D1";
flash1.peripheralDriver.MSS_QSPI["3"].$suggestSolution = "ball.E2";
flash1.peripheralDriver.MSS_QSPI.$suggestSolution      = "MSS_QSPI0";
flash1.peripheralDriver.MSS_QSPI.CLK.$suggestSolution  = "ball.E1";
flash1.peripheralDriver.MSS_QSPI.CS.$suggestSolution   = "ball.F2";
