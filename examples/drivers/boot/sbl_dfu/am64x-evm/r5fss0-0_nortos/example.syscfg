/**
 * @cliArgs --device "AM64x" --package "ALV" --part "Default" --context "r5fss0-0" --product "MCU_PLUS_SDK@07.03.01"
 * @versions {"tool":"1.17.0+3128"}
 */

/**
 * Import the modules used in this configuration.
 */
const bootloader      = scripting.addModule("/drivers/bootloader/bootloader", {}, false);
const bootloader1     = bootloader.addInstance();
const debug_log       = scripting.addModule("/kernel/dpl/debug_log");
const dpl_cfg = scripting.addModule("/kernel/dpl/dpl_cfg");
const mpu_armv7       = scripting.addModule("/kernel/dpl/mpu_armv7", {}, false);
const mpu_armv71      = mpu_armv7.addInstance();
const mpu_armv72      = mpu_armv7.addInstance();
const mpu_armv73      = mpu_armv7.addInstance();
const mpu_armv74      = mpu_armv7.addInstance();
const mpu_armv75      = mpu_armv7.addInstance();
const mpu_armv76      = mpu_armv7.addInstance();
const default_linker  = scripting.addModule("/memory_configurator/default_linker", {}, false);
const default_linker1 = default_linker.addInstance();
const general         = scripting.addModule("/memory_configurator/general", {}, false);
const general1        = general.addInstance();
const region          = scripting.addModule("/memory_configurator/region", {}, false);
const region1         = region.addInstance();
const section         = scripting.addModule("/memory_configurator/section", {}, false);
const section1        = section.addInstance();
const section2        = section.addInstance();
const section3        = section.addInstance();
const section4        = section.addInstance();
const section5        = section.addInstance();
const section6        = section.addInstance();
const tinyusb         = scripting.addModule("/usb/tinyusb/tinyusb", {}, false);
const tinyusb1        = tinyusb.addInstance();

/**
 * Write custom configuration values to the imported modules.
 */
bootloader1.bootMedia = "MEM";
bootloader1.$name     = "CONFIG_BOOTLOADER_0";

debug_log.enableLogZoneInfo  = true;
debug_log.enableCssLog       = false;
debug_log.enableUartLog      = true;
debug_log.uartLog.$name      = "CONFIG_UART0";
debug_log.uartLog.intrEnable = "DISABLE";

mpu_armv71.$name             = "CONFIG_MPU_REGION0";
mpu_armv71.size              = 31;
mpu_armv71.attributes        = "Device";
mpu_armv71.accessPermissions = "Supervisor RD+WR, User RD";
mpu_armv71.allowExecute      = false;

mpu_armv72.$name             = "CONFIG_MPU_REGION1";
mpu_armv72.size              = 15;
mpu_armv72.accessPermissions = "Supervisor RD+WR, User RD";

mpu_armv73.$name             = "CONFIG_MPU_REGION2";
mpu_armv73.baseAddr          = 0x41010000;
mpu_armv73.size              = 15;
mpu_armv73.accessPermissions = "Supervisor RD+WR, User RD";

mpu_armv74.$name             = "CONFIG_MPU_REGION3";
mpu_armv74.accessPermissions = "Supervisor RD+WR, User RD";
mpu_armv74.baseAddr          = 0x70000000;
mpu_armv74.size              = 21;

mpu_armv75.$name    = "CONFIG_MPU_REGION4";
mpu_armv75.size     = 31;
mpu_armv75.baseAddr = 0x80000000;

mpu_armv76.$name        = "CONFIG_MPU_REGION5";
mpu_armv76.attributes   = "NonCached";
mpu_armv76.size         = 15;
mpu_armv76.allowExecute = false;
mpu_armv76.baseAddr     = 0x70050000;

default_linker1.$name = "memory_configurator_default_linker0";

general1.$name          = "CONFIG_GENERAL0";
general1.entry_point    = "-e_vectors_sbl";
general1.irq_stack_size = 4096;
general1.svc_stack_size = 256;
general1.linker.$name   = "TIARMCLANG0";

region1.$name                               = "MEMORY_REGION_CONFIGURATION0";
region1.memory_region.create(8);
region1.memory_region[0].type               = "TCMA_R5F";
region1.memory_region[0].$name              = "R5F_VECS";
region1.memory_region[0].size               = 0x40;
region1.memory_region[0].auto               = false;
region1.memory_region[1].type               = "TCMA_R5F";
region1.memory_region[1].$name              = "R5F_TCMA";
region1.memory_region[1].size               = 0x7FC0;
region1.memory_region[2].type               = "TCMB_R5F";
region1.memory_region[2].$name              = "R5F_TCMB0";
region1.memory_region[2].size               = 0x8000;
region1.memory_region[3].$name              = "MSRAM_VECS";
region1.memory_region[3].auto               = false;
region1.memory_region[3].size               = 0x100;
region1.memory_region[4].$name              = "MSRAM_0";
region1.memory_region[4].auto               = false;
region1.memory_region[4].manualStartAddress = 0x70000100;
region1.memory_region[4].size               = 0x4FF00;
region1.memory_region[5].$name              = "NON_CACHE_MEM";
region1.memory_region[5].auto               = false;
region1.memory_region[5].size               = 0x8000;
region1.memory_region[5].manualStartAddress = 0x70050000;
region1.memory_region[6].$name              = "MSRAM_1";
region1.memory_region[6].auto               = false;
region1.memory_region[6].manualStartAddress = 0x70058000;
region1.memory_region[6].size               = 0x28000;
region1.memory_region[7].$name              = "MSRAM_2";
region1.memory_region[7].auto               = false;
region1.memory_region[7].manualStartAddress = 0x70180000;
region1.memory_region[7].size               = 0x60000;

section1.$name                        = "Vector Table";
section1.group                        = false;
section1.load_memory                  = "MSRAM_VECS";
section1.output_section.create(1);
section1.output_section[0].$name      = ".vectors";
section1.output_section[0].palignment = true;

section2.$name                        = "Text Segments";
section2.load_memory                  = "MSRAM_0";
section2.output_section.create(7);
section2.output_section[0].palignment = true;
section2.output_section[0].$name      = ".text";
section2.output_section[1].palignment = true;
section2.output_section[1].$name      = ".text.hwi";
section2.output_section[2].palignment = true;
section2.output_section[2].$name      = ".text.cache";
section2.output_section[3].palignment = true;
section2.output_section[3].$name      = ".text.mpu";
section2.output_section[4].palignment = true;
section2.output_section[4].$name      = ".text.boot";
section2.output_section[5].$name      = ".data";
section2.output_section[5].palignment = true;
section2.output_section[6].$name      = ".rodata";
section2.output_section[6].palignment = true;

section3.$name                                   = "Memory Segments";
section3.group                                   = false;
section3.load_memory                             = "MSRAM_1";
section3.output_section.create(4);
section3.output_section[0].$name                 = ".bss";
section3.output_section[0].palignment            = true;
section3.output_section[0].output_sections_start = "__BSS_START";
section3.output_section[0].output_sections_end   = "__BSS_END";
section3.output_section[1].$name                 = ".bss._dfu_ctx";
section3.output_section[1].output_sections_start = "__DFU_CTX_START";
section3.output_section[1].output_sections_end   = "__DFU_CTX_END";
section3.output_section[2].$name                 = ".sysmem";
section3.output_section[2].palignment            = true;
section3.output_section[3].$name                 = ".stack";
section3.output_section[3].palignment            = true;

section4.$name                                    = "Stack Segments";
section4.load_memory                              = "MSRAM_1";
section4.output_section.create(5);
section4.output_section[0].$name                  = ".irqstack";
section4.output_section[0].output_sections_start  = "__IRQ_STACK_START";
section4.output_section[0].output_sections_end    = "__IRQ_STACK_END";
section4.output_section[0].input_section.create(1);
section4.output_section[0].input_section[0].$name = ". = . + __IRQ_STACK_SIZE;";
section4.output_section[1].$name                  = ".fiqstack";
section4.output_section[1].output_sections_start  = "__FIQ_STACK_START";
section4.output_section[1].output_sections_end    = "__FIQ_STACK_END";
section4.output_section[1].input_section.create(1);
section4.output_section[1].input_section[0].$name = ". = . + __FIQ_STACK_SIZE;";
section4.output_section[2].$name                  = ".svcstack";
section4.output_section[2].output_sections_start  = "__SVC_STACK_START";
section4.output_section[2].output_sections_end    = "__SVC_STACK_END";
section4.output_section[2].input_section.create(1);
section4.output_section[2].input_section[0].$name = ". = . + __SVC_STACK_SIZE;";
section4.output_section[3].$name                  = ".abortstack";
section4.output_section[3].output_sections_start  = "__ABORT_STACK_START";
section4.output_section[3].output_sections_end    = "__ABORT_STACK_END";
section4.output_section[3].input_section.create(1);
section4.output_section[3].input_section[0].$name = ". = . + __ABORT_STACK_SIZE;";
section4.output_section[4].$name                  = ".undefinedstack";
section4.output_section[4].output_sections_start  = "__UNDEFINED_STACK_START";
section4.output_section[4].output_sections_end    = "__UNDEFINED_STACK_END";
section4.output_section[4].input_section.create(1);
section4.output_section[4].input_section[0].$name = ". = . + __UNDEFINED_STACK_SIZE;";

section5.$name                       = "CONFIG_SECTION0";
section5.load_memory                 = "MSRAM_2";
section5.type                        = "NOLOAD";
section5.group                       = false;
section5.output_section.create(1);
section5.output_section[0].$name     = ".bss.filebuf";
section5.output_section[0].alignment = 0;

section6.$name                       = "CONFIG_SECTION1";
section6.load_memory                 = "NON_CACHE_MEM";
section6.group                       = false;
section6.type                        = "NOLOAD";
section6.output_section.create(1);
section6.output_section[0].$name     = ".bss.nocache";
section6.output_section[0].alignment = 0;

tinyusb1.$name = "CONFIG_TINYUSB0";

/**
 * Pinmux solution for unlocked pins/peripherals. This ensures that minor changes to the automatic solver in a future
 * version of the tool will not impact the pinmux you originally saw.  These lines can be completely deleted in order to
 * re-solve from scratch.
 */
debug_log.uartLog.UART.$suggestSolution     = "USART0";
debug_log.uartLog.UART.RXD.$suggestSolution = "UART0_RXD";
debug_log.uartLog.UART.TXD.$suggestSolution = "UART0_TXD";
tinyusb1.USB.$suggestSolution               = "USB0";
tinyusb1.USB.DRVVBUS.$suggestSolution       = "USB0_DRVVBUS";
