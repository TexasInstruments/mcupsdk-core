/**
 * @cliArgs --device "AM263Px" --package "ZCZ_C" --part "AM263P1" --context "r5fss0-0" --product "MCU_PLUS_SDK@07.03.01"
 * @versions {"tool":"1.17.0+3128"}
 */

/**
 * Import the modules used in this configuration.
 */
const flash       = scripting.addModule("/board/flash/flash", {}, false);
const flash1      = flash.addInstance();
const bootloader  = scripting.addModule("/drivers/bootloader/bootloader", {}, false);
const bootloader1 = bootloader.addInstance();
const hsmclient   = scripting.addModule("/drivers/hsmclient/hsmclient", {}, false);
const hsmclient1  = hsmclient.addInstance();
const debug_log   = scripting.addModule("/kernel/dpl/debug_log");
const mpu_armv7   = scripting.addModule("/kernel/dpl/mpu_armv7", {}, false);
const mpu_armv71  = mpu_armv7.addInstance();
const mpu_armv72  = mpu_armv7.addInstance();
const mpu_armv73  = mpu_armv7.addInstance();
const mpu_armv74  = mpu_armv7.addInstance();
const mpu_armv75  = mpu_armv7.addInstance();

/**
 * Write custom configuration values to the imported modules.
 */
bootloader1.$name          = "CONFIG_BOOTLOADER0";
bootloader1.appImageOffset = "0x00080000";

flash1.$name                            = "CONFIG_FLASH0";
bootloader1.flashDriver                 = flash1;
flash1.proto_isAddrReg                  = true;
flash1.proto_cmdRegRd                   = "0x85";
flash1.proto_cmdRegWr                   = "0x81";
flash1.proto_mask                       = "0xff";
flash1.dummy_isAddrReg                  = true;
flash1.dummy_cfgReg                     = "1";
flash1.dummy_cmdRegRd                   = "0x85";
flash1.dummy_cmdRegWr                   = "0x81";
flash1.strDtr_isAddrReg                 = true;
flash1.strDtr_cmdRegRd                  = "0x85";
flash1.strDtr_cmdRegWr                  = "0x81";
flash1.strDtr_mask                      = "255";
flash1.xspiWipRdCmd                     = "0x05";
flash1.strDtr_shift                     = 255;
flash1.proto_cfgReg                     = "0";
flash1.dummy_mask                       = "0xFF";
flash1.protocol                         = "8d_8d_8d";
flash1.proto_bitP                       = 231;
flash1.fourByteEnableSeq                = "0";
flash1.dummyClksCmd                     = 16;
flash1.dummyClksRd                      = 16;
flash1.dummy_bitP                       = 16;
flash1.peripheralDriver.$name           = "CONFIG_OSPI0";
flash1.peripheralDriver.dmaEnable       = true;
flash1.peripheralDriver.OSPI.D7.$assign = "MCAN1_TX";
flash1.peripheralDriver.OSPI.D5.$assign = "MCAN0_TX";

const edma                         = scripting.addModule("/drivers/edma/edma", {}, false);
const edma1                        = edma.addInstance({}, false);
edma1.$name                        = "CONFIG_EDMA0";
flash1.peripheralDriver.edmaDriver = edma1;
edma1.edmaRmDmaCh[0].$name         = "CONFIG_EDMA_RM0";
edma1.edmaRmQdmaCh[0].$name        = "CONFIG_EDMA_RM1";
edma1.edmaRmTcc[0].$name           = "CONFIG_EDMA_RM2";
edma1.edmaRmParam[0].$name         = "CONFIG_EDMA_RM3";

hsmclient1.$name = "CONFIG_HSMCLIENT0";

debug_log.enableUartLog            = true;
debug_log.uartLog.$name            = "CONFIG_UART0";
debug_log.uartLog.intrEnable       = "DISABLE";
debug_log.uartLog.UART.RXD.$assign = "UART0_RXD";
debug_log.uartLog.UART.TXD.$assign = "UART0_TXD";

mpu_armv71.$name             = "CONFIG_MPU_REGION0";
mpu_armv71.size              = 31;
mpu_armv71.attributes        = "Device";
mpu_armv71.accessPermissions = "Supervisor RD+WR, User RD";
mpu_armv71.allowExecute      = false;

mpu_armv72.$name             = "CONFIG_MPU_REGION1";
mpu_armv72.size              = 15;
mpu_armv72.accessPermissions = "Supervisor RD+WR, User RD";

mpu_armv73.$name             = "CONFIG_MPU_REGION2";
mpu_armv73.baseAddr          = 0x80000;
mpu_armv73.size              = 15;
mpu_armv73.accessPermissions = "Supervisor RD+WR, User RD";

mpu_armv74.$name             = "CONFIG_MPU_REGION3";
mpu_armv74.accessPermissions = "Supervisor RD+WR, User RD";
mpu_armv74.baseAddr          = 0x70000000;
mpu_armv74.size              = 21;
mpu_armv74.attributes        = "Cached+Sharable";

mpu_armv75.$name        = "CONFIG_MPU_REGION4";
mpu_armv75.allowExecute = false;
mpu_armv75.attributes   = "Device";
mpu_armv75.baseAddr     = 0xCE000000;
mpu_armv75.size         = 24;

/**
 * Pinmux solution for unlocked pins/peripherals. This ensures that minor changes to the automatic solver in a future
 * version of the tool will not impact the pinmux you originally saw.  These lines can be completely deleted in order to
 * re-solve from scratch.
 */
flash1.peripheralDriver.OSPI.$suggestSolution      = "OSPI0";
flash1.peripheralDriver.OSPI.CLK.$suggestSolution  = "OSPI0_CLK";
flash1.peripheralDriver.OSPI.CSn0.$suggestSolution = "OSPI0_CSn0";
flash1.peripheralDriver.OSPI.DQS.$suggestSolution  = "UART1_TXD";
flash1.peripheralDriver.OSPI.D6.$suggestSolution   = "MCAN1_RX";
flash1.peripheralDriver.OSPI.D4.$suggestSolution   = "MCAN0_RX";
flash1.peripheralDriver.OSPI.D3.$suggestSolution   = "OSPI0_D3";
flash1.peripheralDriver.OSPI.D2.$suggestSolution   = "OSPI0_D2";
flash1.peripheralDriver.OSPI.D1.$suggestSolution   = "OSPI0_D1";
flash1.peripheralDriver.OSPI.D0.$suggestSolution   = "OSPI0_D0";
debug_log.uartLog.UART.$suggestSolution            = "UART0";
