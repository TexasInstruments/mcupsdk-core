/**
 * @cliArgs --device "AM263x_beta" --package "ZCZ" --part "AM263x" --context "r5fss0-0" --product "MCU_PLUS_SDK@07.03.01"
 * @versions {"tool":"1.12.1+2446"}
 */

/**
 * Import the modules used in this configuration.
 */
const bootloader  = scripting.addModule("/drivers/bootloader/bootloader", {}, false);
const bootloader1 = bootloader.addInstance();
const hsmclient   = scripting.addModule("/drivers/hsmclient/hsmclient", {}, false);
const hsmclient1  = hsmclient.addInstance();
const clock       = scripting.addModule("/kernel/dpl/clock");
const debug_log   = scripting.addModule("/kernel/dpl/debug_log");
const mpu_armv7   = scripting.addModule("/kernel/dpl/mpu_armv7", {}, false);
const mpu_armv71  = mpu_armv7.addInstance();
const mpu_armv72  = mpu_armv7.addInstance();
const mpu_armv73  = mpu_armv7.addInstance();
const mpu_armv74  = mpu_armv7.addInstance();
const mpu_armv75  = mpu_armv7.addInstance();

/**
 * Write custom configuration values to the imported modules.
 */
bootloader1.$name     = "CONFIG_BOOTLOADER0";
bootloader1.bootMedia = "MEM";

hsmclient1.$name = "CONFIG_HSMCLIENT0";

debug_log.enableUartLog            = true;
debug_log.enableCssLog             = false;
debug_log.enableLogZoneInfo        = true;
debug_log.uartLog.$name            = "CONFIG_UART0";
debug_log.uartLog.intrEnable       = "DISABLE";
debug_log.uartLog.UART.$assign     = "UART0";
debug_log.uartLog.UART.RXD.$assign = "ball.A7";
debug_log.uartLog.UART.TXD.$assign = "ball.A6";

mpu_armv71.$name             = "CONFIG_MPU_REGION0";
mpu_armv71.size              = 31;
mpu_armv71.attributes        = "Device";
mpu_armv71.accessPermissions = "Supervisor RD+WR, User RD";
mpu_armv71.allowExecute      = false;

mpu_armv72.$name             = "CONFIG_MPU_REGION1";
mpu_armv72.size              = 15;
mpu_armv72.accessPermissions = "Supervisor RD+WR, User RD";

mpu_armv73.$name             = "CONFIG_MPU_REGION2";
mpu_armv73.baseAddr          = 0x80000;
mpu_armv73.size              = 15;
mpu_armv73.accessPermissions = "Supervisor RD+WR, User RD";

mpu_armv74.$name             = "CONFIG_MPU_REGION3";
mpu_armv74.accessPermissions = "Supervisor RD+WR, User RD";
mpu_armv74.baseAddr          = 0x70000000;
mpu_armv74.size              = 21;
mpu_armv74.attributes        = "Cached+Sharable";

mpu_armv75.$name        = "CONFIG_MPU_REGION4";
mpu_armv75.attributes   = "Device";
mpu_armv75.baseAddr     = 0xCE000000;
mpu_armv75.size         = 24;
mpu_armv75.allowExecute = false;
