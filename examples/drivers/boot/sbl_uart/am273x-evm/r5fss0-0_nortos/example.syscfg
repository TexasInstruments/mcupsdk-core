/**
 * These arguments were used when this file was generated. They will be automatically applied on subsequent loads
 * via the GUI or CLI. Run CLI with '--help' for additional information on how to override these arguments.
 * @cliArgs --device "AM273x" --package "ZCE" --part "Default" --context "r5fss0-0" --product "MCU_PLUS_SDK@07.03.01"
 * @versions {"tool":"1.13.0+2553"}
 */

/**
 * Import the modules used in this configuration.
 */
const flash       = scripting.addModule("/board/flash/flash", {}, false);
const flash1      = flash.addInstance();
const bootloader  = scripting.addModule("/drivers/bootloader/bootloader", {}, false);
const bootloader1 = bootloader.addInstance();
const edma        = scripting.addModule("/drivers/edma/edma", {}, false);
const edma1       = edma.addInstance();
const hsmclient   = scripting.addModule("/drivers/hsmclient/hsmclient", {}, false);
const hsmclient1  = hsmclient.addInstance();
const uart        = scripting.addModule("/drivers/uart/uart", {}, false);
const uart1       = uart.addInstance();
const clock       = scripting.addModule("/kernel/dpl/clock");
const debug_log   = scripting.addModule("/kernel/dpl/debug_log");
const mpu_armv7   = scripting.addModule("/kernel/dpl/mpu_armv7", {}, false);
const mpu_armv71  = mpu_armv7.addInstance();
const mpu_armv72  = mpu_armv7.addInstance();
const mpu_armv73  = mpu_armv7.addInstance();
const mpu_armv74  = mpu_armv7.addInstance();
const mpu_armv75  = mpu_armv7.addInstance();
const mpu_armv76  = mpu_armv7.addInstance();
const mpu_armv77  = mpu_armv7.addInstance();
const timer       = scripting.addModule("/kernel/dpl/timer", {}, false);
const timer1      = timer.addInstance();

/**
 * Write custom configuration values to the imported modules.
 */
flash1.$name                  = "CONFIG_FLASH0";
flash1.peripheralDriver.$name = "CONFIG_QSPI0";

bootloader1.appImageOffset = "0x000A0000";
bootloader1.$name          = "CONFIG_BOOTLOADER_0";
bootloader1.bootMedia      = "MEM";

hsmclient1.$name = "CONFIG_HSMCLIENT0";

uart1.$name               = "CONFIG_UART0";
uart1.intrEnable          = "DISABLE";
uart1.MSS_UART.RX.$assign = "ball.U3";
uart1.MSS_UART.TX.$assign = "ball.W2";

uart1.edmaConfig                   = edma1;
edma1.$name                        = "CONFIG_EDMA0";
edma1.instance                     = "EDMA_MSS_A";
flash1.peripheralDriver.edmaConfig = edma1;
edma1.edmaRmDmaCh[0].resourceType  = scripting.forceWrite("ownDmaCh");
edma1.edmaRmDmaCh[0].$name         = "CONFIG_EDMA_RM0";
edma1.edmaRmQdmaCh[0].$name        = "CONFIG_EDMA_RM1";
edma1.edmaRmTcc[0].$name           = "CONFIG_EDMA_RM2";
edma1.edmaRmParam[0].$name         = "CONFIG_EDMA_RM3";
edma1.edmaRmReservedDmaCh[0].$name = "CONFIG_EDMA_RM4";

debug_log.enableCssLog = false;

mpu_armv71.$name        = "CONFIG_MPU_REGION0";
mpu_armv71.attributes   = "Device";
mpu_armv71.allowExecute = false;

mpu_armv72.$name = "CONFIG_MPU_REGION1";
mpu_armv72.size  = 15;

mpu_armv73.$name    = "CONFIG_MPU_REGION2";
mpu_armv73.baseAddr = 0x80000;
mpu_armv73.size     = 15;

mpu_armv74.$name    = "CONFIG_MPU_REGION3";
mpu_armv74.baseAddr = 0x10200000;
mpu_armv74.size     = 20;

mpu_armv75.$name        = "CONFIG_MPU_REGION4";
mpu_armv75.baseAddr     = 0x102E0000;
mpu_armv75.size         = 16;
mpu_armv75.attributes   = "NonCached";
mpu_armv75.allowExecute = false;

mpu_armv76.$name    = "CONFIG_MPU_REGION5";
mpu_armv76.baseAddr = 0xC3000000;
mpu_armv76.size     = 14;

mpu_armv77.$name    = "CONFIG_MPU_REGION6";
mpu_armv77.size     = 14;
mpu_armv77.baseAddr = 0xC3800000;

timer1.$name = "CONFIG_TIMER0";

/**
 * Pinmux solution for unlocked pins/peripherals. This ensures that minor changes to the automatic solver in a future
 * version of the tool will not impact the pinmux you originally saw.  These lines can be completely deleted in order to
 * re-solve from scratch.
 */
flash1.peripheralDriver.MSS_QSPI["0"].$suggestSolution = "ball.C2";
flash1.peripheralDriver.MSS_QSPI["1"].$suggestSolution = "ball.D2";
flash1.peripheralDriver.MSS_QSPI["2"].$suggestSolution = "ball.D1";
flash1.peripheralDriver.MSS_QSPI["3"].$suggestSolution = "ball.E2";
flash1.peripheralDriver.MSS_QSPI.$suggestSolution      = "MSS_QSPI0";
flash1.peripheralDriver.MSS_QSPI.CLK.$suggestSolution  = "ball.E1";
flash1.peripheralDriver.MSS_QSPI.CS.$suggestSolution   = "ball.F2";
uart1.MSS_UART.$suggestSolution                        = "MSS_UARTA";
timer1.MSS_RTI.$suggestSolution                        = "MSS_RTIC";
