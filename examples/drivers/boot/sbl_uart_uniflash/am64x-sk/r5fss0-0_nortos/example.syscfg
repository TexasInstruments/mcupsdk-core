/**
 * @cliArgs --device "AM64x" --package "ALV" --part "Default" --context "r5fss0-0" --product "MCU_PLUS_SDK@07.03.01"
 * @versions {"tool":"1.17.0+3128"}
 */

/**
 * Import the modules used in this configuration.
 */
const flash       = scripting.addModule("/board/flash/flash", {}, false);
const flash1      = flash.addInstance();
const bootloader  = scripting.addModule("/drivers/bootloader/bootloader", {}, false);
const bootloader1 = bootloader.addInstance();
const ddr         = scripting.addModule("/drivers/ddr/ddr", {}, false);
const ddr1        = ddr.addInstance();
const mmcsd       = scripting.addModule("/drivers/mmcsd/mmcsd", {}, false);
const mmcsd1      = mmcsd.addInstance();
const uart        = scripting.addModule("/drivers/uart/uart", {}, false);
const uart1       = uart.addInstance();
const debug_log   = scripting.addModule("/kernel/dpl/debug_log");
const mpu_armv7   = scripting.addModule("/kernel/dpl/mpu_armv7", {}, false);
const mpu_armv71  = mpu_armv7.addInstance();
const mpu_armv72  = mpu_armv7.addInstance();
const mpu_armv73  = mpu_armv7.addInstance();
const mpu_armv74  = mpu_armv7.addInstance();
const mpu_armv75  = mpu_armv7.addInstance();

/**
 * Write custom configuration values to the imported modules.
 */
flash1.$name                      = "CONFIG_FLASH0";
flash1.peripheralDriver.$name     = "CONFIG_OSPI0";
flash1.peripheralDriver.dmaEnable = true;

bootloader1.$name     = "CONFIG_BOOTLOADER_MEM";
bootloader1.bootMedia = "MEM";

ddr1.$name                    = "CONFIG_DDR0";
ddr1.ddrConfigIncludeFileName = "drivers/ddr/v0/soc/am64x_am243x/board_lpddrReginit.h";

mmcsd1.$name          = "CONFIG_MMCSD0";
mmcsd1.moduleSelect   = "MMC0";
mmcsd1.cardType       = "NO_DEVICE";
mmcsd1.modeSelectEMMC = "SDR50";

uart1.$name        = "CONFIG_UART0";
uart1.intrEnable   = "DISABLE";
uart1.UART.$assign = "USART0";

const udma                         = scripting.addModule("/drivers/udma/udma", {}, false);
const udma1                        = udma.addInstance({}, false);
udma1.$name                        = "CONFIG_UDMA0";
flash1.peripheralDriver.udmaDriver = udma1;

debug_log.enableCssLog      = false;
debug_log.enableLogZoneInfo = true;

mpu_armv71.$name             = "CONFIG_MPU_REGION0";
mpu_armv71.size              = 31;
mpu_armv71.attributes        = "Device";
mpu_armv71.accessPermissions = "Supervisor RD+WR, User RD";
mpu_armv71.allowExecute      = false;

mpu_armv72.$name             = "CONFIG_MPU_REGION1";
mpu_armv72.size              = 15;
mpu_armv72.accessPermissions = "Supervisor RD+WR, User RD";

mpu_armv73.$name             = "CONFIG_MPU_REGION2";
mpu_armv73.baseAddr          = 0x41010000;
mpu_armv73.size              = 15;
mpu_armv73.accessPermissions = "Supervisor RD+WR, User RD";

mpu_armv74.$name             = "CONFIG_MPU_REGION3";
mpu_armv74.accessPermissions = "Supervisor RD+WR, User RD";
mpu_armv74.baseAddr          = 0x70000000;
mpu_armv74.size              = 21;

mpu_armv75.$name    = "CONFIG_MPU_REGION4";
mpu_armv75.baseAddr = 0x80000000;
mpu_armv75.size     = 31;

/**
 * Pinmux solution for unlocked pins/peripherals. This ensures that minor changes to the automatic solver in a future
 * version of the tool will not impact the pinmux you originally saw.  These lines can be completely deleted in order to
 * re-solve from scratch.
 */
flash1.peripheralDriver.OSPI.$suggestSolution      = "OSPI0";
flash1.peripheralDriver.OSPI.CLK.$suggestSolution  = "OSPI0_CLK";
flash1.peripheralDriver.OSPI.CSn0.$suggestSolution = "OSPI0_CSn0";
flash1.peripheralDriver.OSPI.DQS.$suggestSolution  = "OSPI0_DQS";
flash1.peripheralDriver.OSPI.D7.$suggestSolution   = "OSPI0_D7";
flash1.peripheralDriver.OSPI.D6.$suggestSolution   = "OSPI0_D6";
flash1.peripheralDriver.OSPI.D5.$suggestSolution   = "OSPI0_D5";
flash1.peripheralDriver.OSPI.D4.$suggestSolution   = "OSPI0_D4";
flash1.peripheralDriver.OSPI.D3.$suggestSolution   = "OSPI0_D3";
flash1.peripheralDriver.OSPI.D2.$suggestSolution   = "OSPI0_D2";
flash1.peripheralDriver.OSPI.D1.$suggestSolution   = "OSPI0_D1";
flash1.peripheralDriver.OSPI.D0.$suggestSolution   = "OSPI0_D0";
mmcsd1.MMC0.$suggestSolution                       = "MMC0";
uart1.UART.RXD.$suggestSolution                    = "UART0_RXD";
uart1.UART.TXD.$suggestSolution                    = "UART0_TXD";
