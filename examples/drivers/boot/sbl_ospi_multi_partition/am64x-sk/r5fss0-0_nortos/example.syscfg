/**
 * @cliArgs --device "AM64x_beta" --package "ALV" --part "Default" --context "r5fss0-0" --product "MCU_PLUS_SDK@07.03.01"
 * @versions {"tool":"1.12.1+2446"}
 */

/**
 * Import the modules used in this configuration.
 */
const bootloader  = scripting.addModule("/drivers/bootloader/bootloader", {}, false);
const bootloader1 = bootloader.addInstance();
const bootloader2 = bootloader.addInstance();
const bootloader3 = bootloader.addInstance();
const bootloader4 = bootloader.addInstance();
const bootloader5 = bootloader.addInstance();
const bootloader6 = bootloader.addInstance();
const ddr         = scripting.addModule("/drivers/ddr/ddr", {}, false);
const ddr1        = ddr.addInstance();
const debug_log   = scripting.addModule("/kernel/dpl/debug_log");
const mpu_armv7   = scripting.addModule("/kernel/dpl/mpu_armv7", {}, false);
const mpu_armv71  = mpu_armv7.addInstance();
const mpu_armv72  = mpu_armv7.addInstance();
const mpu_armv73  = mpu_armv7.addInstance();
const mpu_armv74  = mpu_armv7.addInstance();
const mpu_armv75  = mpu_armv7.addInstance();

/**
 * Write custom configuration values to the imported modules.
 */
bootloader1.appImageOffset      = "0x80000";
bootloader1.bootMedia           = "MEM";
bootloader1.appImageBaseAddress = "0x60080000";
bootloader1.$name               = "CONFIG_BOOTLOADER_FLASH_R5FSS0_0";

bootloader2.$name               = "CONFIG_BOOTLOADER_FLASH_R5FSS0_1";
bootloader2.appImageOffset      = "0x60100000";
bootloader2.bootMedia           = "MEM";
bootloader2.appImageBaseAddress = "0x60100000";

bootloader3.$name               = "CONFIG_BOOTLOADER_FLASH_R5FSS1_0";
bootloader3.appImageOffset      = "0x60180000";
bootloader3.bootMedia           = "MEM";
bootloader3.appImageBaseAddress = "0x60180000";

bootloader4.$name               = "CONFIG_BOOTLOADER_FLASH_R5FSS1_1";
bootloader4.appImageOffset      = "0x60200000";
bootloader4.bootMedia           = "MEM";
bootloader4.appImageBaseAddress = "0x60200000";

bootloader5.$name               = "CONFIG_BOOTLOADER_FLASH_M4FSS0_0";
bootloader5.appImageOffset      = "0x60280000";
bootloader5.bootMedia           = "MEM";
bootloader5.appImageBaseAddress = "0x60280000";

bootloader6.$name               = "CONFIG_BOOTLOADER_FLASH_A53SS0_0";
bootloader6.appImageOffset      = "0X60300000";
bootloader6.bootMedia           = "MEM";
bootloader6.appImageBaseAddress = "0X60300000";

ddr1.$name                    = "CONFIG_DDR0";
ddr1.ddrConfigIncludeFileName = "drivers/ddr/v0/soc/am64x_am243x/board_lpddrReginit.h";

debug_log.enableUartLog        = true;
debug_log.enableCssLog         = false;
debug_log.enableLogZoneInfo    = true;
debug_log.uartLog.$name        = "CONFIG_UART0";
debug_log.uartLog.intrEnable   = "DISABLE";
debug_log.uartLog.UART.$assign = "USART0";

mpu_armv71.$name             = "CONFIG_MPU_REGION0";
mpu_armv71.size              = 31;
mpu_armv71.attributes        = "Device";
mpu_armv71.accessPermissions = "Supervisor RD+WR, User RD";
mpu_armv71.allowExecute      = false;

mpu_armv72.$name             = "CONFIG_MPU_REGION1";
mpu_armv72.size              = 15;
mpu_armv72.accessPermissions = "Supervisor RD+WR, User RD";

mpu_armv73.$name             = "CONFIG_MPU_REGION2";
mpu_armv73.baseAddr          = 0x41010000;
mpu_armv73.size              = 15;
mpu_armv73.accessPermissions = "Supervisor RD+WR, User RD";

mpu_armv74.$name             = "CONFIG_MPU_REGION3";
mpu_armv74.accessPermissions = "Supervisor RD+WR, User RD";
mpu_armv74.baseAddr          = 0x70000000;
mpu_armv74.size              = 21;

mpu_armv75.$name    = "CONFIG_MPU_REGION4";
mpu_armv75.baseAddr = 0x80000000;
mpu_armv75.size     = 31;

/**
 * Pinmux solution for unlocked pins/peripherals. This ensures that minor changes to the automatic solver in a future
 * version of the tool will not impact the pinmux you originally saw.  These lines can be completely deleted in order to
 * re-solve from scratch.
 */
debug_log.uartLog.UART.RXD.$suggestSolution = "ball.D15";
debug_log.uartLog.UART.TXD.$suggestSolution = "ball.C16";
