/**
 * @cliArgs --device "AWR294X" --package "ETS" --part "Default" --context "r5fss0-0" --product "MCU_PLUS_SDK@07.03.01"
 * @versions {"tool":"1.18.0+3266"}
 */

/**
 * Import the modules used in this configuration.
 */
const bootloader  = scripting.addModule("/drivers/bootloader/bootloader", {}, false);
const bootloader1 = bootloader.addInstance();
const gpio        = scripting.addModule("/drivers/gpio/gpio", {}, false);
const gpio1       = gpio.addInstance();
const clock       = scripting.addModule("/kernel/dpl/clock");
const debug_log   = scripting.addModule("/kernel/dpl/debug_log");
const dpl_cfg = scripting.addModule("/kernel/dpl/dpl_cfg");
const mpu_armv7   = scripting.addModule("/kernel/dpl/mpu_armv7", {}, false);
const mpu_armv71  = mpu_armv7.addInstance();
const mpu_armv72  = mpu_armv7.addInstance();
const mpu_armv73  = mpu_armv7.addInstance();
const mpu_armv74  = mpu_armv7.addInstance();
const mpu_armv75  = mpu_armv7.addInstance();
const mpu_armv76  = mpu_armv7.addInstance();
const mpu_armv77  = mpu_armv7.addInstance();
const enet_cpsw   = scripting.addModule("/networking/enet_cpsw/enet_cpsw", {}, false);
const enet_cpsw1  = enet_cpsw.addInstance();

/**
 * Write custom configuration values to the imported modules.
 */
bootloader1.$name          = "CONFIG_BOOTLOADER0";
bootloader1.appImageOffset = "0x000A0000";

const flash                   = scripting.addModule("/board/flash/flash", {}, false);
const flash1                  = flash.addInstance({}, false);
flash1.$name                  = "CONFIG_FLASH0";
bootloader1.flashDriver       = flash1;
flash1.peripheralDriver.$name = "CONFIG_QSPI0";

gpio1.trigType             = "RISE_EDGE";
gpio1.$name                = "ENET_TRANSFER_START_BTN";
gpio1.GPIO.gpioPin.$assign = "PAD_BB";

debug_log.enableUartLog           = true;
debug_log.enableLogZoneInfo       = true;
debug_log.uartLog.$name           = "CONFIG_UART0";
debug_log.uartLog.UART.$assign    = "UARTA";
debug_log.uartLog.UART.RX.$assign = "PAD_DA";
debug_log.uartLog.UART.TX.$assign = "PAD_DB";

const edma                         = scripting.addModule("/drivers/edma/edma", {}, false);
const edma1                        = edma.addInstance({}, false);
debug_log.uartLog.edmaConfig       = edma1;
edma1.$name                        = "CONFIG_EDMA0";
flash1.peripheralDriver.edmaConfig = edma1;
edma1.edmaRmDmaCh[0].$name         = "CONFIG_EDMA_RM0";
edma1.edmaRmQdmaCh[0].$name        = "CONFIG_EDMA_RM1";
edma1.edmaRmTcc[0].$name           = "CONFIG_EDMA_RM2";
edma1.edmaRmParam[0].$name         = "CONFIG_EDMA_RM3";
edma1.edmaRmReservedDmaCh[0].$name = "CONFIG_EDMA_RM4";

mpu_armv71.$name        = "CONFIG_MPU_REGION0";
mpu_armv71.attributes   = "Device";
mpu_armv71.allowExecute = false;

mpu_armv72.$name = "CONFIG_MPU_REGION1";
mpu_armv72.size  = 14;

mpu_armv73.$name    = "CONFIG_MPU_REGION2";
mpu_armv73.baseAddr = 0x80000;
mpu_armv73.size     = 14;

mpu_armv74.$name    = "CONFIG_MPU_REGION3";
mpu_armv74.baseAddr = 0x10200000;
mpu_armv74.size     = 20;

mpu_armv75.$name    = "CONFIG_MPU_REGION4";
mpu_armv75.baseAddr = 0x88000000;
mpu_armv75.size     = 24;

mpu_armv76.$name        = "CONFIG_MPU_REGION5";
mpu_armv76.attributes   = "NonCached";
mpu_armv76.baseAddr     = 0x102E0000;
mpu_armv76.size         = 16;
mpu_armv76.allowExecute = false;

mpu_armv77.$name        = "CONFIG_MPU_REGION6";
mpu_armv77.baseAddr     = 0xC5000000;
mpu_armv77.size         = 13;
mpu_armv77.attributes   = "NonCached";
mpu_armv77.allowExecute = false;

enet_cpsw1.$name                           = "CONFIG_ENET_CPSW0";
enet_cpsw1.RtosVariant                     = "NoRTOS";
enet_cpsw1.LargePoolPktCount               = 80;
enet_cpsw1.macAddrConfig                   = "Manual Entry";
enet_cpsw1.macAddrList                     = "70:FF:76:1D:EC:F2,70:FF:76:1D:EC:F2";
enet_cpsw1.txDmaChannel[0].$name           = "ENET_DMA_TX_CH0";
enet_cpsw1.rxDmaChannel[0].$name           = "ENET_DMA_RX_CH0";
enet_cpsw1.rxDmaChannel[0].PacketsCount    = 64;
enet_cpsw1.$name                 = "CONFIG_ENET_CPSW0";
enet_cpsw1.phyToMacInterfaceMode = "RGMII";
enet_cpsw1.MDIO.$assign          = "MDIO0";
enet_cpsw1.RGMII.$assign         = "RGMII0";

/**
 * Pinmux solution for unlocked pins/peripherals. This ensures that minor changes to the automatic solver in a future
 * version of the tool will not impact the pinmux you originally saw.  These lines can be completely deleted in order to
 * re-solve from scratch.
 */
flash1.peripheralDriver.QSPI["0"].$suggestSolution = "PAD_AL";
flash1.peripheralDriver.QSPI["1"].$suggestSolution = "PAD_AM";
flash1.peripheralDriver.QSPI["2"].$suggestSolution = "PAD_AN";
flash1.peripheralDriver.QSPI["3"].$suggestSolution = "PAD_AO";
flash1.peripheralDriver.QSPI.$suggestSolution      = "QSPI0";
flash1.peripheralDriver.QSPI.CLK.$suggestSolution  = "PAD_AP";
flash1.peripheralDriver.QSPI.CS.$suggestSolution   = "PAD_AQ";
gpio1.GPIO.$suggestSolution                        = "GPIO";
enet_cpsw1.MDIO.DATA.$suggestSolution    = "PAD_CM";
enet_cpsw1.MDIO.CLK.$suggestSolution     = "PAD_CN";
enet_cpsw1.RGMII.RD0.$suggestSolution    = "PAD_CL";
enet_cpsw1.RGMII.RD1.$suggestSolution    = "PAD_CK";
enet_cpsw1.RGMII.RD2.$suggestSolution    = "PAD_CJ";
enet_cpsw1.RGMII.RD3.$suggestSolution    = "PAD_CI";
enet_cpsw1.RGMII.RCTL.$suggestSolution   = "PAD_CB";
enet_cpsw1.RGMII.RCLK.$suggestSolution   = "PAD_CH";
enet_cpsw1.RGMII.TD0.$suggestSolution    = "PAD_CF";
enet_cpsw1.RGMII.TD1.$suggestSolution    = "PAD_CE";
enet_cpsw1.RGMII.TD2.$suggestSolution    = "PAD_CD";
enet_cpsw1.RGMII.TD3.$suggestSolution    = "PAD_CC";
enet_cpsw1.RGMII.TCTL.$suggestSolution   = "PAD_CA";
enet_cpsw1.RGMII.TCLK.$suggestSolution   = "PAD_CG";
