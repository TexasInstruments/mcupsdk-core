/**
 * @cliArgs --device "AM263x_beta" --part "AM263x" --package "ZCZ" --context "r5fss0-0" --product "MCU_PLUS_SDK@07.03.01"
 * @versions {"tool":"1.21.2+3837"}
 */

/**
 * Import the modules used in this configuration.
 */
const eeprom          = scripting.addModule("/board/eeprom/eeprom", {}, false);
const eeprom1         = eeprom.addInstance();
const flash           = scripting.addModule("/board/flash/flash", {}, false);
const flash1          = flash.addInstance();
const bootloader      = scripting.addModule("/drivers/bootloader/bootloader", {}, false);
const bootloader1     = bootloader.addInstance();
const gpio            = scripting.addModule("/drivers/gpio/gpio", {}, false);
const gpio1           = gpio.addInstance();
const hsmclient       = scripting.addModule("/drivers/hsmclient/hsmclient", {}, false);
const hsmclient1      = hsmclient.addInstance();
const i2c             = scripting.addModule("/drivers/i2c/i2c", {}, false);
const i2c1            = i2c.addInstance();
const debug_log       = scripting.addModule("/kernel/dpl/debug_log");
const dpl_cfg         = scripting.addModule("/kernel/dpl/dpl_cfg");
const mpu_armv7       = scripting.addModule("/kernel/dpl/mpu_armv7", {}, false);
const mpu_armv71      = mpu_armv7.addInstance();
const mpu_armv72      = mpu_armv7.addInstance();
const mpu_armv73      = mpu_armv7.addInstance();
const mpu_armv74      = mpu_armv7.addInstance();
const mpu_armv75      = mpu_armv7.addInstance();
const mpu_armv76      = mpu_armv7.addInstance();
const default_linker  = scripting.addModule("/memory_configurator/default_linker", {}, false);
const default_linker1 = default_linker.addInstance();
const general         = scripting.addModule("/memory_configurator/general", {}, false);
const general1        = general.addInstance();
const region          = scripting.addModule("/memory_configurator/region", {}, false);
const region1         = region.addInstance();
const section         = scripting.addModule("/memory_configurator/section", {}, false);
const section1        = section.addInstance();
const section2        = section.addInstance();
const section3        = section.addInstance();
const section4        = section.addInstance();
const section5        = section.addInstance();
const section6        = section.addInstance();
const section7        = section.addInstance();
const section8        = section.addInstance();
const section9        = section.addInstance();
const section10       = section.addInstance();
const section11       = section.addInstance();
const enet_cpsw       = scripting.addModule("/networking/enet_cpsw/enet_cpsw", {}, false);
const enet_cpsw1      = enet_cpsw.addInstance();

/**
 * Write custom configuration values to the imported modules.
 */
eeprom1.$name = "CONFIG_EEPROM0";

bootloader1.$name          = "CONFIG_BOOTLOADER0";
bootloader1.appImageOffset = "0x00080000";

flash1.$name                               = "CONFIG_FLASH0";
bootloader1.flashDriver                    = flash1;
flash1.peripheralDriver.$name              = "CONFIG_QSPI0";
flash1.peripheralDriver.QSPI.QSPI_D2.pu_pd = "pu";
flash1.peripheralDriver.QSPI.QSPI_D3.pu_pd = "pu";
flash1.peripheralDriver.child.$name        = "drivers_qspi_v0_qspi_v0_template0";

const edma                         = scripting.addModule("/drivers/edma/edma", {}, false);
const edma1                        = edma.addInstance({}, false);
edma1.$name                        = "CONFIG_EDMA0";
flash1.peripheralDriver.edmaConfig = edma1;
edma1.edmaRmDmaCh[0].$name         = "CONFIG_EDMA_RM0";
edma1.edmaRmQdmaCh[0].$name        = "CONFIG_EDMA_RM1";
edma1.edmaRmTcc[0].$name           = "CONFIG_EDMA_RM2";
edma1.edmaRmParam[0].$name         = "CONFIG_EDMA_RM3";

gpio1.$name          = "ENET_TRANSFER_START_BTN";
gpio1.trigType       = "RISE_EDGE";
gpio1.rx             = true;
gpio1.GPIO_n.$assign = "LIN2_RXD";

hsmclient1.$name = "CONFIG_HSMCLIENT0";

i2c1.$name               = "CONFIG_I2C1";
eeprom1.peripheralDriver = i2c1;
i2c1.I2C.$assign         = "I2C2";
i2c1.I2C.SCL.$assign     = "UART0_RTSn";
i2c1.I2C_child.$name     = "drivers_i2c_v1_i2c_v1_template0";

debug_log.enableUartLog            = true;
debug_log.uartLog.$name            = "CONFIG_UART0";
debug_log.uartLog.intrEnable       = "DISABLE";
debug_log.uartLog.UART.RXD.$assign = "UART0_RXD";
debug_log.uartLog.UART.TXD.$assign = "UART0_TXD";
debug_log.uartLog.child.$name      = "drivers_uart_v2_uart_v2_template0";

mpu_armv71.$name             = "CONFIG_MPU_REGION0";
mpu_armv71.size              = 31;
mpu_armv71.attributes        = "Device";
mpu_armv71.accessPermissions = "Supervisor RD+WR, User RD";
mpu_armv71.allowExecute      = false;

mpu_armv72.$name             = "CONFIG_MPU_REGION1";
mpu_armv72.size              = 15;
mpu_armv72.accessPermissions = "Supervisor RD+WR, User RD";

mpu_armv73.$name             = "CONFIG_MPU_REGION2";
mpu_armv73.baseAddr          = 0x80000;
mpu_armv73.size              = 15;
mpu_armv73.accessPermissions = "Supervisor RD+WR, User RD";

mpu_armv74.$name             = "CONFIG_MPU_REGION3";
mpu_armv74.accessPermissions = "Supervisor RD+WR, User RD";
mpu_armv74.baseAddr          = 0x70000000;
mpu_armv74.size              = 21;

mpu_armv75.$name        = "CONFIG_MPU_REGION4";
mpu_armv75.allowExecute = false;
mpu_armv75.size         = 12;
mpu_armv75.baseAddr     = 0x70069000;
mpu_armv75.attributes   = "NonCached";

mpu_armv76.$name      = "CONFIG_MPU_REGION5";
mpu_armv76.baseAddr   = 0xCE000000;
mpu_armv76.size       = 24;
mpu_armv76.attributes = "Device";

default_linker1.$name = "memory_configurator_default_linker0";

general1.$name          = "CONFIG_GENERAL0";
general1.irq_stack_size = 4096;
general1.svc_stack_size = 256;
general1.entry_point    = "-e_vectors_sbl";
general1.linker.$name   = "TIARMCLANG0";

region1.$name                                = "MEMORY_REGION_CONFIGURATION";
region1.memory_region.create(11);
region1.memory_region[0].type                = "TCMA";
region1.memory_region[0].$name               = "R5F_VECS";
region1.memory_region[0].auto                = false;
region1.memory_region[0].size                = 0x100;
region1.memory_region[1].type                = "TCMA";
region1.memory_region[1].$name               = "R5F_TCMA";
region1.memory_region[1].auto                = false;
region1.memory_region[1].manualStartAddress  = 0x100;
region1.memory_region[1].size                = 0x7F00;
region1.memory_region[2].type                = "TCMB";
region1.memory_region[2].size                = 0x8000;
region1.memory_region[2].$name               = "R5F_TCMB0";
region1.memory_region[2].manualStartAddress  = 0x41010000;
region1.memory_region[3].$name               = "MSRAM_VECS";
region1.memory_region[3].auto                = false;
region1.memory_region[3].manualStartAddress  = 0x70002000;
region1.memory_region[3].size                = 0x100;
region1.memory_region[4].$name               = "MSRAM_0";
region1.memory_region[4].manualStartAddress  = 0x70002100;
region1.memory_region[4].auto                = false;
region1.memory_region[4].size                = 0x672E8;
region1.memory_region[5].$name               = "CPPI_DESC";
region1.memory_region[5].auto                = false;
region1.memory_region[5].size                = 0x4000;
region1.memory_region[5].manualStartAddress  = 0x700693E8;
region1.memory_region[6].$name               = "MSRAM_HSMRT";
region1.memory_region[6].auto                = false;
region1.memory_region[6].manualStartAddress  = 0x7007C000;
region1.memory_region[6].size                = 0x40000;
region1.memory_region[7].$name               = "MSRAM_1";
region1.memory_region[7].auto                = false;
region1.memory_region[7].manualStartAddress  = 0x700BC000;
region1.memory_region[7].size                = 0x13C000;
region1.memory_region[8].$name               = "MSRAM_2";
region1.memory_region[8].auto                = false;
region1.memory_region[8].manualStartAddress  = 0x701F8000;
region1.memory_region[8].size                = 0x8000;
region1.memory_region[9].auto                = false;
region1.memory_region[9].type                = "CUSTOM";
region1.memory_region[9].manualStartAddress  = 0x44000000;
region1.memory_region[9].$name               = "MAILBOX_HSM";
region1.memory_region[9].size                = 0x3CE;
region1.memory_region[10].type               = "CUSTOM";
region1.memory_region[10].$name              = "MAILBOX_R5F";
region1.memory_region[10].auto               = false;
region1.memory_region[10].manualStartAddress = 0x44000400;
region1.memory_region[10].size               = 0x3CE;

section1.load_memory                              = "MSRAM_VECS";
section1.group                                    = false;
section1.run_memory                               = "R5F_VECS";
section1.$name                                    = "Sbl Initialization Code";
section1.output_section.create(1);
section1.output_section[0].$name                  = ".sbl_init_code";
section1.output_section[0].palignment             = true;
section1.output_section[0].fill                   = 2882382797;
section1.output_section[0].input_section.create(1);
section1.output_section[0].input_section[0].$name = "*(.vectors). = align(8);";

section2.load_memory                  = "MSRAM_VECS";
section2.group                        = false;
section2.$name                        = "Vectors";
section2.output_section.create(1);
section2.output_section[0].$name      = ".vectors";
section2.output_section[0].palignment = true;

section3.load_memory                  = "MSRAM_0";
section3.$name                        = "Text Segments";
section3.output_section.create(7);
section3.output_section[0].$name      = ".text";
section3.output_section[0].palignment = true;
section3.output_section[1].$name      = ".text.hwi";
section3.output_section[1].palignment = true;
section3.output_section[2].$name      = ".text.cache";
section3.output_section[2].palignment = true;
section3.output_section[3].$name      = ".text.mpu";
section3.output_section[3].palignment = true;
section3.output_section[4].$name      = ".text.boot";
section3.output_section[4].palignment = true;
section3.output_section[5].$name      = ".data";
section3.output_section[5].palignment = true;
section3.output_section[6].$name      = ".rodata";
section3.output_section[6].palignment = true;

section4.load_memory                             = "MSRAM_0";
section4.group                                   = false;
section4.$name                                   = "Memory Segments";
section4.output_section.create(3);
section4.output_section[0].$name                 = ".bss";
section4.output_section[0].output_sections_start = "__BSS_START";
section4.output_section[0].output_sections_end   = "__BSS_END";
section4.output_section[0].palignment            = true;
section4.output_section[1].$name                 = ".sysmem";
section4.output_section[1].palignment            = true;
section4.output_section[2].$name                 = ".stack";
section4.output_section[2].palignment            = true;

section5.load_memory                              = "MSRAM_0";
section5.$name                                    = "Stack Segments";
section5.output_section.create(5);
section5.output_section[0].$name                  = ".irqstack";
section5.output_section[0].output_sections_start  = "__IRQ_STACK_START";
section5.output_section[0].output_sections_end    = "__IRQ_STACK_END";
section5.output_section[0].input_section.create(1);
section5.output_section[0].input_section[0].$name = ". = . + __IRQ_STACK_SIZE;";
section5.output_section[1].$name                  = ".fiqstack";
section5.output_section[1].output_sections_start  = "__FIQ_STACK_START";
section5.output_section[1].output_sections_end    = "__FIQ_STACK_END";
section5.output_section[1].input_section.create(1);
section5.output_section[1].input_section[0].$name = ". = . + __FIQ_STACK_SIZE;";
section5.output_section[2].$name                  = ".svcstack";
section5.output_section[2].output_sections_start  = "__SVC_STACK_START";
section5.output_section[2].output_sections_end    = "__SVC_STACK_END";
section5.output_section[2].input_section.create(1);
section5.output_section[2].input_section[0].$name = ". = . + __SVC_STACK_SIZE;";
section5.output_section[3].$name                  = ".abortstack";
section5.output_section[3].output_sections_start  = "__ABORT_STACK_START";
section5.output_section[3].output_sections_end    = "__ABORT_STACK_END";
section5.output_section[3].input_section.create(1);
section5.output_section[3].input_section[0].$name = ". = . + __ABORT_STACK_SIZE;";
section5.output_section[4].$name                  = ".undefinedstack";
section5.output_section[4].output_sections_start  = "__UNDEFINED_STACK_START";
section5.output_section[4].output_sections_end    = "__UNDEFINED_STACK_END";
section5.output_section[4].input_section.create(1);
section5.output_section[4].input_section[0].$name = ". = . + __UNDEFINED_STACK_SIZE;";

section6.$name                       = "NDK Packet Memory ENET CPPI DESC";
section6.type                        = "NOLOAD";
section6.group                       = false;
section6.load_memory                 = "CPPI_DESC";
section6.output_section.create(1);
section6.output_section[0].$name     = ".bss:ENET_CPPI_DESC";
section6.output_section[0].alignment = 128;

section7.type                    = "NOLOAD";
section7.group                   = false;
section7.load_memory             = "MSRAM_1";
section7.$name                   = "File Buffer to be flashed";
section7.output_section.create(1);
section7.output_section[0].$name = ".bss.filebuf";

section8.$name                   = "Scratch pad memory";
section8.type                    = "NOLOAD";
section8.group                   = false;
section8.load_memory             = "MSRAM_2";
section8.output_section.create(1);
section8.output_section[0].$name = ".bss.sbl_scratch";

section9.load_memory                  = "MSRAM_HSMRT";
section9.group                        = false;
section9.$name                        = "Hsmrt";
section9.output_section.create(1);
section9.output_section[0].$name      = ".rodata.hsmrt";
section9.output_section[0].palignment = true;

section10.type                        = "NOLOAD";
section10.group                       = false;
section10.$name                       = "SIPC HSM Queue Memory";
section10.load_memory                 = "MAILBOX_R5F";
section10.output_section.create(1);
section10.output_section[0].$name     = ".bss.sipc_hsm_queue_mem";
section10.output_section[0].alignment = 0;

section11.load_memory                 = "MAILBOX_R5F";
section11.type                        = "NOLOAD";
section11.group                       = false;
section11.$name                       = "SIPC R5F Queue Memory";
section11.output_section.create(1);
section11.output_section[0].alignment = 0;
section11.output_section[0].$name     = ".bss.sipc_r5f_queue_mem";

enet_cpsw1.$name                        = "CONFIG_ENET_CPSW0";
enet_cpsw1.RtosVariant                  = "NoRTOS";
enet_cpsw1.LargePoolPktCount            = 16;
enet_cpsw1.hostportRxCsumOffloadEn      = false;
enet_cpsw1.macAddrConfig                = "Manual Entry";
enet_cpsw1.DisableMacPort2              = true;
enet_cpsw1.cptsHostRxTsEn               = false;
enet_cpsw1.MDIO.$assign                 = "MDIO";
enet_cpsw1.RGMII1.$assign               = "RGMII1";
enet_cpsw1.txDmaChannel[0].$name        = "ENET_DMA_TX_CH0";
enet_cpsw1.txDmaChannel[0].PacketsCount = 8;
enet_cpsw1.rxDmaChannel[0].$name        = "ENET_DMA_RX_CH0";
enet_cpsw1.rxDmaChannel[0].PacketsCount = 8;

const ethphy_cpsw_icssg  = scripting.addModule("/board/ethphy_cpsw_icssg/ethphy_cpsw_icssg", {}, false);
const ethphy_cpsw_icssg1 = ethphy_cpsw_icssg.addInstance({}, false);
ethphy_cpsw_icssg1.$name = "CONFIG_ENET_ETHPHY0";
enet_cpsw1.ethphy1       = ethphy_cpsw_icssg1;

/**
 * Pinmux solution for unlocked pins/peripherals. This ensures that minor changes to the automatic solver in a future
 * version of the tool will not impact the pinmux you originally saw.  These lines can be completely deleted in order to
 * re-solve from scratch.
 */
flash1.peripheralDriver.QSPI.$suggestSolution           = "QSPI";
flash1.peripheralDriver.QSPI.QSPI_D0.$suggestSolution   = "QSPI_D0";
flash1.peripheralDriver.QSPI.QSPI_D1.$suggestSolution   = "QSPI_D1";
flash1.peripheralDriver.QSPI.QSPI_D2.$suggestSolution   = "QSPI_D2";
flash1.peripheralDriver.QSPI.QSPI_D3.$suggestSolution   = "QSPI_D3";
flash1.peripheralDriver.QSPI.QSPI_CLK.$suggestSolution  = "QSPI_CLK";
flash1.peripheralDriver.QSPI.QSPI_CSn0.$suggestSolution = "QSPI_CSn0";
i2c1.I2C.SDA.$suggestSolution                           = "UART0_CTSn";
debug_log.uartLog.UART.$suggestSolution                 = "UART0";
enet_cpsw1.MDIO.MDIO_MDIO.$suggestSolution              = "MDIO_MDIO";
enet_cpsw1.MDIO.MDIO_MDC.$suggestSolution               = "MDIO_MDC";
enet_cpsw1.RGMII1.RD0.$suggestSolution                  = "RGMII1_RD0";
enet_cpsw1.RGMII1.RD1.$suggestSolution                  = "RGMII1_RD1";
enet_cpsw1.RGMII1.RD2.$suggestSolution                  = "RGMII1_RD2";
enet_cpsw1.RGMII1.RD3.$suggestSolution                  = "RGMII1_RD3";
enet_cpsw1.RGMII1.RX_CTL.$suggestSolution               = "RGMII1_RX_CTL";
enet_cpsw1.RGMII1.RXC.$suggestSolution                  = "RGMII1_RXC";
enet_cpsw1.RGMII1.TD0.$suggestSolution                  = "RGMII1_TD0";
enet_cpsw1.RGMII1.TD1.$suggestSolution                  = "RGMII1_TD1";
enet_cpsw1.RGMII1.TD2.$suggestSolution                  = "RGMII1_TD2";
enet_cpsw1.RGMII1.TD3.$suggestSolution                  = "RGMII1_TD3";
enet_cpsw1.RGMII1.TX_CTL.$suggestSolution               = "RGMII1_TX_CTL";
enet_cpsw1.RGMII1.TXC.$suggestSolution                  = "RGMII1_TXC";
enet_cpsw1.RGMII2.$suggestSolution                      = "RGMII2";
enet_cpsw1.RGMII2.RD0.$suggestSolution                  = "PR0_PRU0_GPIO0";
enet_cpsw1.RGMII2.RD1.$suggestSolution                  = "PR0_PRU0_GPIO1";
enet_cpsw1.RGMII2.RD2.$suggestSolution                  = "PR0_PRU0_GPIO2";
enet_cpsw1.RGMII2.RD3.$suggestSolution                  = "PR0_PRU0_GPIO3";
enet_cpsw1.RGMII2.RX_CTL.$suggestSolution               = "PR0_PRU0_GPIO4";
enet_cpsw1.RGMII2.RXC.$suggestSolution                  = "PR0_PRU0_GPIO6";
enet_cpsw1.RGMII2.TD0.$suggestSolution                  = "PR0_PRU0_GPIO11";
enet_cpsw1.RGMII2.TD1.$suggestSolution                  = "PR0_PRU0_GPIO12";
enet_cpsw1.RGMII2.TD2.$suggestSolution                  = "PR0_PRU0_GPIO13";
enet_cpsw1.RGMII2.TD3.$suggestSolution                  = "PR0_PRU0_GPIO14";
enet_cpsw1.RGMII2.TX_CTL.$suggestSolution               = "PR0_PRU0_GPIO15";
enet_cpsw1.RGMII2.TXC.$suggestSolution                  = "PR0_PRU0_GPIO16";
