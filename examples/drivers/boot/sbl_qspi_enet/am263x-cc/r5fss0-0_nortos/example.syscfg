/**
 * These arguments were used when this file was generated. They will be automatically applied on subsequent loads
 * via the GUI or CLI. Run CLI with '--help' for additional information on how to override these arguments.
 * @cliArgs --device "AM263x_beta" --package "ZCZ" --part "AM263x" --context "r5fss0-0" --product "MCU_PLUS_SDK@07.03.01"
 * @versions {"tool":"1.18.0+3266"}
 */

/**
 * Import the modules used in this configuration.
 */
const flash       = scripting.addModule("/board/flash/flash", {}, false);
const flash1      = flash.addInstance();
const bootloader  = scripting.addModule("/drivers/bootloader/bootloader", {}, false);
const bootloader1 = bootloader.addInstance();
const gpio        = scripting.addModule("/drivers/gpio/gpio", {}, false);
const gpio1       = gpio.addInstance();
const hsmclient   = scripting.addModule("/drivers/hsmclient/hsmclient", {}, false);
const hsmclient1  = hsmclient.addInstance();
const i2c         = scripting.addModule("/drivers/i2c/i2c", {}, false);
const i2c1        = i2c.addInstance();
const debug_log   = scripting.addModule("/kernel/dpl/debug_log");
const mpu_armv7   = scripting.addModule("/kernel/dpl/mpu_armv7", {}, false);
const mpu_armv71  = mpu_armv7.addInstance();
const mpu_armv72  = mpu_armv7.addInstance();
const mpu_armv73  = mpu_armv7.addInstance();
const mpu_armv74  = mpu_armv7.addInstance();
const mpu_armv75  = mpu_armv7.addInstance();
const enet_cpsw   = scripting.addModule("/networking/enet_cpsw/enet_cpsw", {}, false);
const enet_cpsw1  = enet_cpsw.addInstance();

/**
 * Write custom configuration values to the imported modules.
 */
bootloader1.$name          = "CONFIG_BOOTLOADER0";
bootloader1.appImageOffset = "0x00080000";

flash1.$name                               = "CONFIG_FLASH0";
bootloader1.flashDriver                    = flash1;
flash1.peripheralDriver.$name              = "CONFIG_QSPI0";
flash1.peripheralDriver.dmaEnable          = true;
flash1.peripheralDriver.QSPI.QSPI_D2.pu_pd = "pu";
flash1.peripheralDriver.QSPI.QSPI_D3.pu_pd = "pu";

const edma                         = scripting.addModule("/drivers/edma/edma", {}, false);
const edma1                        = edma.addInstance({}, false);
edma1.$name                        = "CONFIG_EDMA0";
flash1.peripheralDriver.edmaConfig = edma1;
edma1.edmaRmDmaCh[0].$name         = "CONFIG_EDMA_RM0";
edma1.edmaRmQdmaCh[0].$name        = "CONFIG_EDMA_RM1";
edma1.edmaRmTcc[0].$name           = "CONFIG_EDMA_RM2";
edma1.edmaRmParam[0].$name         = "CONFIG_EDMA_RM3";

gpio1.$name                = "ENET_TRANSFER_START_BTN";
gpio1.trigType             = "RISE_EDGE";
gpio1.GPIO.gpioPin.$assign = "LIN2_RXD";

hsmclient1.$name = "CONFIG_HSMCLIENT0";

i2c1.$name           = "CONFIG_I2C1";
i2c1.I2C.$assign     = "I2C2";
i2c1.I2C.SCL.$assign = "UART0_RTSn";

debug_log.enableUartLog            = true;
debug_log.uartLog.$name            = "CONFIG_UART0";
debug_log.uartLog.intrEnable       = "DISABLE";
debug_log.uartLog.UART.RXD.$assign = "UART0_RXD";
debug_log.uartLog.UART.TXD.$assign = "UART0_TXD";

mpu_armv71.$name             = "CONFIG_MPU_REGION0";
mpu_armv71.size              = 31;
mpu_armv71.attributes        = "Device";
mpu_armv71.accessPermissions = "Supervisor RD+WR, User RD";
mpu_armv71.allowExecute      = false;

mpu_armv72.$name             = "CONFIG_MPU_REGION1";
mpu_armv72.size              = 15;
mpu_armv72.accessPermissions = "Supervisor RD+WR, User RD";

mpu_armv73.$name             = "CONFIG_MPU_REGION2";
mpu_armv73.baseAddr          = 0x80000;
mpu_armv73.size              = 15;
mpu_armv73.accessPermissions = "Supervisor RD+WR, User RD";

mpu_armv74.$name             = "CONFIG_MPU_REGION3";
mpu_armv74.accessPermissions = "Supervisor RD+WR, User RD";
mpu_armv74.baseAddr          = 0x70000000;
mpu_armv74.size              = 21;
mpu_armv74.attributes        = "Cached+Sharable";

mpu_armv75.$name        = "CONFIG_MPU_REGION4";
mpu_armv75.allowExecute = false;
mpu_armv75.attributes   = "Device";
mpu_armv75.baseAddr     = 0xCE000000;
mpu_armv75.size         = 24;

enet_cpsw1.$name                        = "CONFIG_ENET_CPSW0";
enet_cpsw1.RtosVariant                  = "NoRTOS";
enet_cpsw1.LargePoolPktCount            = 16;
enet_cpsw1.customBoardEnable            = true;
enet_cpsw1.DisableMacPort2              = true;
enet_cpsw1.txDmaChannel[0].$name        = "ENET_DMA_TX_CH0";
enet_cpsw1.txDmaChannel[0].PacketsCount = 8;
enet_cpsw1.rxDmaChannel[0].$name        = "ENET_DMA_RX_CH0";
enet_cpsw1.rxDmaChannel[0].PacketsCount = 8;
enet_cpsw1.pinmux[0].$name              = "ENET_CPSW_PINMUX0";

/**
 * Pinmux solution for unlocked pins/peripherals. This ensures that minor changes to the automatic solver in a future
 * version of the tool will not impact the pinmux you originally saw.  These lines can be completely deleted in order to
 * re-solve from scratch.
 */
flash1.peripheralDriver.QSPI.$suggestSolution           = "QSPI";
flash1.peripheralDriver.QSPI.QSPI_D0.$suggestSolution   = "QSPI_D0";
flash1.peripheralDriver.QSPI.QSPI_D1.$suggestSolution   = "QSPI_D1";
flash1.peripheralDriver.QSPI.QSPI_D2.$suggestSolution   = "QSPI_D2";
flash1.peripheralDriver.QSPI.QSPI_D3.$suggestSolution   = "QSPI_D3";
flash1.peripheralDriver.QSPI.QSPI_CLK.$suggestSolution  = "QSPI_CLK";
flash1.peripheralDriver.QSPI.QSPI_CSn0.$suggestSolution = "QSPI_CSn0";
gpio1.GPIO.$suggestSolution                             = "GPIO0";
i2c1.I2C.SDA.$suggestSolution                           = "UART0_CTSn";
debug_log.uartLog.UART.$suggestSolution                 = "UART0";
enet_cpsw1.pinmux[0].MDIO.$suggestSolution              = "MDIO";
enet_cpsw1.pinmux[0].MDIO.MDIO_MDIO.$suggestSolution    = "MDIO_MDIO";
enet_cpsw1.pinmux[0].MDIO.MDIO_MDC.$suggestSolution     = "MDIO_MDC";
enet_cpsw1.pinmux[0].RGMII1.$suggestSolution            = "RGMII2";
enet_cpsw1.pinmux[0].RGMII1.RD0.$suggestSolution        = "PR0_PRU0_GPIO0";
enet_cpsw1.pinmux[0].RGMII1.RD1.$suggestSolution        = "PR0_PRU0_GPIO1";
enet_cpsw1.pinmux[0].RGMII1.RD2.$suggestSolution        = "PR0_PRU0_GPIO2";
enet_cpsw1.pinmux[0].RGMII1.RD3.$suggestSolution        = "PR0_PRU0_GPIO3";
enet_cpsw1.pinmux[0].RGMII1.RX_CTL.$suggestSolution     = "PR0_PRU0_GPIO4";
enet_cpsw1.pinmux[0].RGMII1.RXC.$suggestSolution        = "PR0_PRU0_GPIO6";
enet_cpsw1.pinmux[0].RGMII1.TD0.$suggestSolution        = "PR0_PRU0_GPIO11";
enet_cpsw1.pinmux[0].RGMII1.TD1.$suggestSolution        = "PR0_PRU0_GPIO12";
enet_cpsw1.pinmux[0].RGMII1.TD2.$suggestSolution        = "PR0_PRU0_GPIO13";
enet_cpsw1.pinmux[0].RGMII1.TD3.$suggestSolution        = "PR0_PRU0_GPIO14";
enet_cpsw1.pinmux[0].RGMII1.TX_CTL.$suggestSolution     = "PR0_PRU0_GPIO15";
enet_cpsw1.pinmux[0].RGMII1.TXC.$suggestSolution        = "PR0_PRU0_GPIO16";
enet_cpsw1.pinmux[0].RGMII2.$suggestSolution            = "RGMII1";
enet_cpsw1.pinmux[0].RGMII2.RD0.$suggestSolution        = "RGMII1_RD0";
enet_cpsw1.pinmux[0].RGMII2.RD1.$suggestSolution        = "RGMII1_RD1";
enet_cpsw1.pinmux[0].RGMII2.RD2.$suggestSolution        = "RGMII1_RD2";
enet_cpsw1.pinmux[0].RGMII2.RD3.$suggestSolution        = "RGMII1_RD3";
enet_cpsw1.pinmux[0].RGMII2.RX_CTL.$suggestSolution     = "RGMII1_RX_CTL";
enet_cpsw1.pinmux[0].RGMII2.RXC.$suggestSolution        = "RGMII1_RXC";
enet_cpsw1.pinmux[0].RGMII2.TD0.$suggestSolution        = "RGMII1_TD0";
enet_cpsw1.pinmux[0].RGMII2.TD1.$suggestSolution        = "RGMII1_TD1";
enet_cpsw1.pinmux[0].RGMII2.TD2.$suggestSolution        = "RGMII1_TD2";
enet_cpsw1.pinmux[0].RGMII2.TD3.$suggestSolution        = "RGMII1_TD3";
enet_cpsw1.pinmux[0].RGMII2.TX_CTL.$suggestSolution     = "RGMII1_TX_CTL";
enet_cpsw1.pinmux[0].RGMII2.TXC.$suggestSolution        = "RGMII1_TXC";
