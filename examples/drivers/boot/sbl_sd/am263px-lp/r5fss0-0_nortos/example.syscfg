/**
 * @cliArgs --device "AM263Px" --package "ZCZ_S" --part "AM263P2" --context "r5fss0-0" --product "MCU_PLUS_SDK@07.03.01"
 * @versions {"tool":"1.17.0+3128"}
 */

/**
 * Import the modules used in this configuration.
 */
const bootloader    = scripting.addModule("/drivers/bootloader/bootloader", {}, false);
const bootloader1   = bootloader.addInstance();
const gpio          = scripting.addModule("/drivers/gpio/gpio", {}, false);
const gpio1         = gpio.addInstance();
const hsmclient     = scripting.addModule("/drivers/hsmclient/hsmclient", {}, false);
const hsmclient1    = hsmclient.addInstance();
const freertos_fat  = scripting.addModule("/fs/freertos_fat/freertos_fat", {}, false);
const freertos_fat1 = freertos_fat.addInstance();
const debug_log     = scripting.addModule("/kernel/dpl/debug_log");
const mpu_armv7     = scripting.addModule("/kernel/dpl/mpu_armv7", {}, false);
const mpu_armv71    = mpu_armv7.addInstance();
const mpu_armv72    = mpu_armv7.addInstance();
const mpu_armv73    = mpu_armv7.addInstance();
const mpu_armv74    = mpu_armv7.addInstance();
const mpu_armv75    = mpu_armv7.addInstance();

/**
 * Write custom configuration values to the imported modules.
 */
bootloader1.bootMedia = "MEM";
bootloader1.$name     = "CONFIG_BOOTLOADER_MEM";

gpio1.$name                = "CONFIG_GPIO0";
gpio1.GPIO.gpioPin.pu_pd   = "pu";
gpio1.GPIO.gpioPin.$assign = "SDFM0_CLK0";

hsmclient1.$name = "CONFIG_HSMCLIENT0";

freertos_fat1.$name                  = "CONFIG_FREERTOS_FAT0";
freertos_fat1.peripheralDriver.$name = "CONFIG_MMCSD0";

debug_log.enableUartLog            = true;
debug_log.uartLog.$name            = "CONFIG_UART0";
debug_log.uartLog.intrEnable       = "DISABLE";
debug_log.uartLog.UART.RXD.$assign = "UART0_RXD";
debug_log.uartLog.UART.TXD.$assign = "UART0_TXD";

mpu_armv71.$name             = "CONFIG_MPU_REGION0";
mpu_armv71.size              = 31;
mpu_armv71.attributes        = "Device";
mpu_armv71.accessPermissions = "Supervisor RD+WR, User RD";
mpu_armv71.allowExecute      = false;

mpu_armv72.$name             = "CONFIG_MPU_REGION1";
mpu_armv72.size              = 15;
mpu_armv72.accessPermissions = "Supervisor RD+WR, User RD";

mpu_armv73.$name             = "CONFIG_MPU_REGION2";
mpu_armv73.baseAddr          = 0x80000;
mpu_armv73.size              = 15;
mpu_armv73.accessPermissions = "Supervisor RD+WR, User RD";

mpu_armv74.$name             = "CONFIG_MPU_REGION3";
mpu_armv74.accessPermissions = "Supervisor RD+WR, User RD";
mpu_armv74.baseAddr          = 0x70000000;
mpu_armv74.size              = 21;
mpu_armv74.attributes        = "Cached+Sharable";

mpu_armv75.$name        = "CONFIG_MPU_REGION4";
mpu_armv75.allowExecute = false;
mpu_armv75.attributes   = "Device";
mpu_armv75.baseAddr     = 0xCE000000;
mpu_armv75.size         = 24;

/**
 * Pinmux solution for unlocked pins/peripherals. This ensures that minor changes to the automatic solver in a future
 * version of the tool will not impact the pinmux you originally saw.  These lines can be completely deleted in order to
 * re-solve from scratch.
 */
gpio1.GPIO.$suggestSolution                                  = "GPIO";
freertos_fat1.peripheralDriver.MMC.$suggestSolution          = "MMC";
freertos_fat1.peripheralDriver.MMC.MMC_CLK.$suggestSolution  = "MMC_CLK";
freertos_fat1.peripheralDriver.MMC.MMC_SDWP.$suggestSolution = "MMC_SDWP";
freertos_fat1.peripheralDriver.MMC.MMC_CMD.$suggestSolution  = "MMC_CMD";
freertos_fat1.peripheralDriver.MMC.MMC_DAT0.$suggestSolution = "MMC_DAT0";
freertos_fat1.peripheralDriver.MMC.MMC_DAT1.$suggestSolution = "MMC_DAT1";
freertos_fat1.peripheralDriver.MMC.MMC_DAT2.$suggestSolution = "MMC_DAT2";
freertos_fat1.peripheralDriver.MMC.MMC_DAT3.$suggestSolution = "MMC_DAT3";
freertos_fat1.peripheralDriver.MMC.MMC_SDCD.$suggestSolution = "MMC_SDCD";
debug_log.uartLog.UART.$suggestSolution                      = "UART0";
