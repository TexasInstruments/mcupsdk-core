/**
 * @cliArgs --device "AM64x_beta" --package "ALV" --part "Default" --context "r5fss0-0" --product "MCU_PLUS_SDK@07.03.01"
 * @versions {"tool":"1.14.0+2667"}
 */

/**
 * Import the modules used in this configuration.
 */
const bootloader    = scripting.addModule("/drivers/bootloader/bootloader", {}, false);
const bootloader1   = bootloader.addInstance();
const ddr           = scripting.addModule("/drivers/ddr/ddr", {}, false);
const ddr1          = ddr.addInstance();
const freertos_fat  = scripting.addModule("/fs/freertos_fat/freertos_fat", {}, false);
const freertos_fat1 = freertos_fat.addInstance();
const debug_log     = scripting.addModule("/kernel/dpl/debug_log");
const mpu_armv7     = scripting.addModule("/kernel/dpl/mpu_armv7", {}, false);
const mpu_armv71    = mpu_armv7.addInstance();
const mpu_armv72    = mpu_armv7.addInstance();
const mpu_armv73    = mpu_armv7.addInstance();
const mpu_armv74    = mpu_armv7.addInstance();
const mpu_armv75    = mpu_armv7.addInstance();

/**
 * Write custom configuration values to the imported modules.
 */
bootloader1.$name     = "CONFIG_BOOTLOADER_MEM";
bootloader1.bootMedia = "MEM";

ddr1.$name = "CONFIG_DDR0";

freertos_fat1.$name                     = "CONFIG_FREERTOS_FAT0";
freertos_fat1.peripheralDriver.$name    = "CONFIG_MMCSD0";
freertos_fat1.peripheralDriver.cardType = "SD";
freertos_fat1.peripheralDriver.phyType  = "SW_PHY";

debug_log.enableCssLog         = false;
debug_log.enableUartLog        = true;
debug_log.enableLogZoneWarning = false;
debug_log.uartLog.$name        = "CONFIG_UART0";
debug_log.uartLog.intrEnable   = "DISABLE";

mpu_armv71.$name             = "CONFIG_MPU_REGION0";
mpu_armv71.size              = 31;
mpu_armv71.attributes        = "Device";
mpu_armv71.accessPermissions = "Supervisor RD+WR, User RD";
mpu_armv71.allowExecute      = false;

mpu_armv72.$name             = "CONFIG_MPU_REGION1";
mpu_armv72.size              = 15;
mpu_armv72.accessPermissions = "Supervisor RD+WR, User RD";

mpu_armv73.$name             = "CONFIG_MPU_REGION2";
mpu_armv73.baseAddr          = 0x41010000;
mpu_armv73.size              = 15;
mpu_armv73.accessPermissions = "Supervisor RD+WR, User RD";

mpu_armv74.$name             = "CONFIG_MPU_REGION3";
mpu_armv74.accessPermissions = "Supervisor RD+WR, User RD";
mpu_armv74.baseAddr          = 0x70000000;
mpu_armv74.size              = 21;

mpu_armv75.$name             = "CONFIG_MPU_REGION4";
mpu_armv75.baseAddr          = 0x80000000;
mpu_armv75.size              = 31;
mpu_armv75.accessPermissions = "Supervisor RD+WR, User RD";

/**
 * Pinmux solution for unlocked pins/peripherals. This ensures that minor changes to the automatic solver in a future
 * version of the tool will not impact the pinmux you originally saw.  These lines can be completely deleted in order to
 * re-solve from scratch.
 */
freertos_fat1.peripheralDriver.MMC1.$suggestSolution       = "MMC1";
freertos_fat1.peripheralDriver.MMC1.CLK.$suggestSolution   = "ball.L20";
freertos_fat1.peripheralDriver.MMC1.CLKLB.$suggestSolution = "MMC1_CLKLB";
freertos_fat1.peripheralDriver.MMC1.CMD.$suggestSolution   = "ball.J19";
freertos_fat1.peripheralDriver.MMC1.DAT0.$suggestSolution  = "ball.K21";
freertos_fat1.peripheralDriver.MMC1.DAT1.$suggestSolution  = "ball.L21";
freertos_fat1.peripheralDriver.MMC1.DAT2.$suggestSolution  = "ball.K19";
freertos_fat1.peripheralDriver.MMC1.DAT3.$suggestSolution  = "ball.K18";
freertos_fat1.peripheralDriver.MMC1.SDCD.$suggestSolution  = "ball.D19";
debug_log.uartLog.UART.$suggestSolution                    = "USART0";
debug_log.uartLog.UART.RXD.$suggestSolution                = "ball.D15";
debug_log.uartLog.UART.TXD.$suggestSolution                = "ball.C16";
