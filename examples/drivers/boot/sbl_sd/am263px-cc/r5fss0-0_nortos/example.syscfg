/**
 * @cliArgs --device "AM263Px_beta" --package "ZCZ" --part "AM263Px" --context "r5fss0-0" --product "MCU_PLUS_SDK@07.03.01"
 * @versions {"tool":"1.13.0+2553"}
 */

/**
 * Import the modules used in this configuration.
 */
const flash       = scripting.addModule("/board/flash/flash", {}, false);
const flash1      = flash.addInstance();
const bootloader  = scripting.addModule("/drivers/bootloader/bootloader", {}, false);
const bootloader1 = bootloader.addInstance();
const hsmclient   = scripting.addModule("/drivers/hsmclient/hsmclient", {}, false);
const hsmclient1  = hsmclient.addInstance();
const debug_log   = scripting.addModule("/kernel/dpl/debug_log");

const freertos_fat  = scripting.addModule("/fs/freertos_fat/freertos_fat", {}, false);
const freertos_fat1 = freertos_fat.addInstance();
const mpu_armv7  = scripting.addModule("/kernel/dpl/mpu_armv7", {}, false);
const mpu_armv71 = mpu_armv7.addInstance();
const mpu_armv72 = mpu_armv7.addInstance();
const mpu_armv73 = mpu_armv7.addInstance();
const mpu_armv74 = mpu_armv7.addInstance();
const mpu_armv75 = mpu_armv7.addInstance();

/**
 * Write custom configuration values to the imported modules.
 */
bootloader1.bootMedia = "MEM";
bootloader1.$name     = "CONFIG_BOOTLOADER_MEM";

flash1.$name                               = "CONFIG_FLASH0";
flash1.peripheralDriver.$name              = "CONFIG_QSPI0";
flash1.peripheralDriver.dmaEnable          = true;
flash1.peripheralDriver.QSPI.QSPI_D2.pu_pd = "pu";
flash1.peripheralDriver.QSPI.QSPI_D3.pu_pd = "pu";

const edma                         = scripting.addModule("/drivers/edma/edma", {}, false);
const edma1                        = edma.addInstance({}, false);
edma1.$name                        = "CONFIG_EDMA0";
flash1.peripheralDriver.edmaConfig = edma1;
edma1.edmaRmDmaCh[0].$name         = "CONFIG_EDMA_RM0";
edma1.edmaRmQdmaCh[0].$name        = "CONFIG_EDMA_RM1";
edma1.edmaRmTcc[0].$name           = "CONFIG_EDMA_RM2";
edma1.edmaRmParam[0].$name         = "CONFIG_EDMA_RM3";

hsmclient1.$name = "CONFIG_HSMCLIENT0";

freertos_fat1.$name                     = "CONFIG_FREERTOS_FAT0";
freertos_fat1.peripheralDriver.$name    = "CONFIG_MMCSD0";
freertos_fat1.peripheralDriver.cardType = "SD";

debug_log.enableUartLog            = true;
debug_log.uartLog.$name            = "CONFIG_UART0";
debug_log.uartLog.intrEnable       = "DISABLE";
debug_log.uartLog.UART.RXD.$assign = "ball.A7";
debug_log.uartLog.UART.TXD.$assign = "ball.A6";

mpu_armv71.$name             = "CONFIG_MPU_REGION0";
mpu_armv71.size              = 31;
mpu_armv71.attributes        = "Device";
mpu_armv71.accessPermissions = "Supervisor RD+WR, User RD";
mpu_armv71.allowExecute      = false;

mpu_armv72.$name             = "CONFIG_MPU_REGION1";
mpu_armv72.size              = 15;
mpu_armv72.accessPermissions = "Supervisor RD+WR, User RD";

mpu_armv73.$name             = "CONFIG_MPU_REGION2";
mpu_armv73.baseAddr          = 0x80000;
mpu_armv73.size              = 15;
mpu_armv73.accessPermissions = "Supervisor RD+WR, User RD";

mpu_armv74.$name             = "CONFIG_MPU_REGION3";
mpu_armv74.accessPermissions = "Supervisor RD+WR, User RD";
mpu_armv74.baseAddr          = 0x70000000;
mpu_armv74.size              = 21;
mpu_armv74.attributes        = "Cached+Sharable";

mpu_armv75.$name        = "CONFIG_MPU_REGION4";
mpu_armv75.allowExecute = false;
mpu_armv75.attributes   = "Device";
mpu_armv75.baseAddr     = 0xCE000000;
mpu_armv75.size         = 24;

/**
 * Pinmux solution for unlocked pins/peripherals. This ensures that minor changes to the automatic solver in a future
 * version of the tool will not impact the pinmux you originally saw.  These lines can be completely deleted in order to
 * re-solve from scratch.
 */
flash1.peripheralDriver.QSPI.$suggestSolution           = "QSPI";
flash1.peripheralDriver.QSPI.QSPI_D0.$suggestSolution   = "ball.N1";
flash1.peripheralDriver.QSPI.QSPI_D1.$suggestSolution   = "ball.N4";
flash1.peripheralDriver.QSPI.QSPI_D2.$suggestSolution   = "ball.M4";
flash1.peripheralDriver.QSPI.QSPI_D3.$suggestSolution   = "ball.P3";
flash1.peripheralDriver.QSPI.QSPI_CLK.$suggestSolution  = "ball.N2";
flash1.peripheralDriver.QSPI.QSPI_CSn0.$suggestSolution = "ball.P1";
debug_log.uartLog.UART.$suggestSolution                 = "UART0";

freertos_fat1.peripheralDriver.MMC.$suggestSolution       = "MMC";
freertos_fat1.peripheralDriver.MMC.MMC_CLK.$suggestSolution   = "ball.B6";
freertos_fat1.peripheralDriver.MMC.MMC_CMD.$suggestSolution   = "ball.A4";
freertos_fat1.peripheralDriver.MMC.MMC_DAT0.$suggestSolution  = "ball.B5";
freertos_fat1.peripheralDriver.MMC.MMC_DAT1.$suggestSolution  = "ball.B4";
freertos_fat1.peripheralDriver.MMC.MMC_DAT2.$suggestSolution  = "ball.A3";
freertos_fat1.peripheralDriver.MMC.MMC_DAT3.$suggestSolution  = "ball.A2";
freertos_fat1.peripheralDriver.MMC.MMC_SDCD.$suggestSolution  = "ball.A5";
freertos_fat1.peripheralDriver.MMC.MMC_SDWP.$suggestSolution  = "ball.C6";
