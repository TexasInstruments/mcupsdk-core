/**
 * @cliArgs --device "AM273x" --package "ZCE" --part "Default" --context "c66ss0" --product "MCU_PLUS_SDK@07.03.01"
 * @versions {"tool":"1.10.0+2163"}
 */

/**
 * Import the modules used in this configuration.
 */
const edma      = scripting.addModule("/drivers/edma/edma", {}, false);
const edma1     = edma.addInstance();
const cache_c6x = scripting.addModule("/kernel/dpl/cache_c6x");
const debug_log = scripting.addModule("/kernel/dpl/debug_log");

/**
 * Write custom configuration values to the imported modules.
 */
edma1.$name                        = "CONFIG_EDMA0";
edma1.edmaRmDmaCh[0].$name         = "CONFIG_EDMA_RM0";
edma1.edmaRmQdmaCh[0].$name        = "CONFIG_EDMA_RM1";
edma1.edmaRmTcc[0].$name           = "CONFIG_EDMA_RM2";
edma1.edmaRmParam[0].$name         = "CONFIG_EDMA_RM3";
edma1.edmaRmReservedDmaCh[0].$name = "CONFIG_EDMA_RM4";

debug_log.enableSharedMemLog = true;
