/**
 * @cliArgs --device "AM263x_beta" --package "ZCZ" --part "AM263x" --context "r5fss0-0" --product "MCU_PLUS_SDK@07.03.01"
 * @versions {"tool":"1.18.0+3266"}
 */

/**
 * Import the modules used in this configuration.
 */
const ecap         = scripting.addModule("/drivers/ecap/ecap", {}, false);
const ecap1        = ecap.addInstance();
const ecap2        = ecap.addInstance();
const ecap3        = ecap.addInstance();
const edma         = scripting.addModule("/drivers/edma/edma", {}, false);
const edma1        = edma.addInstance();
const epwm         = scripting.addModule("/drivers/epwm/epwm", {}, false);
const epwm1        = epwm.addInstance();
const debug_log    = scripting.addModule("/kernel/dpl/debug_log");
const mpu_armv7    = scripting.addModule("/kernel/dpl/mpu_armv7", {}, false);
const mpu_armv71   = mpu_armv7.addInstance();
const mpu_armv72   = mpu_armv7.addInstance();
const mpu_armv73   = mpu_armv7.addInstance();
const mpu_armv74   = mpu_armv7.addInstance();
const input_xbar   = scripting.addModule("/xbar/input_xbar/input_xbar", {}, false);
const input_xbar1  = input_xbar.addInstance();
const output_xbar  = scripting.addModule("/xbar/output_xbar/output_xbar", {}, false);
const output_xbar1 = output_xbar.addInstance();

/**
 * Write custom configuration values to the imported modules.
 */
ecap1.captureMode       = "ECAP_ONE_SHOT_CAPTURE_MODE";
ecap1.enableLoadCounter = true;
ecap1.$name             = "APWM_ECAP0";
ecap1.ecapMode          = "APWM";
ecap1.useInterrupts     = false;
ecap1.apwmPeriod        = 31999;
ecap1.apwmCompare       = 7999;
ecap1.emulationMode     = "ECAP_EMULATION_FREE_RUN";
ecap1.useDMA            = true;

ecap2.ecapBase            = "CSL_CONTROLSS_ECAP1_U_BASE";
ecap2.emulationMode       = "ECAP_EMULATION_FREE_RUN";
ecap2.$name               = "CAPTURE_ECAP1";
ecap2.eventStop           = "ECAP_EVENT_4";
ecap2.eventOnePolarity    = "ECAP_EVNT_FALLING_EDGE";
ecap2.useInterrupts       = false;
ecap2.eventThreePolarity  = "ECAP_EVNT_FALLING_EDGE";
ecap2.ecapInput           = "ECAP_INPUT_INPUTXBAR0";
ecap2.dmaSource           = "ECAP_CAP_MODE_DMA_TRIGGER_SRC_CEVT4";
ecap2.counterResetOnEvent = ["ECAP_EVENT_1","ECAP_EVENT_2","ECAP_EVENT_3","ECAP_EVENT_4"];
ecap2.syncInPulseSource   = "ECAP_SYNC_IN_PULSE_SRC_SYNCOUT_EPWM0";
ecap2.useDMA              = true;

ecap3.$name               = "CAPTURE_ECAP2";
ecap3.ecapBase            = "CSL_CONTROLSS_ECAP2_U_BASE";
ecap3.emulationMode       = "ECAP_EMULATION_FREE_RUN";
ecap3.eventStop           = "ECAP_EVENT_2";
ecap3.eventOnePolarity    = "ECAP_EVNT_FALLING_EDGE";
ecap3.useInterrupts       = false;
ecap3.dmaSource           = "ECAP_CAP_MODE_DMA_TRIGGER_SRC_CEVT2";
ecap3.counterResetOnEvent = ["ECAP_EVENT_1","ECAP_EVENT_2","ECAP_EVENT_3","ECAP_EVENT_4"];
ecap3.syncInPulseSource   = "ECAP_SYNC_IN_PULSE_SRC_SYNCOUT_EPWM0";
ecap3.ecapInput           = "ECAP_INPUT_INPUTXBAR0";

edma1.$name                                         = "CONFIG_EDMA0";
edma1.edmaRmDmaCh[0].$name                          = "CONFIG_EDMA_RM0";
edma1.edmaRmQdmaCh[0].$name                         = "CONFIG_EDMA_RM1";
edma1.edmaRmTcc[0].$name                            = "CONFIG_EDMA_RM2";
edma1.edmaRmParam[0].$name                          = "CONFIG_EDMA_RM3";
edma1.edmaChannel.create(2);
edma1.edmaChannel[0].$name                          = "CONFIG_EDMA_CH0";
edma1.edmaChannel[0].channelTrigger                 = "ECAP0_DMA_INT";
edma1.edmaChannel[0].xbarConfig.$name               = "CONFIG_DMA_TRIG_XBAR0";
edma1.edmaChannel[0].xbarConfig.xbarConfig.$name    = "CONFIG_DMA_XBAR0";
edma1.edmaChannel[1].$name                          = "CONFIG_EDMA_CH1";
edma1.edmaChannel[1].channelTrigger                 = "ECAP1_DMA_INT";
edma1.edmaChannel[1].xbarConfig.$name               = "CONFIG_DMA_TRIG_XBAR1";
edma1.edmaChannel[1].xbarConfig.instance            = "DMA_TRIG_XBAR_EDMA_MODULE_1";
edma1.edmaChannel[1].xbarConfig.xbarConfig.$name    = "CONFIG_DMA_XBAR1";
edma1.edmaChannel[1].xbarConfig.xbarConfig.instance = "DMA_XBAR_DMA_TRIG_XBAR_1";

epwm1.epwmTimebase_syncOutPulseMode = ["EPWM_SYNC_OUT_PULSE_ON_SOFTWARE"];
epwm1.$name                         = "SYNC_EPWM";
epwm1.EPWM.$assign                  = "EPWM0";

debug_log.enableUartLog            = true;
debug_log.uartLog.$name            = "CONFIG_UART0";
debug_log.uartLog.UART.RXD.$assign = "UART0_RXD";
debug_log.uartLog.UART.TXD.$assign = "UART0_TXD";

mpu_armv71.$name             = "CONFIG_MPU_REGION0";
mpu_armv71.size              = 31;
mpu_armv71.attributes        = "Device";
mpu_armv71.accessPermissions = "Supervisor RD+WR, User RD";
mpu_armv71.allowExecute      = false;

mpu_armv72.$name             = "CONFIG_MPU_REGION1";
mpu_armv72.size              = 15;
mpu_armv72.accessPermissions = "Supervisor RD+WR, User RD";

mpu_armv73.$name             = "CONFIG_MPU_REGION2";
mpu_armv73.baseAddr          = 0x80000;
mpu_armv73.size              = 15;
mpu_armv73.accessPermissions = "Supervisor RD+WR, User RD";

mpu_armv74.$name             = "CONFIG_MPU_REGION3";
mpu_armv74.accessPermissions = "Supervisor RD+WR, User RD";
mpu_armv74.baseAddr          = 0x70000000;
mpu_armv74.size              = 21;

input_xbar1.$name      = "CONFIG_INPUT_XBAR0";
input_xbar1.xbarOutput = "GPIO119";

output_xbar1.$name              = "CONFIG_OUTPUT_XBAR0";
output_xbar1.xbarOutput         = ["ECAP0_OUT"];
output_xbar1.OUTPUTXBAR.$assign = "OUTPUTXBAR13";

/**
 * Pinmux solution for unlocked pins/peripherals. This ensures that minor changes to the automatic solver in a future
 * version of the tool will not impact the pinmux you originally saw.  These lines can be completely deleted in order to
 * re-solve from scratch.
 */
epwm1.EPWM.A.$suggestSolution                       = "EPWM0_A";
epwm1.EPWM.B.$suggestSolution                       = "EPWM0_B";
debug_log.uartLog.UART.$suggestSolution             = "UART0";
output_xbar1.OUTPUTXBAR.OUTPUTXBAR.$suggestSolution = "PR0_PRU1_GPIO19";
