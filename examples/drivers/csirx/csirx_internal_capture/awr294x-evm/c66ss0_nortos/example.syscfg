/**
 * @cliArgs --device "AWR294X" --package "ETS" --part "Default" --context "c66ss0" --product "MCU_PLUS_SDK@07.03.01"
 * @versions {"tool":"1.10.0+2061"}
 */

/**
 * Import the modules used in this configuration.
 */
const csirx     = scripting.addModule("/drivers/csirx/csirx", {}, false);
const csirx1    = csirx.addInstance();
const cache_c6x = scripting.addModule("/kernel/dpl/cache_c6x");
const debug_log = scripting.addModule("/kernel/dpl/debug_log");
const dpl_cfg = scripting.addModule("/kernel/dpl/dpl_cfg");

/**
 * Write custom configuration values to the imported modules.
 */
csirx1.$name                           = "CONFIG_CSIRX0";
csirx1.dphy.$name                      = "CONFIG_CSIRX_DPHY0";
csirx1.complexio.$name                 = "CONFIG_CSIRX_COMPLEXIO0";
csirx1.common.$name                    = "CONFIG_CSIRX_COMMON0";
csirx1.common.commonCallback           = "App_csirxCommonCallback";
csirx1.context.create(2);
csirx1.context[0].$name                = "CONFIG_CSIRX_CONTEXT0";
csirx1.context[0].isFrameEndCodeDetect = true;
csirx1.context[1].$name                = "CONFIG_CSIRX_CONTEXT1";
csirx1.context[1].virtualChannelId     = 1;
csirx1.context[1].pingPongSwitchMode   = "CSIRX_PING_PONG_LINE_SWITCHING";
csirx1.context[1].isNumLines           = true;

cache_c6x.marRegionConfig.create(2);
cache_c6x.marRegionConfig[0].$name    = "kernel_dpl_cache_c6x_mar0";
cache_c6x.marRegionConfig[0].baseAddr = 0xC5000000;
cache_c6x.marRegionConfig[1].$name    = "kernel_dpl_cache_c6x_mar1";
cache_c6x.marRegionConfig[1].baseAddr = 0x83000000;

debug_log.enableUartLog               = true;
debug_log.uartLog.$name               = "CONFIG_UART0";
debug_log.uartLog.DSS_UART.$assign    = "DSS_UARTA";
debug_log.uartLog.DSS_UART.RX.$assign = "PAD_DD";
debug_log.uartLog.DSS_UART.TX.$assign = "PAD_DC";
