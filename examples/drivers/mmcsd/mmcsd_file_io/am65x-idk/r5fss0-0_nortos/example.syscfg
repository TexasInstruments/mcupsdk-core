/**
 * @cliArgs --device "AM65xx_SR2.0_beta" --package "ACD" --part "Default" --context "r5fss0-0" --product "MCU_PLUS_SDK@07.03.01"
 * @versions {"tool":"1.20.0+3587"}
 */

/**
 * Import the modules used in this configuration.
 */
const freertos_fat  = scripting.addModule("/fs/freertos_fat/freertos_fat", {}, false);
const freertos_fat1 = freertos_fat.addInstance();
const debug_log     = scripting.addModule("/kernel/dpl/debug_log");
const dpl_cfg       = scripting.addModule("/kernel/dpl/dpl_cfg");
const mpu_armv7     = scripting.addModule("/kernel/dpl/mpu_armv7", {}, false);
const mpu_armv71    = mpu_armv7.addInstance();
const mpu_armv72    = mpu_armv7.addInstance();
const mpu_armv73    = mpu_armv7.addInstance();
const mpu_armv74    = mpu_armv7.addInstance();
const mpu_armv75    = mpu_armv7.addInstance();
const mpu_armv76    = mpu_armv7.addInstance();

/**
 * Write custom configuration values to the imported modules.
 */
freertos_fat1.$name                    = "CONFIG_FREERTOS_FAT0";
freertos_fat1.peripheralDriver.$name   = "CONFIG_MMCSD1";
freertos_fat1.peripheralDriver.phyType = "SW_PHY";

debug_log.enableUartLog                   = true;
debug_log.uartLog.$name                   = "CONFIG_UART0";
debug_log.uartLog.useMcuDomainPeripherals = true;
debug_log.uartLog.MCU_UART.$assign        = "MCU_USART0";
debug_log.uartLog.MCU_UART.RXD.$assign    = "MCU_OSPI1_D1";
debug_log.uartLog.MCU_UART.TXD.$assign    = "MCU_OSPI1_D2";

const uart_v0_template  = scripting.addModule("/drivers/uart/v0/uart_v0_template", {}, false);
const uart_v0_template1 = uart_v0_template.addInstance({}, false);
uart_v0_template1.$name = "drivers_uart_v0_uart_v0_template0";
debug_log.uartLog.child = uart_v0_template1;

mpu_armv71.size         = 31;
mpu_armv71.allowExecute = false;
mpu_armv71.attributes   = "Device";
mpu_armv71.$name        = "SOC_MEM_MAP";

mpu_armv72.size  = 15;
mpu_armv72.$name = "ATCM_MEM_MAP";

mpu_armv73.baseAddr          = 0x41010000;
mpu_armv73.size              = 15;
mpu_armv73.allowExecute      = false;
mpu_armv73.accessPermissions = "Supervisor RD+WR, User RD";
mpu_armv73.$name             = "BTCM_MEM_MAP";

mpu_armv74.size       = 19;
mpu_armv74.baseAddr   = 0x41C00000;
mpu_armv74.attributes = "NonCached";
mpu_armv74.$name      = "MSRAM_MEM_MAP";

mpu_armv75.baseAddr = 0x70000000;
mpu_armv75.size     = 21;
mpu_armv75.$name    = "MSMC_SRAM_MEM_MAP";

mpu_armv76.baseAddr = 0x80000000;
mpu_armv76.size     = 31;
mpu_armv76.$name    = "DDR_MEM_MAP";

/**
 * Pinmux solution for unlocked pins/peripherals. This ensures that minor changes to the automatic solver in a future
 * version of the tool will not impact the pinmux you originally saw.  These lines can be completely deleted in order to
 * re-solve from scratch.
 */
freertos_fat1.peripheralDriver.MMC.$suggestSolution      = "MMC1";
freertos_fat1.peripheralDriver.MMC.CLK.$suggestSolution  = "MMC1_CLK";
freertos_fat1.peripheralDriver.MMC.CMD.$suggestSolution  = "MMC1_CMD";
freertos_fat1.peripheralDriver.MMC.DAT0.$suggestSolution = "MMC1_DAT0";
freertos_fat1.peripheralDriver.MMC.DAT1.$suggestSolution = "MMC1_DAT1";
freertos_fat1.peripheralDriver.MMC.DAT2.$suggestSolution = "MMC1_DAT2";
freertos_fat1.peripheralDriver.MMC.DAT3.$suggestSolution = "MMC1_DAT3";
freertos_fat1.peripheralDriver.MMC.SDCD.$suggestSolution = "MMC1_SDCD";
