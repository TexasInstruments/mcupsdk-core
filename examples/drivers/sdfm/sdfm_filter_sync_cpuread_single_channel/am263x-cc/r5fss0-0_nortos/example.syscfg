/**
 * @cliArgs --device "AM263x_beta" --package "ZCZ" --part "AM263x" --context "r5fss0-0" --product "MCU_PLUS_SDK@07.03.01"
 * @versions {"tool":"1.10.0+2163"}
 */

/**
 * Import the modules used in this configuration.
 */
const epwm       = scripting.addModule("/drivers/epwm/epwm", {}, false);
const epwm1      = epwm.addInstance();
const sdfm       = scripting.addModule("/drivers/sdfm/sdfm", {}, false);
const sdfm1      = sdfm.addInstance();
const mpu_armv7  = scripting.addModule("/kernel/dpl/mpu_armv7", {}, false);
const mpu_armv71 = mpu_armv7.addInstance();
const mpu_armv72 = mpu_armv7.addInstance();
const mpu_armv73 = mpu_armv7.addInstance();
const mpu_armv74 = mpu_armv7.addInstance();
const int_xbar   = scripting.addModule("/xbar/int_xbar/int_xbar", {}, false);
const int_xbar1  = int_xbar.addInstance();

/**
 * Write custom configuration values to the imported modules.
 */
epwm1.$name                                                    = "CONFIG_EPWM0";
epwm1.epwmTimebase_emulationMode                               = "EPWM_EMULATION_FREE_RUN";
epwm1.epwmTimebase_period                                      = 65535;
epwm1.epwmTimebase_counterMode                                 = "EPWM_COUNTER_MODE_UP";
epwm1.epwmCounterCompare_cmpA                                  = 32768;
epwm1.epwmCounterCompare_cmpB                                  = 16384;
epwm1.epwmActionQualifier_EPWM_AQ_OUTPUT_A_usedEvents          = ["EPWM_AQ_OUTPUT_ON_TIMEBASE_UP_CMPA","EPWM_AQ_OUTPUT_ON_TIMEBASE_ZERO"];
epwm1.epwmActionQualifier_EPWM_AQ_OUTPUT_B_usedEvents          = ["EPWM_AQ_OUTPUT_ON_TIMEBASE_UP_CMPB","EPWM_AQ_OUTPUT_ON_TIMEBASE_ZERO"];
epwm1.epwmActionQualifier_EPWM_AQ_OUTPUT_A_ON_TIMEBASE_ZERO    = "EPWM_AQ_OUTPUT_LOW";
epwm1.epwmActionQualifier_EPWM_AQ_OUTPUT_A_ON_TIMEBASE_UP_CMPA = "EPWM_AQ_OUTPUT_HIGH";
epwm1.epwmActionQualifier_EPWM_AQ_OUTPUT_B_ON_TIMEBASE_ZERO    = "EPWM_AQ_OUTPUT_LOW";
epwm1.epwmActionQualifier_EPWM_AQ_OUTPUT_B_ON_TIMEBASE_UP_CMPB = "EPWM_AQ_OUTPUT_HIGH";
epwm1.EPWM.$assign                                             = "EPWM0";

sdfm1.$name           = "CONFIG_SDFM0";
sdfm1.SDFM.$assign    = "SDFM0";
sdfm1.SDFM.CLK0.$used = false;
sdfm1.SDFM.CLK2.$used = false;
sdfm1.SDFM.CLK3.$used = false;
sdfm1.SDFM.D0.$used   = false;
sdfm1.SDFM.D2.$used   = false;
sdfm1.SDFM.D3.$used   = false;

mpu_armv71.$name             = "CONFIG_MPU_REGION0";
mpu_armv71.size              = 31;
mpu_armv71.attributes        = "Device";
mpu_armv71.accessPermissions = "Supervisor RD+WR, User RD";
mpu_armv71.allowExecute      = false;

mpu_armv72.$name             = "CONFIG_MPU_REGION1";
mpu_armv72.size              = 15;
mpu_armv72.accessPermissions = "Supervisor RD+WR, User RD";

mpu_armv73.$name             = "CONFIG_MPU_REGION2";
mpu_armv73.baseAddr          = 0x80000;
mpu_armv73.size              = 15;
mpu_armv73.accessPermissions = "Supervisor RD+WR, User RD";

mpu_armv74.$name             = "CONFIG_MPU_REGION3";
mpu_armv74.accessPermissions = "Supervisor RD+WR, User RD";
mpu_armv74.baseAddr          = 0x70000000;
mpu_armv74.size              = 21;

int_xbar1.$name      = "CONFIG_INT_XBAR0";
int_xbar1.xbarOutput = ["SD0_FILT0_DRINT","SD0_FILT1_DRINT","SD0_FILT2_DRINT","SD0_FILT3_DRINT"];

/**
 * Pinmux solution for unlocked pins/peripherals. This ensures that minor changes to the automatic solver in a future
 * version of the tool will not impact the pinmux you originally saw.  These lines can be completely deleted in order to
 * re-solve from scratch.
 */
epwm1.EPWM.A.$suggestSolution    = "ball.B2";
epwm1.EPWM.B.$suggestSolution    = "ball.B1";
sdfm1.SDFM.CLK1.$suggestSolution = "ball.A16";
sdfm1.SDFM.D1.$suggestSolution   = "ball.D13";
