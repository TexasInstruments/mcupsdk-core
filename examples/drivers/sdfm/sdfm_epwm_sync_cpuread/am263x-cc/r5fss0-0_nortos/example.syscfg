/**
 * @cliArgs --device "AM263x_beta" --package "ZCZ" --part "AM263x" --context "r5fss0-0" --product "MCU_PLUS_SDK@07.03.01"
 * @versions {"tool":"1.14.0+2667"}
 */

/**
 * Import the modules used in this configuration.
 */
const epwm       = scripting.addModule("/drivers/epwm/epwm", {}, false);
const epwm1      = epwm.addInstance();
const epwm2      = epwm.addInstance();
const sdfm       = scripting.addModule("/drivers/sdfm/sdfm", {}, false);
const sdfm1      = sdfm.addInstance();
const debug_log  = scripting.addModule("/kernel/dpl/debug_log");
const mpu_armv7  = scripting.addModule("/kernel/dpl/mpu_armv7", {}, false);
const mpu_armv71 = mpu_armv7.addInstance();
const mpu_armv72 = mpu_armv7.addInstance();
const mpu_armv73 = mpu_armv7.addInstance();
const mpu_armv74 = mpu_armv7.addInstance();
const int_xbar   = scripting.addModule("/xbar/int_xbar/int_xbar", {}, false);
const int_xbar1  = int_xbar.addInstance();

/**
 * Write custom configuration values to the imported modules.
 */
epwm1.$name                                                    = "CONFIG_EPWM0";
epwm1.epwmTimebase_emulationMode                               = "EPWM_EMULATION_FREE_RUN";
epwm1.epwmTimebase_counterMode                                 = "EPWM_COUNTER_MODE_UP";
epwm1.epwmActionQualifier_EPWM_AQ_OUTPUT_A_usedEvents          = ["EPWM_AQ_OUTPUT_ON_TIMEBASE_UP_CMPA","EPWM_AQ_OUTPUT_ON_TIMEBASE_ZERO"];
epwm1.epwmActionQualifier_EPWM_AQ_OUTPUT_B_usedEvents          = ["EPWM_AQ_OUTPUT_ON_TIMEBASE_UP_CMPB","EPWM_AQ_OUTPUT_ON_TIMEBASE_ZERO"];
epwm1.epwmActionQualifier_EPWM_AQ_OUTPUT_A_ON_TIMEBASE_ZERO    = "EPWM_AQ_OUTPUT_LOW";
epwm1.epwmActionQualifier_EPWM_AQ_OUTPUT_A_ON_TIMEBASE_UP_CMPA = "EPWM_AQ_OUTPUT_HIGH";
epwm1.epwmActionQualifier_EPWM_AQ_OUTPUT_B_ON_TIMEBASE_ZERO    = "EPWM_AQ_OUTPUT_LOW";
epwm1.epwmActionQualifier_EPWM_AQ_OUTPUT_B_ON_TIMEBASE_UP_CMPB = "EPWM_AQ_OUTPUT_HIGH";
epwm1.epwmTimebase_period                                      = 200;
epwm1.epwmCounterCompare_cmpB                                  = 100;
epwm1.epwmCounterCompare_cmpA                                  = 50;
epwm1.EPWM.$assign                                             = "EPWM0";

epwm2.$name                                             = "CONFIG_EPWM1";
epwm2.epwmTimebase_period                               = 65535;
epwm2.epwmTimebase_counterMode                          = "EPWM_COUNTER_MODE_UP";
epwm2.epwmEventTrigger_EPWM_SOC_A_triggerEnable         = true;
epwm2.epwmEventTrigger_EPWM_SOC_A_triggerSource         = "EPWM_SOC_TBCTR_ZERO";
epwm2.epwmEventTrigger_EPWM_SOC_A_triggerEventPrescalar = "1";

sdfm1.$name = "CONFIG_SDFM0";

debug_log.enableCssLog             = false;
debug_log.enableUartLog            = true;
debug_log.uartLog.$name            = "CONFIG_UART0";
debug_log.uartLog.UART.RXD.$assign = "UART0_RXD";
debug_log.uartLog.UART.TXD.$assign = "UART0_TXD";

mpu_armv71.$name             = "CONFIG_MPU_REGION0";
mpu_armv71.size              = 31;
mpu_armv71.attributes        = "Device";
mpu_armv71.accessPermissions = "Supervisor RD+WR, User RD";
mpu_armv71.allowExecute      = false;

mpu_armv72.$name             = "CONFIG_MPU_REGION1";
mpu_armv72.size              = 15;
mpu_armv72.accessPermissions = "Supervisor RD+WR, User RD";

mpu_armv73.$name             = "CONFIG_MPU_REGION2";
mpu_armv73.baseAddr          = 0x80000;
mpu_armv73.size              = 15;
mpu_armv73.accessPermissions = "Supervisor RD+WR, User RD";

mpu_armv74.$name             = "CONFIG_MPU_REGION3";
mpu_armv74.accessPermissions = "Supervisor RD+WR, User RD";
mpu_armv74.baseAddr          = 0x70000000;
mpu_armv74.size              = 21;

int_xbar1.$name      = "CONFIG_INT_XBAR0";
int_xbar1.xbarOutput = ["SD0_FILT0_DRINT","SD0_FILT1_DRINT","SD0_FILT2_DRINT","SD0_FILT3_DRINT"];

/**
 * Pinmux solution for unlocked pins/peripherals. This ensures that minor changes to the automatic solver in a future
 * version of the tool will not impact the pinmux you originally saw.  These lines can be completely deleted in order to
 * re-solve from scratch.
 */
epwm1.EPWM.A.$suggestSolution           = "EPWM0_A";
epwm1.EPWM.B.$suggestSolution           = "EPWM0_B";
epwm2.EPWM.$suggestSolution             = "EPWM1";
epwm2.EPWM.A.$suggestSolution           = "EPWM1_A";
epwm2.EPWM.B.$suggestSolution           = "EPWM1_B";
sdfm1.SDFM.$suggestSolution             = "SDFM0";
sdfm1.SDFM.CLK0.$suggestSolution        = "SDFM0_CLK0";
sdfm1.SDFM.CLK1.$suggestSolution        = "SDFM0_CLK1";
sdfm1.SDFM.CLK2.$suggestSolution        = "SDFM0_CLK2";
sdfm1.SDFM.CLK3.$suggestSolution        = "SDFM0_CLK3";
sdfm1.SDFM.D0.$suggestSolution          = "SDFM0_D0";
sdfm1.SDFM.D1.$suggestSolution          = "SDFM0_D1";
sdfm1.SDFM.D2.$suggestSolution          = "SDFM0_D2";
sdfm1.SDFM.D3.$suggestSolution          = "SDFM0_D3";
debug_log.uartLog.UART.$suggestSolution = "UART0";
