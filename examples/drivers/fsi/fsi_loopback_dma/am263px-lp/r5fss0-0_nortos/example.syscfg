/**
 * @cliArgs --device "AM263Px" --package "ZCZ_S" --part "AM263P2" --context "r5fss0-0" --product "MCU_PLUS_SDK@07.03.01"
 * @versions {"tool":"1.15.0+2826"}
 */

/**
 * Import the modules used in this configuration.
 */
const edma           = scripting.addModule("/drivers/edma/edma", {}, false);
const edma1          = edma.addInstance();
const fsi_rx         = scripting.addModule("/drivers/fsi_rx/fsi_rx", {}, false);
const fsi_rx1        = fsi_rx.addInstance();
const fsi_tx         = scripting.addModule("/drivers/fsi_tx/fsi_tx", {}, false);
const fsi_tx1        = fsi_tx.addInstance();
const debug_log      = scripting.addModule("/kernel/dpl/debug_log");
const mpu_armv7      = scripting.addModule("/kernel/dpl/mpu_armv7", {}, false);
const mpu_armv71     = mpu_armv7.addInstance();
const mpu_armv72     = mpu_armv7.addInstance();
const mpu_armv73     = mpu_armv7.addInstance();
const mpu_armv74     = mpu_armv7.addInstance();
const mpu_armv75     = mpu_armv7.addInstance();
const mpu_armv76     = mpu_armv7.addInstance();
const dma_trig_xbar  = scripting.addModule("/xbar/dma_trig_xbar/dma_trig_xbar", {}, false);
const dma_trig_xbar1 = dma_trig_xbar.addInstance();
const dma_trig_xbar2 = dma_trig_xbar.addInstance();
const dma_trig_xbar3 = dma_trig_xbar.addInstance();
const dma_trig_xbar4 = dma_trig_xbar.addInstance();

/**
 * Write custom configuration values to the imported modules.
 */
edma1.$name                 = "CONFIG_EDMA0";
edma1.edmaRmDmaCh[0].$name  = "CONFIG_EDMA_RM0";
edma1.edmaRmQdmaCh[0].$name = "CONFIG_EDMA_RM1";
edma1.edmaRmTcc[0].$name    = "CONFIG_EDMA_RM2";
edma1.edmaRmParam[0].$name  = "CONFIG_EDMA_RM3";

fsi_rx1.$name         = "CONFIG_FSI_RX0";
fsi_rx1.intrEnable    = false;
fsi_rx1.FSIRX.$assign = "FSIRX0";

fsi_tx1.$name             = "CONFIG_FSI_TX0";
fsi_tx1.intrEnable        = false;
fsi_tx1.FSITX.$assign     = "FSITX0";
fsi_tx1.FSITX.CLK.$assign = "ball.R17";

debug_log.enableUartLog            = true;
debug_log.uartLog.$name            = "CONFIG_UART_CONSOLE";
debug_log.uartLog.UART.$assign     = "UART0";
debug_log.uartLog.UART.RXD.$assign = "ball.A7";
debug_log.uartLog.UART.TXD.$assign = "ball.A6";

mpu_armv71.$name             = "CONFIG_MPU_REGION0";
mpu_armv71.size              = 31;
mpu_armv71.attributes        = "Device";
mpu_armv71.accessPermissions = "Supervisor RD+WR, User RD";
mpu_armv71.allowExecute      = false;

mpu_armv72.$name             = "CONFIG_MPU_REGION1";
mpu_armv72.size              = 15;
mpu_armv72.accessPermissions = "Supervisor RD+WR, User RD";

mpu_armv73.$name             = "CONFIG_MPU_REGION2";
mpu_armv73.baseAddr          = 0x41010000;
mpu_armv73.size              = 15;
mpu_armv73.accessPermissions = "Supervisor RD+WR, User RD";

mpu_armv74.$name             = "CONFIG_MPU_REGION3";
mpu_armv74.baseAddr          = 0x70000000;
mpu_armv74.size              = 21;
mpu_armv74.accessPermissions = "Supervisor RD+WR, User RD";

mpu_armv75.$name             = "CONFIG_MPU_REGION4";
mpu_armv75.baseAddr          = 0x60000000;
mpu_armv75.size              = 28;
mpu_armv75.accessPermissions = "Supervisor RD, User RD";

mpu_armv76.$name    = "CONFIG_MPU_REGION5";
mpu_armv76.baseAddr = 0x80000000;
mpu_armv76.size     = 31;

dma_trig_xbar1.$name            = "CONFIG_DMA_TRIG_XBAR0";
dma_trig_xbar1.xbarOutput       = "FSI0_TX_DMA_EVT";
dma_trig_xbar1.xbarConfig.$name = "CONFIG_DMA_XBAR0";

dma_trig_xbar2.$name               = "CONFIG_DMA_TRIG_XBAR1";
dma_trig_xbar2.instance            = "DMA_TRIG_XBAR_EDMA_MODULE_1";
dma_trig_xbar2.xbarOutput          = "FSI0_TX_DMA_EVT";
dma_trig_xbar2.xbarConfig.$name    = "CONFIG_DMA_XBAR1";
dma_trig_xbar2.xbarConfig.instance = "DMA_XBAR_DMA_TRIG_XBAR_1";

dma_trig_xbar3.$name               = "CONFIG_DMA_TRIG_XBAR2";
dma_trig_xbar3.xbarOutput          = "FSI0_RX_DMA_EVT";
dma_trig_xbar3.instance            = "DMA_TRIG_XBAR_EDMA_MODULE_2";
dma_trig_xbar3.xbarConfig.$name    = "CONFIG_DMA_XBAR2";
dma_trig_xbar3.xbarConfig.instance = "DMA_XBAR_DMA_TRIG_XBAR_2";

dma_trig_xbar4.$name               = "CONFIG_DMA_TRIG_XBAR3";
dma_trig_xbar4.instance            = "DMA_TRIG_XBAR_EDMA_MODULE_3";
dma_trig_xbar4.xbarOutput          = "FSI0_RX_DMA_EVT";
dma_trig_xbar4.xbarConfig.$name    = "CONFIG_DMA_XBAR4";
dma_trig_xbar4.xbarConfig.instance = "DMA_XBAR_DMA_TRIG_XBAR_3";

/**
 * Pinmux solution for unlocked pins/peripherals. This ensures that minor changes to the automatic solver in a future
 * version of the tool will not impact the pinmux you originally saw.  These lines can be completely deleted in order to
 * re-solve from scratch.
 */
fsi_rx1.FSIRX.CLK.$suggestSolution = "ball.A10";
fsi_rx1.FSIRX.D0.$suggestSolution  = "ball.B10";
fsi_rx1.FSIRX.D1.$suggestSolution  = "ball.D9";
fsi_tx1.FSITX.D0.$suggestSolution  = "ball.C10";
fsi_tx1.FSITX.D1.$suggestSolution  = "ball.B11";
