/**
 * @cliArgs --device "AWR294X" --package "ETS" --part "Default" --context "c66ss0" --product "MCU_PLUS_SDK@07.03.01"
 * @versions {"tool":"1.10.0+2123"}
 */

/**
 * Import the modules used in this configuration.
 */
const edma      = scripting.addModule("/drivers/edma/edma", {}, false);
const edma1     = edma.addInstance();
const edma2     = edma.addInstance();
const uart      = scripting.addModule("/drivers/uart/uart", {}, false);
const uart1     = uart.addInstance();
const cache_c6x = scripting.addModule("/kernel/dpl/cache_c6x");
const debug_log = scripting.addModule("/kernel/dpl/debug_log");
const dpl_cfg = scripting.addModule("/kernel/dpl/dpl_cfg");

/**
 * Write custom configuration values to the imported modules.
 */
edma1.$name                        = "CONFIG_EDMA0";
edma1.edmaRmDmaCh[0].$name         = "CONFIG_EDMA_RM0";
edma1.edmaRmQdmaCh[0].$name        = "CONFIG_EDMA_RM1";
edma1.edmaRmTcc[0].$name           = "CONFIG_EDMA_RM2";
edma1.edmaRmParam[0].$name         = "CONFIG_EDMA_RM3";
edma1.edmaRmReservedDmaCh[0].$name = "CONFIG_EDMA_RM4";

uart1.intrEnable          = "DMA";
uart1.$name               = "CONFIG_UART_CONSOLE";
uart1.DSS_UART.RX.$assign = "ball.B14";
uart1.DSS_UART.TX.$assign = "ball.A15";

edma2.$name                        = "CONFIG_EDMA1";
edma2.instance                     = "EDMA_DSS_B";
uart1.edmaConfig                   = edma2;
edma2.edmaRmDmaCh[0].$name         = "CONFIG_EDMA_RM5";
edma2.edmaRmDmaCh[0].resourceType  = scripting.forceWrite("ownDmaCh");
edma2.edmaRmQdmaCh[0].$name        = "CONFIG_EDMA_RM6";
edma2.edmaRmTcc[0].$name           = "CONFIG_EDMA_RM7";
edma2.edmaRmParam[0].$name         = "CONFIG_EDMA_RM8";
edma2.edmaRmReservedDmaCh[0].$name = "CONFIG_EDMA_RM9";

cache_c6x.marRegionConfig.create(2);
cache_c6x.marRegionConfig[0].$name    = "kernel_dpl_cache_c6x_mar0";
cache_c6x.marRegionConfig[0].baseAddr = 0xC5000000;
cache_c6x.marRegionConfig[1].$name    = "kernel_dpl_cache_c6x_mar1";
cache_c6x.marRegionConfig[1].baseAddr = 0x83000000;

/**
 * Pinmux solution for unlocked pins/peripherals. This ensures that minor changes to the automatic solver in a future
 * version of the tool will not impact the pinmux you originally saw.  These lines can be completely deleted in order to
 * re-solve from scratch.
 */
uart1.DSS_UART.$suggestSolution = "DSS_UARTA";
