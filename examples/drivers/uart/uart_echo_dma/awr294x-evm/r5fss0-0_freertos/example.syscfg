/**
 * @cliArgs --device "AWR294X" --package "ETS" --part "Default" --context "r5fss0-0" --product "MCU_PLUS_SDK@07.03.01"
 * @versions {"tool":"1.10.0+2123"}
 */

/**
 * Import the modules used in this configuration.
 */
const edma       = scripting.addModule("/drivers/edma/edma", {}, false);
const edma1      = edma.addInstance();
const edma2      = edma.addInstance();
const uart       = scripting.addModule("/drivers/uart/uart", {}, false);
const uart1      = uart.addInstance();
const clock      = scripting.addModule("/kernel/dpl/clock");
const debug_log  = scripting.addModule("/kernel/dpl/debug_log");
const dpl_cfg = scripting.addModule("/kernel/dpl/dpl_cfg");
const mpu_armv7  = scripting.addModule("/kernel/dpl/mpu_armv7", {}, false);
const mpu_armv71 = mpu_armv7.addInstance();
const mpu_armv72 = mpu_armv7.addInstance();
const mpu_armv73 = mpu_armv7.addInstance();
const mpu_armv74 = mpu_armv7.addInstance();
const mpu_armv75 = mpu_armv7.addInstance();
const mpu_armv76 = mpu_armv7.addInstance();

/**
 * Write custom configuration values to the imported modules.
 */
edma1.$name                        = "CONFIG_EDMA0";
edma1.edmaRmDmaCh[0].$name         = "CONFIG_EDMA_RM0";
edma1.edmaRmQdmaCh[0].$name        = "CONFIG_EDMA_RM1";
edma1.edmaRmTcc[0].$name           = "CONFIG_EDMA_RM2";
edma1.edmaRmParam[0].$name         = "CONFIG_EDMA_RM3";
edma1.edmaRmReservedDmaCh[0].$name = "CONFIG_EDMA_RM4";

uart1.intrEnable      = "DMA";
uart1.$name           = "CONFIG_UART_CONSOLE";
uart1.UART.$assign    = "UARTA";
uart1.UART.RX.$assign = "ball.B16";
uart1.UART.TX.$assign = "ball.C16";

edma2.$name                        = "CONFIG_EDMA1";
edma2.instance                     = "EDMA_MSS_A";
uart1.edmaConfig                   = edma2;
edma2.edmaRmDmaCh[0].$name         = "CONFIG_EDMA_RM5";
edma2.edmaRmDmaCh[0].resourceType  = scripting.forceWrite("ownDmaCh");
edma2.edmaRmDmaCh[0].endIndex      = 63;
edma2.edmaRmQdmaCh[0].$name        = "CONFIG_EDMA_RM6";
edma2.edmaRmTcc[0].$name           = "CONFIG_EDMA_RM7";
edma2.edmaRmParam[0].$name         = "CONFIG_EDMA_RM8";
edma2.edmaRmReservedDmaCh[0].$name = "CONFIG_EDMA_RM9";

mpu_armv71.$name        = "CONFIG_MPU_REGION0";
mpu_armv71.attributes   = "Device";
mpu_armv71.allowExecute = false;

mpu_armv72.$name = "CONFIG_MPU_REGION1";
mpu_armv72.size  = 14;

mpu_armv73.$name    = "CONFIG_MPU_REGION2";
mpu_armv73.baseAddr = 0x80000;
mpu_armv73.size     = 14;

mpu_armv74.$name    = "CONFIG_MPU_REGION3";
mpu_armv74.baseAddr = 0x10200000;
mpu_armv74.size     = 20;

mpu_armv75.$name        = "CONFIG_MPU_REGION4";
mpu_armv75.baseAddr     = 0x102E0000;
mpu_armv75.size         = 16;
mpu_armv75.attributes   = "NonCached";
mpu_armv75.allowExecute = false;

mpu_armv76.$name        = "CONFIG_MPU_REGION5";
mpu_armv76.baseAddr     = 0xC5000000;
mpu_armv76.size         = 13;
mpu_armv76.attributes   = "NonCached";
mpu_armv76.allowExecute = false;
