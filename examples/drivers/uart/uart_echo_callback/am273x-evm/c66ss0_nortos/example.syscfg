/**
 * @cliArgs --device "AM273x" --package "ZCE" --part "Default" --context "c66ss0" --product "MCU_PLUS_SDK@07.03.01"
 * @versions {"tool":"1.9.0+2015","templates":null}
 */

/**
 * Import the modules used in this configuration.
 */
const uart      = scripting.addModule("/drivers/uart/uart", {}, false);
const uart1     = uart.addInstance();
const cache_c6x = scripting.addModule("/kernel/dpl/cache_c6x");
const debug_log = scripting.addModule("/kernel/dpl/debug_log");

/**
 * Write custom configuration values to the imported modules.
 */
uart1.$name               = "CONFIG_UART_CONSOLE";
uart1.readMode            = "CALLBACK";
uart1.writeMode           = "CALLBACK";
uart1.readCallbackFxn     = "uart_echo_read_callback";
uart1.writeCallbackFxn    = "uart_echo_write_callback";
uart1.DSS_UART.RX.$assign = "ball.H19";
uart1.DSS_UART.TX.$assign = "ball.J19";

/**
 * Pinmux solution for unlocked pins/peripherals. This ensures that minor changes to the automatic solver in a future
 * version of the tool will not impact the pinmux you originally saw.  These lines can be completely deleted in order to
 * re-solve from scratch.
 */
uart1.DSS_UART.$suggestSolution = "DSS_UARTA";
