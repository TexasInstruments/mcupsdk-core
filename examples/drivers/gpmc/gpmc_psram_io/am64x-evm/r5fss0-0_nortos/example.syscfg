/**
 * @cliArgs --device "AM64x" --package "ALV" --part "Default" --context "r5fss0-0" --product "MCU_PLUS_SDK@07.03.01"
 * @versions {"tool":"1.20.0+3587"}
 */

/**
 * Import the modules used in this configuration.
 */
const ram             = scripting.addModule("/board/ram/ram", {}, false);
const ram1            = ram.addInstance();
const debug_log       = scripting.addModule("/kernel/dpl/debug_log");
const dpl_cfg = scripting.addModule("/kernel/dpl/dpl_cfg");
const mpu_armv7       = scripting.addModule("/kernel/dpl/mpu_armv7", {}, false);
const mpu_armv71      = mpu_armv7.addInstance();
const mpu_armv72      = mpu_armv7.addInstance();
const mpu_armv73      = mpu_armv7.addInstance();
const mpu_armv74      = mpu_armv7.addInstance();
const mpu_armv75      = mpu_armv7.addInstance();
const mpu_armv76      = mpu_armv7.addInstance();
const mpu_armv77      = mpu_armv7.addInstance();
const mpu_armv78      = mpu_armv7.addInstance();
const mpu_armv79      = mpu_armv7.addInstance();
const mpu_armv710     = mpu_armv7.addInstance();
const default_linker  = scripting.addModule("/memory_configurator/default_linker", {}, false);
const default_linker1 = default_linker.addInstance();
const general         = scripting.addModule("/memory_configurator/general", {}, false);
const general1        = general.addInstance();
const region          = scripting.addModule("/memory_configurator/region", {}, false);
const region1         = region.addInstance();
const section         = scripting.addModule("/memory_configurator/section", {}, false);
const section1        = section.addInstance();
const section2        = section.addInstance();
const section3        = section.addInstance();
const section4        = section.addInstance();
const section5        = section.addInstance();
const section6        = section.addInstance();
const section7        = section.addInstance();
const section8        = section.addInstance();
const section9        = section.addInstance();
const section10       = section.addInstance();
const section11       = section.addInstance();
const section12       = section.addInstance();

/**
 * Write custom configuration values to the imported modules.
 */
ram1.$name                                                    = "CONFIG_RAM0";
ram1.parallelRamDriver.$name                                  = "board_ram_parallelRam_parallelram0";
ram1.parallelRamDriver.sleepEnGpioDriver.GPIO.gpioPin.rx      = false;
ram1.parallelRamDriver.sleepEnGpioDriver.GPIO.gpioPin.$assign = "PRG0_PRU0_GPO3";
ram1.parallelRamDriver.psramDriver.$name                      = "CONFIG_GPMC0";
ram1.parallelRamDriver.psramDriver.dmaEnable                  = false;
ram1.parallelRamDriver.psramDriver.GPMC.A1.$assign            = "PRG0_PRU0_GPO4";

debug_log.enableUartLog        = true;
debug_log.uartLog.$name        = "CONFIG_UART_CONSOLE";
debug_log.uartLog.UART.$assign = "USART0";

const uart_v0_template  = scripting.addModule("/drivers/uart/v0/uart_v0_template", {}, false);
const uart_v0_template1 = uart_v0_template.addInstance({}, false);
uart_v0_template1.$name = "drivers_uart_v0_uart_v0_template0";
debug_log.uartLog.child = uart_v0_template1;

mpu_armv71.$name             = "CONFIG_MPU_REGION0";
mpu_armv71.size              = 31;
mpu_armv71.attributes        = "Device";
mpu_armv71.allowExecute      = false;
mpu_armv71.accessPermissions = "Supervisor RD+WR, User RD";

mpu_armv72.$name             = "CONFIG_MPU_REGION1";
mpu_armv72.size              = 15;
mpu_armv72.accessPermissions = "Supervisor RD+WR, User RD";

mpu_armv73.$name             = "CONFIG_MPU_REGION2";
mpu_armv73.baseAddr          = 0x41010000;
mpu_armv73.size              = 15;
mpu_armv73.accessPermissions = "Supervisor RD+WR, User RD";

mpu_armv74.$name             = "CONFIG_MPU_REGION3";
mpu_armv74.accessPermissions = "Supervisor RD+WR, User RD";
mpu_armv74.baseAddr          = 0x70000000;
mpu_armv74.size              = 21;

mpu_armv75.$name             = "CONFIG_MPU_REGION4";
mpu_armv75.baseAddr          = 0x60000000;
mpu_armv75.size              = 28;
mpu_armv75.accessPermissions = "Supervisor RD, User RD";

mpu_armv76.$name    = "CONFIG_MPU_REGION5";
mpu_armv76.baseAddr = 0x80000000;
mpu_armv76.size     = 31;

mpu_armv77.$name        = "CONFIG_MPU_REGION6";
mpu_armv77.baseAddr     = 0x3B000000;
mpu_armv77.size         = 10;
mpu_armv77.attributes   = "Device";
mpu_armv77.allowExecute = false;

mpu_armv78.$name        = "CONFIG_MPU_REGION7";
mpu_armv78.baseAddr     = 0x25010000;
mpu_armv78.size         = 12;
mpu_armv78.allowExecute = false;
mpu_armv78.attributes   = "Device";

mpu_armv79.$name        = "CONFIG_MPU_REGION8";
mpu_armv79.baseAddr     = 0x50000000;
mpu_armv79.size         = 27;
mpu_armv79.allowExecute = false;
mpu_armv79.attributes   = "Device";

mpu_armv710.$name      = "CONFIG_MPU_REGION9";
mpu_armv710.baseAddr   = 0x80000000;
mpu_armv710.size       = 25;
mpu_armv710.attributes = "NonCached";

default_linker1.$name = "memory_configurator_default_linker0";

general1.$name        = "CONFIG_GENERAL0";
general1.linker.$name = "TIARMCLANG0";

region1.$name                               = "MEMORY_REGION_CONFIGURATION0";
region1.memory_region.create(10);
region1.memory_region[0].type               = "TCMA_R5F";
region1.memory_region[0].$name              = "R5F_VECS";
region1.memory_region[0].size               = 0x40;
region1.memory_region[0].auto               = false;
region1.memory_region[1].type               = "TCMA_R5F";
region1.memory_region[1].$name              = "R5F_TCMA";
region1.memory_region[1].size               = 0x7FC0;
region1.memory_region[2].type               = "TCMB_R5F";
region1.memory_region[2].$name              = "R5F_TCMB0";
region1.memory_region[2].size               = 0x8000;
region1.memory_region[3].$name              = "NON_CACHE_MEM";
region1.memory_region[3].auto               = false;
region1.memory_region[3].manualStartAddress = 0x70060000;
region1.memory_region[3].size               = 0x8000;
region1.memory_region[4].$name              = "MSRAM";
region1.memory_region[4].auto               = false;
region1.memory_region[4].manualStartAddress = 0x70080000;
region1.memory_region[4].size               = 0x50000;
region1.memory_region[5].type               = "FLASH";
region1.memory_region[5].$name              = "FLASH";
region1.memory_region[5].auto               = false;
region1.memory_region[5].manualStartAddress = 0x60100000;
region1.memory_region[5].size               = 0x80000;
region1.memory_region[6].$name              = "USER_SHM_MEM";
region1.memory_region[6].auto               = false;
region1.memory_region[6].manualStartAddress = 0x701D0000;
region1.memory_region[6].size               = 0x80;
region1.memory_region[6].isShared           = true;
region1.memory_region[6].shared_cores       = ["a53ss0-0","a53ss0-1","m4fss0-0","r5fss0-1","r5fss1-0","r5fss1-1"];
region1.memory_region[7].auto               = false;
region1.memory_region[7].manualStartAddress = 0x701D0080;
region1.memory_region[7].size               = 0x3F80;
region1.memory_region[7].$name              = "LOG_SHM_MEM";
region1.memory_region[7].isShared           = true;
region1.memory_region[7].shared_cores       = ["a53ss0-0","a53ss0-1","m4fss0-0","r5fss0-1","r5fss1-0","r5fss1-1"];
region1.memory_region[8].auto               = false;
region1.memory_region[8].manualStartAddress = 0x701D4000;
region1.memory_region[8].size               = 0xC000;
region1.memory_region[8].$name              = "RTOS_NORTOS_IPC_SHM_MEM";
region1.memory_region[8].isShared           = true;
region1.memory_region[8].shared_cores       = ["a53ss0-0","a53ss0-1","m4fss0-0","r5fss0-1","r5fss1-0","r5fss1-1"];
region1.memory_region[9].type               = "DDR_ALL";
region1.memory_region[9].size               = 0x1000000;
region1.memory_region[9].$name              = "DDR_0";

section1.$name                        = "Vector Table";
section1.load_memory                  = "R5F_VECS";
section1.group                        = false;
section1.output_section.create(1);
section1.output_section[0].$name      = ".vectors";
section1.output_section[0].palignment = true;

section2.$name                        = "Text Segments";
section2.load_memory                  = "MSRAM";
section2.output_section.create(5);
section2.output_section[0].$name      = ".text.hwi";
section2.output_section[0].palignment = true;
section2.output_section[1].$name      = ".text.cache";
section2.output_section[1].palignment = true;
section2.output_section[2].$name      = ".text.mpu";
section2.output_section[2].palignment = true;
section2.output_section[3].$name      = ".text.boot";
section2.output_section[3].palignment = true;
section2.output_section[4].$name      = ".text:abort";
section2.output_section[4].palignment = true;

section3.$name                        = "Code and Read-Only Data";
section3.load_memory                  = "MSRAM";
section3.output_section.create(2);
section3.output_section[0].$name      = ".text";
section3.output_section[0].palignment = true;
section3.output_section[1].$name      = ".rodata";
section3.output_section[1].palignment = true;

section4.$name                        = "Data Segment";
section4.load_memory                  = "MSRAM";
section4.output_section.create(1);
section4.output_section[0].$name      = ".data";
section4.output_section[0].palignment = true;

section5.$name                                   = "Memory Segments";
section5.load_memory                             = "MSRAM";
section5.output_section.create(3);
section5.output_section[0].$name                 = ".bss";
section5.output_section[0].palignment            = true;
section5.output_section[0].output_sections_start = "__BSS_START";
section5.output_section[0].output_sections_end   = "__BSS_END";
section5.output_section[1].$name                 = ".sysmem";
section5.output_section[1].palignment            = true;
section5.output_section[2].$name                 = ".stack";
section5.output_section[2].palignment            = true;

section6.$name                                    = "Stack Segments";
section6.load_memory                              = "MSRAM";
section6.output_section.create(5);
section6.output_section[0].$name                  = ".irqstack";
section6.output_section[0].output_sections_start  = "__IRQ_STACK_START";
section6.output_section[0].output_sections_end    = "__IRQ_STACK_END";
section6.output_section[0].input_section.create(1);
section6.output_section[0].input_section[0].$name = ". = . + __IRQ_STACK_SIZE;";
section6.output_section[1].$name                  = ".fiqstack";
section6.output_section[1].output_sections_start  = "__FIQ_STACK_START";
section6.output_section[1].output_sections_end    = "__FIQ_STACK_END";
section6.output_section[1].input_section.create(1);
section6.output_section[1].input_section[0].$name = ". = . + __FIQ_STACK_SIZE;";
section6.output_section[2].$name                  = ".svcstack";
section6.output_section[2].output_sections_start  = "__SVC_STACK_START";
section6.output_section[2].output_sections_end    = "__SVC_STACK_END";
section6.output_section[2].input_section.create(1);
section6.output_section[2].input_section[0].$name = ". = . + __SVC_STACK_SIZE;";
section6.output_section[3].$name                  = ".abortstack";
section6.output_section[3].output_sections_start  = "__ABORT_STACK_START";
section6.output_section[3].output_sections_end    = "__ABORT_STACK_END";
section6.output_section[3].input_section.create(1);
section6.output_section[3].input_section[0].$name = ". = . + __ABORT_STACK_SIZE;";
section6.output_section[4].$name                  = ".undefinedstack";
section6.output_section[4].output_sections_start  = "__UNDEFINED_STACK_START";
section6.output_section[4].output_sections_end    = "__UNDEFINED_STACK_END";
section6.output_section[4].input_section.create(1);
section6.output_section[4].input_section[0].$name = ". = . + __UNDEFINED_STACK_SIZE;";

section7.$name                        = "Initialization and Exception Handling";
section7.load_memory                  = "MSRAM";
section7.output_section.create(3);
section7.output_section[0].$name      = ".ARM.exidx";
section7.output_section[0].palignment = true;
section7.output_section[1].$name      = ".init_array";
section7.output_section[1].palignment = true;
section7.output_section[2].$name      = ".fini_array";
section7.output_section[2].palignment = true;

section8.$name                       = "User Shared Memory";
section8.type                        = "NOLOAD";
section8.load_memory                 = "USER_SHM_MEM";
section8.group                       = false;
section8.output_section.create(1);
section8.output_section[0].$name     = ".bss.user_shared_mem";
section8.output_section[0].alignment = 0;

section9.$name                       = "Log Shared Memory";
section9.load_memory                 = "LOG_SHM_MEM";
section9.type                        = "NOLOAD";
section9.group                       = false;
section9.output_section.create(1);
section9.output_section[0].$name     = ".bss.log_shared_mem";
section9.output_section[0].alignment = 0;

section10.$name                       = "IPC Shared Memory";
section10.type                        = "NOLOAD";
section10.load_memory                 = "RTOS_NORTOS_IPC_SHM_MEM";
section10.group                       = false;
section10.output_section.create(1);
section10.output_section[0].$name     = ".bss.ipc_vring_mem";
section10.output_section[0].alignment = 0;

section11.$name                       = "Non Cacheable Memory";
section11.load_memory                 = "NON_CACHE_MEM";
section11.group                       = false;
section11.type                        = "NOLOAD";
section11.output_section.create(1);
section11.output_section[0].$name     = ".bss.nocache";
section11.output_section[0].alignment = 0;

section12.load_memory             = "DDR_0";
section12.$name                   = "DDR Memory";
section12.output_section.create(1);
section12.output_section[0].$name = "ddr_data";

/**
 * Pinmux solution for unlocked pins/peripherals. This ensures that minor changes to the automatic solver in a future
 * version of the tool will not impact the pinmux you originally saw.  These lines can be completely deleted in order to
 * re-solve from scratch.
 */
ram1.parallelRamDriver.sleepEnGpioDriver.GPIO.$suggestSolution    = "GPIO1";
ram1.parallelRamDriver.psramDriver.GPMC.$suggestSolution          = "GPMC0";
ram1.parallelRamDriver.psramDriver.GPMC.OEn_REn.$suggestSolution  = "GPMC0_OEn_REn";
ram1.parallelRamDriver.psramDriver.GPMC.ADVn_ALE.$suggestSolution = "GPMC0_ADVn_ALE";
ram1.parallelRamDriver.psramDriver.GPMC.WEn.$suggestSolution      = "GPMC0_WEn";
ram1.parallelRamDriver.psramDriver.GPMC.CSn0.$suggestSolution     = "GPMC0_CSn0";
ram1.parallelRamDriver.psramDriver.GPMC.BE0n_CLE.$suggestSolution = "GPMC0_BE0n_CLE";
ram1.parallelRamDriver.psramDriver.GPMC.AD0.$suggestSolution      = "GPMC0_AD0";
ram1.parallelRamDriver.psramDriver.GPMC.AD1.$suggestSolution      = "GPMC0_AD1";
ram1.parallelRamDriver.psramDriver.GPMC.AD2.$suggestSolution      = "GPMC0_AD2";
ram1.parallelRamDriver.psramDriver.GPMC.AD3.$suggestSolution      = "GPMC0_AD3";
ram1.parallelRamDriver.psramDriver.GPMC.AD4.$suggestSolution      = "GPMC0_AD4";
ram1.parallelRamDriver.psramDriver.GPMC.AD5.$suggestSolution      = "GPMC0_AD5";
ram1.parallelRamDriver.psramDriver.GPMC.AD6.$suggestSolution      = "GPMC0_AD6";
ram1.parallelRamDriver.psramDriver.GPMC.AD7.$suggestSolution      = "GPMC0_AD7";
ram1.parallelRamDriver.psramDriver.GPMC.WAIT0.$suggestSolution    = "GPMC0_WAIT0";
ram1.parallelRamDriver.psramDriver.GPMC.BE1n.$suggestSolution     = "GPMC0_BE1n";
ram1.parallelRamDriver.psramDriver.GPMC.A2.$suggestSolution       = "PRG0_PRU0_GPO8";
ram1.parallelRamDriver.psramDriver.GPMC.A3.$suggestSolution       = "PRG0_PRU0_GPO14";
ram1.parallelRamDriver.psramDriver.GPMC.A4.$suggestSolution       = "PRG0_PRU0_GPO16";
ram1.parallelRamDriver.psramDriver.GPMC.A5.$suggestSolution       = "PRG0_PRU0_GPO18";
ram1.parallelRamDriver.psramDriver.GPMC.A6.$suggestSolution       = "PRG0_PRU0_GPO19";
ram1.parallelRamDriver.psramDriver.GPMC.A7.$suggestSolution       = "PRG0_PRU1_GPO12";
ram1.parallelRamDriver.psramDriver.GPMC.A8.$suggestSolution       = "PRG0_PRU1_GPO13";
ram1.parallelRamDriver.psramDriver.GPMC.A9.$suggestSolution       = "PRG0_PRU1_GPO14";
ram1.parallelRamDriver.psramDriver.GPMC.A10.$suggestSolution      = "PRG0_PRU1_GPO15";
ram1.parallelRamDriver.psramDriver.GPMC.A11.$suggestSolution      = "PRG0_PRU1_GPO16";
ram1.parallelRamDriver.psramDriver.GPMC.A12.$suggestSolution      = "PRG0_MDIO0_MDIO";
ram1.parallelRamDriver.psramDriver.GPMC.A13.$suggestSolution      = "PRG0_MDIO0_MDC";
ram1.parallelRamDriver.psramDriver.GPMC.A14.$suggestSolution      = "PRG0_PRU0_GPO12";
ram1.parallelRamDriver.psramDriver.GPMC.A15.$suggestSolution      = "PRG0_PRU0_GPO13";
ram1.parallelRamDriver.psramDriver.GPMC.A16.$suggestSolution      = "PRG0_PRU0_GPO15";
ram1.parallelRamDriver.psramDriver.GPMC.A17.$suggestSolution      = "PRG0_PRU0_GPO17";
ram1.parallelRamDriver.psramDriver.GPMC.A18.$suggestSolution      = "PRG0_PRU1_GPO3";
ram1.parallelRamDriver.psramDriver.GPMC.A19.$suggestSolution      = "PRG0_PRU1_GPO6";
ram1.parallelRamDriver.psramDriver.GPMC.A20.$suggestSolution      = "GPMC0_CSn3";
ram1.parallelRamDriver.psramDriver.GPMC.A21.$suggestSolution      = "GPMC0_WAIT1";
ram1.parallelRamDriver.psramDriver.GPMC.AD8.$suggestSolution      = "GPMC0_AD8";
ram1.parallelRamDriver.psramDriver.GPMC.AD9.$suggestSolution      = "GPMC0_AD9";
ram1.parallelRamDriver.psramDriver.GPMC.AD10.$suggestSolution     = "GPMC0_AD10";
ram1.parallelRamDriver.psramDriver.GPMC.AD11.$suggestSolution     = "GPMC0_AD11";
ram1.parallelRamDriver.psramDriver.GPMC.AD12.$suggestSolution     = "GPMC0_AD12";
ram1.parallelRamDriver.psramDriver.GPMC.AD13.$suggestSolution     = "GPMC0_AD13";
ram1.parallelRamDriver.psramDriver.GPMC.AD14.$suggestSolution     = "GPMC0_AD14";
ram1.parallelRamDriver.psramDriver.GPMC.AD15.$suggestSolution     = "GPMC0_AD15";
debug_log.uartLog.UART.RXD.$suggestSolution                       = "UART0_RXD";
debug_log.uartLog.UART.TXD.$suggestSolution                       = "UART0_TXD";
