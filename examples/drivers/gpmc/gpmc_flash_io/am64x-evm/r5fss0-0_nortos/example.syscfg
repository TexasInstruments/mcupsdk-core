/**
 * @cliArgs --device "AM64x" --package "ALV" --part "Default" --context "r5fss0-0" --product "MCU_PLUS_SDK@07.03.01"
 * @versions {"tool":"1.14.0+2667"}
 */

/**
 * Import the modules used in this configuration.
 */
const gpmc       = scripting.addModule("/drivers/gpmc/gpmc", {}, false);
const gpmc1      = gpmc.addInstance();
const debug_log  = scripting.addModule("/kernel/dpl/debug_log");
const mpu_armv7  = scripting.addModule("/kernel/dpl/mpu_armv7", {}, false);
const mpu_armv71 = mpu_armv7.addInstance();
const mpu_armv72 = mpu_armv7.addInstance();
const mpu_armv73 = mpu_armv7.addInstance();
const mpu_armv74 = mpu_armv7.addInstance();
const mpu_armv75 = mpu_armv7.addInstance();
const mpu_armv76 = mpu_armv7.addInstance();
const mpu_armv77 = mpu_armv7.addInstance();
const mpu_armv78 = mpu_armv7.addInstance();
const mpu_armv79 = mpu_armv7.addInstance();

/**
 * Write custom configuration values to the imported modules.
 */
gpmc1.$name = "CONFIG_GPMC0";

const udma       = scripting.addModule("/drivers/udma/udma", {}, false);
const udma1      = udma.addInstance({}, false);
udma1.$name      = "CONFIG_UDMA0";
gpmc1.udmaDriver = udma1;

debug_log.enableUartLog        = true;
debug_log.uartLog.$name        = "CONFIG_UART_CONSOLE";
debug_log.uartLog.UART.$assign = "USART0";

mpu_armv71.$name             = "CONFIG_MPU_REGION0";
mpu_armv71.size              = 31;
mpu_armv71.attributes        = "Device";
mpu_armv71.accessPermissions = "Supervisor RD+WR, User RD";
mpu_armv71.allowExecute      = false;

mpu_armv72.$name             = "CONFIG_MPU_REGION1";
mpu_armv72.size              = 15;
mpu_armv72.accessPermissions = "Supervisor RD+WR, User RD";

mpu_armv73.$name             = "CONFIG_MPU_REGION2";
mpu_armv73.baseAddr          = 0x41010000;
mpu_armv73.size              = 15;
mpu_armv73.accessPermissions = "Supervisor RD+WR, User RD";

mpu_armv74.$name             = "CONFIG_MPU_REGION3";
mpu_armv74.accessPermissions = "Supervisor RD+WR, User RD";
mpu_armv74.baseAddr          = 0x70000000;
mpu_armv74.size              = 21;

mpu_armv75.$name             = "CONFIG_MPU_REGION4";
mpu_armv75.baseAddr          = 0x60000000;
mpu_armv75.size              = 28;
mpu_armv75.accessPermissions = "Supervisor RD, User RD";

mpu_armv76.$name    = "CONFIG_MPU_REGION5";
mpu_armv76.baseAddr = 0x80000000;
mpu_armv76.size     = 31;

mpu_armv77.$name        = "CONFIG_MPU_REGION6";
mpu_armv77.baseAddr     = 0x3B000000;
mpu_armv77.size         = 10;
mpu_armv77.attributes   = "Device";
mpu_armv77.allowExecute = false;

mpu_armv78.$name        = "CONFIG_MPU_REGION7";
mpu_armv78.baseAddr     = 0x25010000;
mpu_armv78.size         = 12;
mpu_armv78.allowExecute = false;
mpu_armv78.attributes   = "Device";

mpu_armv79.$name        = "CONFIG_MPU_REGION8";
mpu_armv79.baseAddr     = 0x50000000;
mpu_armv79.size         = 27;
mpu_armv79.allowExecute = false;
mpu_armv79.attributes   = "Device";

/**
 * Pinmux solution for unlocked pins/peripherals. This ensures that minor changes to the automatic solver in a future
 * version of the tool will not impact the pinmux you originally saw.  These lines can be completely deleted in order to
 * re-solve from scratch.
 */
gpmc1.GPMC.$suggestSolution                 = "GPMC0";
gpmc1.GPMC.OEn_REn.$suggestSolution         = "ball.R18";
gpmc1.GPMC.ADVn_ALE.$suggestSolution        = "ball.P16";
gpmc1.GPMC.WEn.$suggestSolution             = "ball.T21";
gpmc1.GPMC.BE0n_CLE.$suggestSolution        = "ball.P17";
gpmc1.GPMC.CSn0.$suggestSolution            = "ball.R19";
gpmc1.GPMC.AD0.$suggestSolution             = "ball.T20";
gpmc1.GPMC.AD1.$suggestSolution             = "ball.U21";
gpmc1.GPMC.AD2.$suggestSolution             = "ball.T18";
gpmc1.GPMC.AD3.$suggestSolution             = "ball.U20";
gpmc1.GPMC.AD4.$suggestSolution             = "ball.U18";
gpmc1.GPMC.AD5.$suggestSolution             = "ball.U19";
gpmc1.GPMC.AD6.$suggestSolution             = "ball.V20";
gpmc1.GPMC.AD7.$suggestSolution             = "ball.V21";
gpmc1.GPMC.WAIT0.$suggestSolution           = "ball.W19";
debug_log.uartLog.UART.RXD.$suggestSolution = "ball.D15";
debug_log.uartLog.UART.TXD.$suggestSolution = "ball.C16";
