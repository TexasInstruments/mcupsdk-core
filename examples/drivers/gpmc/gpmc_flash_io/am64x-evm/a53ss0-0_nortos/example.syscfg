/**
 * @cliArgs --device "AM64x" --package "ALV" --part "Default" --context "a53ss0-0" --product "MCU_PLUS_SDK@07.03.01"
 * @versions {"tool":"1.20.0+3587"}
 */

/**
 * Import the modules used in this configuration.
 */
const gpmc       = scripting.addModule("/drivers/gpmc/gpmc", {}, false);
const gpmc1      = gpmc.addInstance();
const debug_log  = scripting.addModule("/kernel/dpl/debug_log");
const dpl_cfg = scripting.addModule("/kernel/dpl/dpl_cfg");
const mmu_armv8  = scripting.addModule("/kernel/dpl/mmu_armv8", {}, false);
const mmu_armv81 = mmu_armv8.addInstance();
const mmu_armv82 = mmu_armv8.addInstance();
const mmu_armv83 = mmu_armv8.addInstance();

/**
 * Write custom configuration values to the imported modules.
 */
gpmc1.$name = "CONFIG_GPMC0";

const udma       = scripting.addModule("/drivers/udma/udma", {}, false);
const udma1      = udma.addInstance({}, false);
udma1.$name      = "CONFIG_UDMA0";
gpmc1.udmaDriver = udma1;

const udma_blkcopy_channel  = scripting.addModule("/drivers/udma/udma_blkcopy_channel", {}, false);
const udma_blkcopy_channel1 = udma_blkcopy_channel.addInstance({}, false);
udma_blkcopy_channel1.$name = "CONFIG_UDMA_BLKCOPY_CH0";
gpmc1.udmaBlkCopyChannel    = udma_blkcopy_channel1;

debug_log.enableCssLog         = false;
debug_log.enableUartLog        = true;
debug_log.uartLog.$name        = "CONFIG_UART_CONSOLE";
debug_log.uartLog.UART.$assign = "USART0";

const uart_v0_template  = scripting.addModule("/drivers/uart/v0/uart_v0_template", {}, false);
const uart_v0_template1 = uart_v0_template.addInstance({}, false);
uart_v0_template1.$name = "drivers_uart_v0_uart_v0_template0";
debug_log.uartLog.child = uart_v0_template1;

mmu_armv81.size  = 0x80000000;
mmu_armv81.$name = "SOC_MEM_REGION";

mmu_armv82.vAddr     = 0x70000000;
mmu_armv82.pAddr     = 0x70000000;
mmu_armv82.size      = 0x200000;
mmu_armv82.attribute = "MAIR7";
mmu_armv82.$name     = "MSRAM_REGION";

mmu_armv83.vAddr     = 0x80000000;
mmu_armv83.pAddr     = 0x80000000;
mmu_armv83.size      = 0x80000000;
mmu_armv83.attribute = "MAIR7";
mmu_armv83.$name     = "DDR_REGION";

/**
 * Pinmux solution for unlocked pins/peripherals. This ensures that minor changes to the automatic solver in a future
 * version of the tool will not impact the pinmux you originally saw.  These lines can be completely deleted in order to
 * re-solve from scratch.
 */
gpmc1.GPMC.$suggestSolution                 = "GPMC0";
gpmc1.GPMC.OEn_REn.$suggestSolution         = "GPMC0_OEn_REn";
gpmc1.GPMC.ADVn_ALE.$suggestSolution        = "GPMC0_ADVn_ALE";
gpmc1.GPMC.WEn.$suggestSolution             = "GPMC0_WEn";
gpmc1.GPMC.CSn0.$suggestSolution            = "GPMC0_CSn0";
gpmc1.GPMC.BE0n_CLE.$suggestSolution        = "GPMC0_BE0n_CLE";
gpmc1.GPMC.AD0.$suggestSolution             = "GPMC0_AD0";
gpmc1.GPMC.AD1.$suggestSolution             = "GPMC0_AD1";
gpmc1.GPMC.AD2.$suggestSolution             = "GPMC0_AD2";
gpmc1.GPMC.AD3.$suggestSolution             = "GPMC0_AD3";
gpmc1.GPMC.AD4.$suggestSolution             = "GPMC0_AD4";
gpmc1.GPMC.AD5.$suggestSolution             = "GPMC0_AD5";
gpmc1.GPMC.AD6.$suggestSolution             = "GPMC0_AD6";
gpmc1.GPMC.AD7.$suggestSolution             = "GPMC0_AD7";
gpmc1.GPMC.WAIT0.$suggestSolution           = "GPMC0_WAIT0";
debug_log.uartLog.UART.RXD.$suggestSolution = "UART0_RXD";
debug_log.uartLog.UART.TXD.$suggestSolution = "UART0_TXD";
