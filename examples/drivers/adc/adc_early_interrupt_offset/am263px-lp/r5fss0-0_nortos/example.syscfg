/**
 * @cliArgs --device "AM263Px" --package "ZCZ_C" --part "AM263P1" --context "r5fss0-0" --product "MCU_PLUS_SDK@07.03.01"
 * @versions {"tool":"1.13.0+2553"}
 */

/**
 * Import the modules used in this configuration.
 */
const adc        = scripting.addModule("/drivers/adc/adc", {}, false);
const adc1       = adc.addInstance();
const debug_log  = scripting.addModule("/kernel/dpl/debug_log");
const mpu_armv7  = scripting.addModule("/kernel/dpl/mpu_armv7", {}, false);
const mpu_armv71 = mpu_armv7.addInstance();
const mpu_armv72 = mpu_armv7.addInstance();
const mpu_armv73 = mpu_armv7.addInstance();
const mpu_armv74 = mpu_armv7.addInstance();
const int_xbar   = scripting.addModule("/xbar/int_xbar/int_xbar", {}, false);
const int_xbar1  = int_xbar.addInstance();

/**
 * Write custom configuration values to the imported modules.
 */
adc1.soc1InterruptTrigger = "ADC_INT_SOC_TRIGGER_ADCINT1";
adc1.adcClockPrescaler    = "ADC_CLK_DIV_3_0";
adc1.enableInterrupt1     = true;
adc1.interrupt2SOCSource  = "ADC_SOC_NUMBER1";
adc1.enableInterrupt2     = true;
adc1.$name                = "CONFIG_ADC1";
adc1.ppb1SOCNumber        = "ADC_SOC_NUMBER1";

debug_log.enableUartLog            = true;
debug_log.uartLog.$name            = "CONFIG_UART0";
debug_log.uartLog.UART.RXD.$assign = "ball.A7";
debug_log.uartLog.UART.TXD.$assign = "ball.A6";

mpu_armv71.$name             = "CONFIG_MPU_REGION0";
mpu_armv71.size              = 31;
mpu_armv71.attributes        = "Device";
mpu_armv71.accessPermissions = "Supervisor RD+WR, User RD";
mpu_armv71.allowExecute      = false;

mpu_armv72.$name             = "CONFIG_MPU_REGION1";
mpu_armv72.size              = 15;
mpu_armv72.accessPermissions = "Supervisor RD+WR, User RD";

mpu_armv73.$name             = "CONFIG_MPU_REGION2";
mpu_armv73.baseAddr          = 0x80000;
mpu_armv73.size              = 15;
mpu_armv73.accessPermissions = "Supervisor RD+WR, User RD";

mpu_armv74.$name             = "CONFIG_MPU_REGION3";
mpu_armv74.accessPermissions = "Supervisor RD+WR, User RD";
mpu_armv74.baseAddr          = 0x70000000;
mpu_armv74.size              = 21;

int_xbar1.$name      = "CONFIG_INT_XBAR0";
int_xbar1.xbarOutput = ["ADC1_INT2"];

/**
 * Pinmux solution for unlocked pins/peripherals. This ensures that minor changes to the automatic solver in a future
 * version of the tool will not impact the pinmux you originally saw.  These lines can be completely deleted in order to
 * re-solve from scratch.
 */
adc1.ADC.$suggestSolution               = "ADC1";
adc1.ADC.AIN0.$suggestSolution          = "ball.T11";
adc1.ADC.AIN1.$suggestSolution          = "ball.U11";
adc1.ADC.AIN2.$suggestSolution          = "ball.T12";
adc1.ADC.AIN3.$suggestSolution          = "ball.V12";
adc1.ADC.AIN4.$suggestSolution          = "ball.U12";
adc1.ADC.AIN5.$suggestSolution          = "ball.R12";
debug_log.uartLog.UART.$suggestSolution = "UART0";
