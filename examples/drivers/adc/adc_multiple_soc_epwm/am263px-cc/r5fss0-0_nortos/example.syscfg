/**
 * @cliArgs --device "AM263Px" --package "ZCZ_C" --part "AM263P1" --context "r5fss0-0" --product "MCU_PLUS_SDK@07.03.01"
 * @versions {"tool":"1.10.0+2163"}
 */

/**
 * Import the modules used in this configuration.
 */
const adc        = scripting.addModule("/drivers/adc/adc", {}, false);
const adc1       = adc.addInstance();
const adc2       = adc.addInstance();
const epwm       = scripting.addModule("/drivers/epwm/epwm", {}, false);
const epwm1      = epwm.addInstance();
const debug_log  = scripting.addModule("/kernel/dpl/debug_log");
const mpu_armv7  = scripting.addModule("/kernel/dpl/mpu_armv7", {}, false);
const mpu_armv71 = mpu_armv7.addInstance();
const mpu_armv72 = mpu_armv7.addInstance();
const mpu_armv73 = mpu_armv7.addInstance();
const mpu_armv74 = mpu_armv7.addInstance();
const int_xbar   = scripting.addModule("/xbar/int_xbar/int_xbar", {}, false);
const int_xbar1  = int_xbar.addInstance();

/**
 * Write custom configuration values to the imported modules.
 */
adc1.$name              = "CONFIG_ADC0";
adc1.adcClockPrescaler  = "ADC_CLK_DIV_4_0";
adc1.interruptPulseMode = "ADC_PULSE_END_OF_CONV";
adc1.soc0SampleWindow   = 16;
adc1.enableInterrupt1   = true;
adc1.enableConverter    = true;
adc1.soc0Trigger        = "ADC_TRIGGER_EPWM0_SOCA";
adc1.soc1Channel        = "ADC_CH_ADCIN1";
adc1.soc2Channel        = "ADC_CH_ADCIN2";
adc1.soc1SampleWindow   = 16;
adc1.soc2SampleWindow   = 16;
adc1.soc1Trigger        = "ADC_TRIGGER_EPWM0_SOCA";
adc1.soc2Trigger        = "ADC_TRIGGER_EPWM0_SOCA";
adc1.ADC.$assign        = "ADC0";

adc2.$name              = "CONFIG_ADC1";
adc2.adcClockPrescaler  = "ADC_CLK_DIV_4_0";
adc2.enableConverter    = true;
adc2.soc0Trigger        = "ADC_TRIGGER_EPWM0_SOCA";
adc2.interruptPulseMode = "ADC_PULSE_END_OF_CONV";
adc2.soc0SampleWindow   = 16;
adc2.soc1Channel        = "ADC_CH_ADCIN1";
adc2.soc1Trigger        = "ADC_TRIGGER_EPWM0_SOCA";
adc2.soc1SampleWindow   = 16;
adc2.soc2Channel        = "ADC_CH_ADCIN2";
adc2.soc2Trigger        = "ADC_TRIGGER_EPWM0_SOCA";
adc2.soc2SampleWindow   = 16;

epwm1.$name                                                      = "CONFIG_EPWM0";
epwm1.epwmTimebase_emulationMode                                 = "EPWM_EMULATION_FREE_RUN";
epwm1.epwmActionQualifier_EPWM_AQ_OUTPUT_A_ON_TIMEBASE_UP_CMPA   = "EPWM_AQ_OUTPUT_HIGH";
epwm1.epwmActionQualifier_EPWM_AQ_OUTPUT_A_ON_TIMEBASE_DOWN_CMPA = "EPWM_AQ_OUTPUT_LOW";
epwm1.epwmEventTrigger_EPWM_SOC_A_triggerEnable                  = true;
epwm1.epwmEventTrigger_EPWM_SOC_A_triggerSource                  = "EPWM_SOC_TBCTR_U_CMPA";
epwm1.epwmEventTrigger_EPWM_SOC_A_triggerEventPrescalar          = "1";
epwm1.epwmCounterCompare_cmpA                                    = 1000;
epwm1.epwmTimebase_period                                        = 2000;
epwm1.epwmTimebase_clockDiv                                      = "EPWM_CLOCK_DIVIDER_4";

debug_log.enableUartLog            = true;
debug_log.uartLog.$name            = "CONFIG_UART0";
debug_log.uartLog.UART.RXD.$assign = "UART0_RXD";
debug_log.uartLog.UART.TXD.$assign = "UART0_TXD";

mpu_armv71.$name             = "CONFIG_MPU_REGION0";
mpu_armv71.size              = 31;
mpu_armv71.attributes        = "Device";
mpu_armv71.accessPermissions = "Supervisor RD+WR, User RD";
mpu_armv71.allowExecute      = false;

mpu_armv72.$name             = "CONFIG_MPU_REGION1";
mpu_armv72.size              = 15;
mpu_armv72.accessPermissions = "Supervisor RD+WR, User RD";

mpu_armv73.$name             = "CONFIG_MPU_REGION2";
mpu_armv73.baseAddr          = 0x80000;
mpu_armv73.size              = 15;
mpu_armv73.accessPermissions = "Supervisor RD+WR, User RD";

mpu_armv74.$name             = "CONFIG_MPU_REGION3";
mpu_armv74.accessPermissions = "Supervisor RD+WR, User RD";
mpu_armv74.baseAddr          = 0x70000000;
mpu_armv74.size              = 21;

int_xbar1.$name      = "CONFIG_INT_XBAR0";
int_xbar1.xbarOutput = ["ADC0_INT1"];

/**
 * Pinmux solution for unlocked pins/peripherals. This ensures that minor changes to the automatic solver in a future
 * version of the tool will not impact the pinmux you originally saw.  These lines can be completely deleted in order to
 * re-solve from scratch.
 */
adc1.ADC.AIN0.$suggestSolution          = "ADC0_AIN0";
adc1.ADC.AIN1.$suggestSolution          = "ADC0_AIN1";
adc1.ADC.AIN2.$suggestSolution          = "ADC0_AIN2";
adc1.ADC.AIN3.$suggestSolution          = "ADC0_AIN3";
adc1.ADC.AIN4.$suggestSolution          = "ADC0_AIN4";
adc1.ADC.AIN5.$suggestSolution          = "ADC0_AIN5";
adc2.ADC.$suggestSolution               = "ADC1";
adc2.ADC.AIN0.$suggestSolution          = "ADC1_AIN0";
adc2.ADC.AIN1.$suggestSolution          = "ADC1_AIN1";
adc2.ADC.AIN2.$suggestSolution          = "ADC1_AIN2";
adc2.ADC.AIN3.$suggestSolution          = "ADC1_AIN3";
adc2.ADC.AIN4.$suggestSolution          = "ADC1_AIN4";
adc2.ADC.AIN5.$suggestSolution          = "ADC1_AIN5";
epwm1.EPWM.$suggestSolution             = "EPWM0";
epwm1.EPWM.A.$suggestSolution           = "EPWM0_A";
epwm1.EPWM.B.$suggestSolution           = "EPWM0_B";
debug_log.uartLog.UART.$suggestSolution = "UART0";
