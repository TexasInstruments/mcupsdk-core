/**
 * @cliArgs --device "AM64x_beta" --package "ALV" --part "Default" --context "r5fss0-0" --product "MCU_PLUS_SDK@07.03.00"
 * @versions {"data":"2021012919","timestamp":"2021012919","tool":"1.8.0+1785","templates":null}
 */

/**
 * Import the modules used in this configuration.
 */
const adc             = scripting.addModule("/drivers/adc/adc", {}, false);
const adc1            = adc.addInstance();
const addr_translate  = scripting.addModule("/kernel/dpl/addr_translate", {}, false);
const addr_translate1 = addr_translate.addInstance();
const debug_log       = scripting.addModule("/kernel/dpl/debug_log");
const mpu_armv7       = scripting.addModule("/kernel/dpl/mpu_armv7", {}, false);
const mpu_armv71      = mpu_armv7.addInstance();
const mpu_armv72      = mpu_armv7.addInstance();
const mpu_armv73      = mpu_armv7.addInstance();
const mpu_armv74      = mpu_armv7.addInstance();
const mpu_armv75      = mpu_armv7.addInstance();
const mpu_armv76      = mpu_armv7.addInstance();

/**
 * Write custom configuration values to the imported modules.
 */
adc1.$name                  = "CONFIG_ADC0";
adc1.ADC.$assign            = "ADC0";
adc1.ADC.EXT_TRIGGER0.$used = false;
adc1.ADC.EXT_TRIGGER1.$used = false;

addr_translate1.$name = "CONFIG_ADDR_TRANSLATE_REGION0";

debug_log.enableUartLog            = true;
debug_log.uartLog.$name            = "CONFIG_UART_CONSOLE";
debug_log.uartLog.UART.$assign     = "USART0";
debug_log.uartLog.UART.RXD.$assign = "UART0_RXD";
debug_log.uartLog.UART.TXD.$assign = "UART0_TXD";

mpu_armv71.$name             = "CONFIG_MPU_REGION0";
mpu_armv71.size              = 31;
mpu_armv71.attributes        = "Device";
mpu_armv71.accessPermissions = "Supervisor RD+WR, User RD";
mpu_armv71.allowExecute      = false;

mpu_armv72.$name             = "CONFIG_MPU_REGION1";
mpu_armv72.size              = 15;
mpu_armv72.accessPermissions = "Supervisor RD+WR, User RD";

mpu_armv73.$name             = "CONFIG_MPU_REGION2";
mpu_armv73.baseAddr          = 0x41010000;
mpu_armv73.size              = 15;
mpu_armv73.accessPermissions = "Supervisor RD+WR, User RD";

mpu_armv74.$name             = "CONFIG_MPU_REGION3";
mpu_armv74.baseAddr          = 0x70000000;
mpu_armv74.size              = 21;
mpu_armv74.accessPermissions = "Supervisor RD+WR, User RD";

mpu_armv75.$name             = "CONFIG_MPU_REGION4";
mpu_armv75.baseAddr          = 0x60000000;
mpu_armv75.size              = 28;
mpu_armv75.accessPermissions = "Supervisor RD, User RD";

mpu_armv76.$name             = "CONFIG_MPU_REGION5";
mpu_armv76.baseAddr          = 0x80000000;
mpu_armv76.size              = 31;

/**
 * Pinmux solution for unlocked pins/peripherals. This ensures that minor changes to the automatic solver in a future
 * version of the tool will not impact the pinmux you originally saw.  These lines can be completely deleted in order to
 * re-solve from scratch.
 */
adc1.ADC.AIN0.$suggestSolution = "ADC0_AIN0";
adc1.ADC.AIN1.$suggestSolution = "ADC0_AIN1";
adc1.ADC.AIN2.$suggestSolution = "ADC0_AIN2";
adc1.ADC.AIN3.$suggestSolution = "ADC0_AIN3";
adc1.ADC.AIN4.$suggestSolution = "ADC0_AIN4";
adc1.ADC.AIN5.$suggestSolution = "ADC0_AIN5";
adc1.ADC.AIN6.$suggestSolution = "ADC0_AIN6";
adc1.ADC.AIN7.$suggestSolution = "ADC0_AIN7";
