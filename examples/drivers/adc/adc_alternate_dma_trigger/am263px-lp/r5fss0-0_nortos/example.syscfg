/**
 * @cliArgs --device "AM263Px" --package "ZCZ_C" --part "AM263P4" --context "r5fss0-0" --product "MCU_PLUS_SDK@07.03.01"
 * @versions {"tool":"1.18.0+3266"}
 */

/**
 * Import the modules used in this configuration.
 */
const adc        = scripting.addModule("/drivers/adc/adc", {}, false);
const adc1       = adc.addInstance();
const adc2       = adc.addInstance();
const edma       = scripting.addModule("/drivers/edma/edma", {}, false);
const edma1      = edma.addInstance();
const debug_log  = scripting.addModule("/kernel/dpl/debug_log");
const dpl_cfg = scripting.addModule("/kernel/dpl/dpl_cfg");
const mpu_armv7  = scripting.addModule("/kernel/dpl/mpu_armv7", {}, false);
const mpu_armv71 = mpu_armv7.addInstance();
const mpu_armv72 = mpu_armv7.addInstance();
const mpu_armv73 = mpu_armv7.addInstance();
const mpu_armv74 = mpu_armv7.addInstance();
const general    = scripting.addModule("/memory_configurator/general", {}, false);
const general1   = general.addInstance();
const region     = scripting.addModule("/memory_configurator/region", {}, false);
const region1    = region.addInstance();
const section    = scripting.addModule("/memory_configurator/section", {}, false);
const section1   = section.addInstance();
const section2   = section.addInstance();
const section3   = section.addInstance();
const section4   = section.addInstance();
const section5   = section.addInstance();
const section6   = section.addInstance();
const section7   = section.addInstance();
const section8   = section.addInstance();
const section9   = section.addInstance();
const section10  = section.addInstance();
const section11  = section.addInstance();
const section12  = section.addInstance();
const section13  = section.addInstance();

/**
 * Write custom configuration values to the imported modules.
 */
adc1.$name                          = "CONFIG_ADC0";
adc1.soc0Channel                    = "ADC_CH_ADCIN2";
adc1.enableConverter                = true;
adc1.enableInterrupt1               = true;
adc1.interruptPulseMode             = "ADC_PULSE_END_OF_CONV";
adc1.soc0InterruptTrigger           = "ADC_INT_SOC_TRIGGER_ADCINT1";
adc1.soc0SampleWindow               = 20;
adc1.adcClockPrescaler              = "ADC_CLK_DIV_4_0";
adc1.enableInterrupt1ContinuousMode = true;
adc1.ADC.$assign                    = "ADC0";

adc2.$name                          = "CONFIG_ADC1";
adc2.soc0InterruptTrigger           = "ADC_INT_SOC_TRIGGER_ADCINT1";
adc2.adcClockPrescaler              = "ADC_CLK_DIV_4_0";
adc2.soc0SampleWindow               = 20;
adc2.enableConverter                = true;
adc2.interruptPulseMode             = "ADC_PULSE_END_OF_CONV";
adc2.enableInterrupt1               = true;
adc2.enableInterrupt1ContinuousMode = true;
adc2.ADC.$assign                    = "ADC1";

edma1.$name                                         = "CONFIG_EDMA0";
edma1.edmaRmDmaCh[0].$name                          = "CONFIG_EDMA_RM0";
edma1.edmaRmQdmaCh[0].$name                         = "CONFIG_EDMA_RM1";
edma1.edmaRmTcc[0].$name                            = "CONFIG_EDMA_RM2";
edma1.edmaRmParam[0].$name                          = "CONFIG_EDMA_RM3";
edma1.edmaChannel.create(2);
edma1.edmaChannel[0].$name                          = "CONFIG_EDMA_CH0";
edma1.edmaChannel[0].channelTrigger                 = "ADC0_INT1";
edma1.edmaChannel[0].xbarConfig.$name               = "CONFIG_DMA_TRIG_XBAR0";
edma1.edmaChannel[0].xbarConfig.xbarConfig.$name    = "CONFIG_DMA_XBAR0";
edma1.edmaChannel[1].$name                          = "CONFIG_EDMA_CH1";
edma1.edmaChannel[1].channelTrigger                 = "ADC1_INT1";
edma1.edmaChannel[1].xbarConfig.$name               = "CONFIG_DMA_TRIG_XBAR1";
edma1.edmaChannel[1].xbarConfig.instance            = "DMA_TRIG_XBAR_EDMA_MODULE_1";
edma1.edmaChannel[1].xbarConfig.xbarConfig.$name    = "CONFIG_DMA_XBAR1";
edma1.edmaChannel[1].xbarConfig.xbarConfig.instance = "DMA_XBAR_DMA_TRIG_XBAR_1";

debug_log.enableUartLog            = true;
debug_log.uartLog.$name            = "CONFIG_UART0";
debug_log.uartLog.UART.RXD.$assign = "UART0_RXD";
debug_log.uartLog.UART.TXD.$assign = "UART0_TXD";
debug_log.uartLog.child.$name      = "drivers_uart_v2_uart_v2_template0";

mpu_armv71.$name             = "CONFIG_MPU_REGION0";
mpu_armv71.size              = 31;
mpu_armv71.attributes        = "Device";
mpu_armv71.accessPermissions = "Supervisor RD+WR, User RD";
mpu_armv71.allowExecute      = false;

mpu_armv72.$name             = "CONFIG_MPU_REGION1";
mpu_armv72.size              = 15;
mpu_armv72.accessPermissions = "Supervisor RD+WR, User RD";

mpu_armv73.$name             = "CONFIG_MPU_REGION2";
mpu_armv73.baseAddr          = 0x80000;
mpu_armv73.size              = 15;
mpu_armv73.accessPermissions = "Supervisor RD+WR, User RD";

mpu_armv74.$name             = "CONFIG_MPU_REGION3";
mpu_armv74.accessPermissions = "Supervisor RD+WR, User RD";
mpu_armv74.baseAddr          = 0x70000000;
mpu_armv74.size              = 21;

general1.$name        = "CONFIG_GENERAL0";
general1.linker.$name = "TIARMCLANG0";

region1.$name                                = "MEMORY_REGION_CONFIGURATION";
region1.memory_region.create(12);
region1.memory_region[0].type                = "TCMA";
region1.memory_region[0].$name               = "R5F_VECS";
region1.memory_region[0].auto                = false;
region1.memory_region[0].size                = 0x40;
region1.memory_region[1].type                = "TCMA";
region1.memory_region[1].$name               = "R5F_TCMA";
region1.memory_region[1].size                = 0x7FC0;
region1.memory_region[2].type                = "TCMB";
region1.memory_region[2].$name               = "R5F_TCMB";
region1.memory_region[2].size                = 0x8000;
region1.memory_region[3].$name               = "SBL";
region1.memory_region[3].size                = 0x40000;
region1.memory_region[4].$name               = "OCRAM";
region1.memory_region[4].auto                = false;
region1.memory_region[4].manualStartAddress  = 0x70040000;
region1.memory_region[4].size                = 0x40000;
region1.memory_region[5].type                = "FLASH";
region1.memory_region[5].auto                = false;
region1.memory_region[5].manualStartAddress  = 0x60100000;
region1.memory_region[5].size                = 0x80000;
region1.memory_region[5].$name               = "FLASH";
region1.memory_region[6].$name               = "USER_SHM_MEM";
region1.memory_region[6].auto                = false;
region1.memory_region[6].manualStartAddress  = 0x701D0000;
region1.memory_region[6].size                = 0x4000;
region1.memory_region[6].isShared            = true;
region1.memory_region[6].shared_cores        = ["r5fss0-1","r5fss1-0","r5fss1-1"];
region1.memory_region[7].$name               = "LOG_SHM_MEM";
region1.memory_region[7].size                = 0x4000;
region1.memory_region[7].isShared            = true;
region1.memory_region[7].shared_cores        = ["r5fss0-1","r5fss1-0","r5fss1-1"];
region1.memory_region[8].type                = "CUSTOM";
region1.memory_region[8].$name               = "RTOS_NORTOS_IPC_SHM_MEM";
region1.memory_region[8].auto                = false;
region1.memory_region[8].manualStartAddress  = 0x72000000;
region1.memory_region[8].size                = 0x3E80;
region1.memory_region[8].isShared            = true;
region1.memory_region[8].shared_cores        = ["r5fss0-1","r5fss1-0","r5fss1-1"];
region1.memory_region[9].type                = "CUSTOM";
region1.memory_region[9].$name               = "MAILBOX_HSM";
region1.memory_region[9].auto                = false;
region1.memory_region[9].manualStartAddress  = 0x44000000;
region1.memory_region[9].size                = 0x3CE;
region1.memory_region[9].isShared            = true;
region1.memory_region[9].shared_cores        = ["r5fss0-1","r5fss1-0","r5fss1-1"];
region1.memory_region[10].type               = "CUSTOM";
region1.memory_region[10].$name              = "MAILBOX_R5F";
region1.memory_region[10].auto               = false;
region1.memory_region[10].manualStartAddress = 0x44000400;
region1.memory_region[10].size               = 0x3CE;
region1.memory_region[10].isShared           = true;
region1.memory_region[10].shared_cores       = ["r5fss0-1","r5fss1-0","r5fss1-1"];
region1.memory_region[11].type               = "CUSTOM";
region1.memory_region[11].$name              = "MSS_CTRL";
region1.memory_region[11].auto               = false;
region1.memory_region[11].manualStartAddress = 0x50D00000;
region1.memory_region[11].size               = 0x4000;
region1.memory_region[11].isShared           = true;
region1.memory_region[11].shared_cores       = ["r5fss0-1","r5fss1-0","r5fss1-1"];

section1.load_memory             = "R5F_VECS";
section1.group                   = false;
section1.$name                   = "Vector Table";
section1.output_section.create(1);
section1.output_section[0].$name = ".vectors";

section2.load_memory             = "OCRAM";
section2.$name                   = "Text Segments";
section2.output_section.create(5);
section2.output_section[0].$name = ".text.hwi";
section2.output_section[1].$name = ".text.cache";
section2.output_section[2].$name = ".text.mpu";
section2.output_section[3].$name = ".text.boot";
section2.output_section[4].$name = ".text:abort";

section3.load_memory             = "OCRAM";
section3.$name                   = "Code and Read-Only Data";
section3.output_section.create(2);
section3.output_section[0].$name = ".text";
section3.output_section[1].$name = ".rodata";

section4.load_memory             = "OCRAM";
section4.$name                   = "Data Segment";
section4.output_section.create(1);
section4.output_section[0].$name = ".data";

section5.load_memory                             = "OCRAM";
section5.$name                                   = "Memory Segments";
section5.output_section.create(3);
section5.output_section[0].$name                 = ".bss";
section5.output_section[0].output_sections_start = "__BSS_START";
section5.output_section[0].output_sections_end   = "__BSS_END";
section5.output_section[1].$name                 = ".sysmem";
section5.output_section[2].$name                 = ".stack";

section6.load_memory                              = "OCRAM";
section6.$name                                    = "Stack Segments";
section6.output_section.create(5);
section6.output_section[0].$name                  = ".irqstack";
section6.output_section[0].output_sections_start  = "__IRQ_STACK_START";
section6.output_section[0].output_sections_end    = "__IRQ_STACK_END";
section6.output_section[0].input_section.create(1);
section6.output_section[0].input_section[0].$name = ". = . + __IRQ_STACK_SIZE;";
section6.output_section[1].$name                  = ".fiqstack";
section6.output_section[1].output_sections_start  = "__FIQ_STACK_START";
section6.output_section[1].output_sections_end    = "__FIQ_STACK_END";
section6.output_section[1].input_section.create(1);
section6.output_section[1].input_section[0].$name = ". = . + __FIQ_STACK_SIZE;";
section6.output_section[2].$name                  = ".svcstack";
section6.output_section[2].output_sections_start  = "__SVC_STACK_START";
section6.output_section[2].output_sections_end    = "__SVC_STACK_END";
section6.output_section[2].input_section.create(1);
section6.output_section[2].input_section[0].$name = ". = . + __SVC_STACK_SIZE;";
section6.output_section[3].$name                  = ".abortstack";
section6.output_section[3].output_sections_start  = "__ABORT_STACK_START";
section6.output_section[3].output_sections_end    = "__ABORT_STACK_END";
section6.output_section[3].input_section.create(1);
section6.output_section[3].input_section[0].$name = ". = . + __ABORT_STACK_SIZE;";
section6.output_section[4].$name                  = ".undefinedstack";
section6.output_section[4].output_sections_start  = "__UNDEFINED_STACK_START";
section6.output_section[4].output_sections_end    = "__UNDEFINED_STACK_END";
section6.output_section[4].input_section.create(1);
section6.output_section[4].input_section[0].$name = ". = . + __UNDEFINED_STACK_SIZE;";

section7.load_memory             = "OCRAM";
section7.$name                   = "Initialization and Exception Handling";
section7.output_section.create(3);
section7.output_section[0].$name = ".ARM.exidx";
section7.output_section[1].$name = ".init_array";
section7.output_section[2].$name = ".fini_array";

section8.load_memory             = "USER_SHM_MEM";
section8.type                    = "NOLOAD";
section8.$name                   = "User Shared Memory";
section8.group                   = false;
section8.output_section.create(1);
section8.output_section[0].$name = ".bss.user_shared_mem";

section9.load_memory             = "LOG_SHM_MEM";
section9.$name                   = "Log Shared Memory";
section9.group                   = false;
section9.output_section.create(1);
section9.output_section[0].$name = ".bss.log_shared_mem";

section10.load_memory             = "RTOS_NORTOS_IPC_SHM_MEM";
section10.type                    = "NOLOAD";
section10.$name                   = "IPC Shared Memory";
section10.group                   = false;
section10.output_section.create(1);
section10.output_section[0].$name = ".bss.ipc_vring_mem";

section11.load_memory             = "MAILBOX_HSM";
section11.type                    = "NOLOAD";
section11.$name                   = "SIPC HSM Queue Memory";
section11.group                   = false;
section11.output_section.create(1);
section11.output_section[0].$name = ".bss.sipc_hsm_queue_mem";

section12.load_memory             = "MAILBOX_R5F";
section12.$name                   = "SIPC R5F Queue Memory";
section12.group                   = false;
section12.output_section.create(1);
section12.output_section[0].$name = ".bss.sipc_secure_host_queue_mem";

section13.$name                        = "CONTROL_DATA";
section13.load_memory                  = "R5F_TCMB";
section13.output_section.create(1);
section13.output_section[0].$name      = "adcData";
section13.output_section[0].palignment = true;

/**
 * Pinmux solution for unlocked pins/peripherals. This ensures that minor changes to the automatic solver in a future
 * version of the tool will not impact the pinmux you originally saw.  These lines can be completely deleted in order to
 * re-solve from scratch.
 */
adc1.ADC.AIN0.$suggestSolution          = "ADC0_AIN0";
adc1.ADC.AIN1.$suggestSolution          = "ADC0_AIN1";
adc1.ADC.AIN2.$suggestSolution          = "ADC0_AIN2";
adc1.ADC.AIN3.$suggestSolution          = "ADC0_AIN3";
adc1.ADC.AIN4.$suggestSolution          = "ADC0_AIN4";
adc1.ADC.AIN5.$suggestSolution          = "ADC0_AIN5";
adc2.ADC.AIN0.$suggestSolution          = "ADC1_AIN0";
adc2.ADC.AIN1.$suggestSolution          = "ADC1_AIN1";
adc2.ADC.AIN2.$suggestSolution          = "ADC1_AIN2";
adc2.ADC.AIN3.$suggestSolution          = "ADC1_AIN3";
adc2.ADC.AIN4.$suggestSolution          = "ADC1_AIN4";
adc2.ADC.AIN5.$suggestSolution          = "ADC1_AIN5";
debug_log.uartLog.UART.$suggestSolution = "UART0";
