/**
 * @cliArgs --device "AM263Px" --package "ZCZ_C" --part "AM263P1" --context "r5fss0-0" --product "MCU_PLUS_SDK@07.03.01"
 * @versions {"tool":"1.17.0+3128"}
 */

/**
 * Import the modules used in this configuration.
 */
const pmic       = scripting.addModule("/board/pmic/pmic", {}, false);
const pmic1      = pmic.addInstance();
const adc        = scripting.addModule("/drivers/adc/adc", {}, false);
const adc1       = adc.addInstance();
const adc2       = adc.addInstance();
const adc3       = adc.addInstance();
const adc4       = adc.addInstance();
const adc5       = adc.addInstance();
const epwm       = scripting.addModule("/drivers/epwm/epwm", {}, false);
const epwm1      = epwm.addInstance();
const mcspi      = scripting.addModule("/drivers/mcspi/mcspi", {}, false);
const mcspi1     = mcspi.addInstance();
const debug_log  = scripting.addModule("/kernel/dpl/debug_log");
const mpu_armv7  = scripting.addModule("/kernel/dpl/mpu_armv7", {}, false);
const mpu_armv71 = mpu_armv7.addInstance();
const mpu_armv72 = mpu_armv7.addInstance();
const mpu_armv73 = mpu_armv7.addInstance();
const mpu_armv74 = mpu_armv7.addInstance();
const int_xbar   = scripting.addModule("/xbar/int_xbar/int_xbar", {}, false);
const int_xbar1  = int_xbar.addInstance();

/**
 * Write custom configuration values to the imported modules.
 */
pmic1.$name = "CONFIG_PMIC0";

adc1.$name              = "CONFIG_ADC0";
adc1.soc0Trigger        = "ADC_TRIGGER_EPWM0_SOCA";
adc1.soc1Trigger        = "ADC_TRIGGER_EPWM0_SOCA";
adc1.soc2Trigger        = "ADC_TRIGGER_EPWM0_SOCA";
adc1.soc3Trigger        = "ADC_TRIGGER_EPWM0_SOCA";
adc1.adcClockPrescaler  = "ADC_CLK_DIV_4_0";
adc1.enableConverter    = true;
adc1.ppb2SOCNumber      = "ADC_SOC_NUMBER1";
adc1.ppb3SOCNumber      = "ADC_SOC_NUMBER2";
adc1.ppb4SOCNumber      = "ADC_SOC_NUMBER3";
adc1.interruptPulseMode = "ADC_PULSE_END_OF_CONV";
adc1.ADC.$assign        = "ADC0";

adc2.$name              = "CONFIG_ADC1";
adc2.soc0Trigger        = "ADC_TRIGGER_EPWM0_SOCB";
adc2.soc1Trigger        = "ADC_TRIGGER_EPWM0_SOCA";
adc2.soc2Trigger        = "ADC_TRIGGER_EPWM0_SOCA";
adc2.soc3Trigger        = "ADC_TRIGGER_EPWM0_SOCB";
adc2.adcClockPrescaler  = "ADC_CLK_DIV_4_0";
adc2.enableConverter    = true;
adc2.ppb2SOCNumber      = "ADC_SOC_NUMBER1";
adc2.ppb3SOCNumber      = "ADC_SOC_NUMBER2";
adc2.ppb4SOCNumber      = "ADC_SOC_NUMBER3";
adc2.interruptPulseMode = "ADC_PULSE_END_OF_CONV";
adc2.ADC.$assign        = "ADC1";

adc3.$name               = "CONFIG_ADC2";
adc3.soc0Trigger         = "ADC_TRIGGER_EPWM0_SOCA";
adc3.soc1Trigger         = "ADC_TRIGGER_EPWM0_SOCA";
adc3.soc2Trigger         = "ADC_TRIGGER_EPWM0_SOCA";
adc3.soc3Trigger         = "ADC_TRIGGER_EPWM0_SOCA";
adc3.adcClockPrescaler   = "ADC_CLK_DIV_4_0";
adc3.enableConverter     = true;
adc3.ppb2SOCNumber       = "ADC_SOC_NUMBER1";
adc3.ppb3SOCNumber       = "ADC_SOC_NUMBER2";
adc3.ppb4SOCNumber       = "ADC_SOC_NUMBER3";
adc3.interruptPulseMode  = "ADC_PULSE_END_OF_CONV";
adc3.socHighPriorityMode = "ADC_PRI_THRU_SOC3_HIPRI";
adc3.ADC.$assign         = "ADC2";

adc4.$name               = "CONFIG_ADC3";
adc4.soc0Trigger         = "ADC_TRIGGER_EPWM0_SOCB";
adc4.soc1Trigger         = "ADC_TRIGGER_EPWM0_SOCA";
adc4.soc2Trigger         = "ADC_TRIGGER_EPWM0_SOCA";
adc4.soc3Trigger         = "ADC_TRIGGER_EPWM0_SOCB";
adc4.adcClockPrescaler   = "ADC_CLK_DIV_4_0";
adc4.enableConverter     = true;
adc4.ppb2SOCNumber       = "ADC_SOC_NUMBER1";
adc4.ppb3SOCNumber       = "ADC_SOC_NUMBER2";
adc4.ppb4SOCNumber       = "ADC_SOC_NUMBER3";
adc4.interruptPulseMode  = "ADC_PULSE_END_OF_CONV";
adc4.socHighPriorityMode = "ADC_PRI_THRU_SOC3_HIPRI";
adc4.ADC.$assign         = "ADC3";

adc5.$name                          = "CONFIG_ADC4";
adc5.soc0Trigger                    = "ADC_TRIGGER_EPWM0_SOCA";
adc5.soc1Trigger                    = "ADC_TRIGGER_EPWM0_SOCA";
adc5.soc2Trigger                    = "ADC_TRIGGER_EPWM0_SOCA";
adc5.soc3Trigger                    = "ADC_TRIGGER_EPWM0_SOCA";
adc5.adcClockPrescaler              = "ADC_CLK_DIV_4_0";
adc5.enableConverter                = true;
adc5.ppb2SOCNumber                  = "ADC_SOC_NUMBER1";
adc5.ppb3SOCNumber                  = "ADC_SOC_NUMBER2";
adc5.ppb4SOCNumber                  = "ADC_SOC_NUMBER3";
adc5.interruptPulseMode             = "ADC_PULSE_END_OF_CONV";
adc5.enableInterrupt1               = true;
adc5.enableInterrupt1ContinuousMode = true;
adc5.interrupt1SOCSource            = "ADC_SOC_NUMBER2";
adc5.ADC.$assign                    = "ADC4";

epwm1.$name                                             = "CONFIG_EPWM0";
epwm1.epwmTimebase_clockDiv                             = "EPWM_CLOCK_DIVIDER_128";
epwm1.epwmTimebase_period                               = 24000;
epwm1.epwmEventTrigger_EPWM_SOC_A_triggerEnable         = true;
epwm1.epwmEventTrigger_EPWM_SOC_A_triggerSource         = "EPWM_SOC_TBCTR_U_CMPA";
epwm1.epwmEventTrigger_EPWM_SOC_A_triggerEventPrescalar = "15";
epwm1.epwmEventTrigger_EPWM_SOC_B_triggerEnable         = true;
epwm1.epwmEventTrigger_EPWM_SOC_B_triggerSource         = "EPWM_SOC_TBCTR_U_CMPB";
epwm1.epwmEventTrigger_EPWM_SOC_B_triggerEventPrescalar = "15";
epwm1.epwmCounterCompare_cmpA                           = 1000;
epwm1.epwmCounterCompare_cmpB                           = 1005;
epwm1.EPWM.$assign                                      = "EPWM0";

mcspi1.$name                 = "CONFIG_MCSPI0";
pmic1.peripheralDriver       = mcspi1;
mcspi1.SPI.$assign           = "SPI1";
mcspi1.mcspiChannel[0].$name = "CONFIG_MCSPI_CH0";

const edma                  = scripting.addModule("/drivers/edma/edma", {}, false);
const edma1                 = edma.addInstance({}, false);
edma1.$name                 = "CONFIG_EDMA0";
mcspi1.edmaDriver           = edma1;
edma1.edmaRmDmaCh[0].$name  = "CONFIG_EDMA_RM0";
edma1.edmaRmQdmaCh[0].$name = "CONFIG_EDMA_RM1";
edma1.edmaRmTcc[0].$name    = "CONFIG_EDMA_RM2";
edma1.edmaRmParam[0].$name  = "CONFIG_EDMA_RM3";

debug_log.enableUartLog            = true;
debug_log.uartLog.$name            = "CONFIG_UART0";
debug_log.uartLog.UART.RXD.$assign = "UART0_RXD";
debug_log.uartLog.UART.TXD.$assign = "UART0_TXD";

mpu_armv71.$name             = "CONFIG_MPU_REGION0";
mpu_armv71.size              = 31;
mpu_armv71.attributes        = "Device";
mpu_armv71.accessPermissions = "Supervisor RD+WR, User RD";
mpu_armv71.allowExecute      = false;

mpu_armv72.$name             = "CONFIG_MPU_REGION1";
mpu_armv72.size              = 15;
mpu_armv72.accessPermissions = "Supervisor RD+WR, User RD";

mpu_armv73.$name             = "CONFIG_MPU_REGION2";
mpu_armv73.baseAddr          = 0x80000;
mpu_armv73.size              = 15;
mpu_armv73.accessPermissions = "Supervisor RD+WR, User RD";

mpu_armv74.$name             = "CONFIG_MPU_REGION3";
mpu_armv74.accessPermissions = "Supervisor RD+WR, User RD";
mpu_armv74.baseAddr          = 0x70000000;
mpu_armv74.size              = 21;

int_xbar1.$name      = "CONFIG_INT_XBAR0";
int_xbar1.xbarOutput = ["ADC4_INT1"];

/**
 * Pinmux solution for unlocked pins/peripherals. This ensures that minor changes to the automatic solver in a future
 * version of the tool will not impact the pinmux you originally saw.  These lines can be completely deleted in order to
 * re-solve from scratch.
 */
adc1.ADC.AIN0.$suggestSolution              = "ADC0_AIN0";
adc1.ADC.AIN1.$suggestSolution              = "ADC0_AIN1";
adc1.ADC.AIN2.$suggestSolution              = "ADC0_AIN2";
adc1.ADC.AIN3.$suggestSolution              = "ADC0_AIN3";
adc1.ADC.AIN4.$suggestSolution              = "ADC0_AIN4";
adc1.ADC.AIN5.$suggestSolution              = "ADC0_AIN5";
adc2.ADC.AIN0.$suggestSolution              = "ADC1_AIN0";
adc2.ADC.AIN1.$suggestSolution              = "ADC1_AIN1";
adc2.ADC.AIN2.$suggestSolution              = "ADC1_AIN2";
adc2.ADC.AIN3.$suggestSolution              = "ADC1_AIN3";
adc2.ADC.AIN4.$suggestSolution              = "ADC1_AIN4";
adc2.ADC.AIN5.$suggestSolution              = "ADC1_AIN5";
adc3.ADC.AIN0.$suggestSolution              = "ADC2_AIN0";
adc3.ADC.AIN1.$suggestSolution              = "ADC2_AIN1";
adc3.ADC.AIN2.$suggestSolution              = "ADC2_AIN2";
adc3.ADC.AIN3.$suggestSolution              = "ADC2_AIN3";
adc3.ADC.AIN4.$suggestSolution              = "ADC2_AIN4";
adc3.ADC.AIN5.$suggestSolution              = "ADC2_AIN5";
adc4.ADC.AIN0.$suggestSolution              = "ADC3_AIN0";
adc4.ADC.AIN1.$suggestSolution              = "ADC3_AIN1";
adc4.ADC.AIN2.$suggestSolution              = "ADC3_AIN2";
adc4.ADC.AIN3.$suggestSolution              = "ADC3_AIN3";
adc4.ADC.AIN4.$suggestSolution              = "ADC3_AIN4";
adc4.ADC.AIN5.$suggestSolution              = "ADC3_AIN5";
adc5.ADC.AIN0.$suggestSolution              = "ADC4_AIN0";
adc5.ADC.AIN1.$suggestSolution              = "ADC4_AIN1";
adc5.ADC.AIN2.$suggestSolution              = "ADC4_AIN2";
adc5.ADC.AIN3.$suggestSolution              = "ADC4_AIN3";
adc5.ADC.AIN4.$suggestSolution              = "ADC4_AIN4";
adc5.ADC.AIN5.$suggestSolution              = "ADC4_AIN5";
epwm1.EPWM.A.$suggestSolution               = "EPWM0_A";
epwm1.EPWM.B.$suggestSolution               = "EPWM0_B";
mcspi1.SPI.CLK.$suggestSolution             = "SPI1_CLK";
mcspi1.SPI.D0.$suggestSolution              = "SPI1_D0";
mcspi1.SPI.D1.$suggestSolution              = "SPI1_D1";
mcspi1.mcspiChannel[0].CSn.$suggestSolution = "SPI1_CS0";
debug_log.uartLog.UART.$suggestSolution     = "UART0";
