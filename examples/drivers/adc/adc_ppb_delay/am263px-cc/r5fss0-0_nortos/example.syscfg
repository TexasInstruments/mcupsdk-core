/**
 * @cliArgs --device "AM263Px" --package "ZCZ_C" --part "AM263P1" --context "r5fss0-0" --product "MCU_PLUS_SDK@07.03.01"
 * @versions {"tool":"1.17.0+3128"}
 */

/**
 * Import the modules used in this configuration.
 */
const pmic       = scripting.addModule("/board/pmic/pmic", {}, false);
const pmic1      = pmic.addInstance();
const adc        = scripting.addModule("/drivers/adc/adc", {}, false);
const adc1       = adc.addInstance();
const epwm       = scripting.addModule("/drivers/epwm/epwm", {}, false);
const epwm1      = epwm.addInstance();
const epwm2      = epwm.addInstance();
const mcspi      = scripting.addModule("/drivers/mcspi/mcspi", {}, false);
const mcspi1     = mcspi.addInstance();
const debug_log  = scripting.addModule("/kernel/dpl/debug_log");
const mpu_armv7  = scripting.addModule("/kernel/dpl/mpu_armv7", {}, false);
const mpu_armv71 = mpu_armv7.addInstance();
const mpu_armv72 = mpu_armv7.addInstance();
const mpu_armv73 = mpu_armv7.addInstance();
const mpu_armv74 = mpu_armv7.addInstance();
const int_xbar   = scripting.addModule("/xbar/int_xbar/int_xbar", {}, false);
const int_xbar1  = int_xbar.addInstance();
const int_xbar2  = int_xbar.addInstance();

/**
 * Write custom configuration values to the imported modules.
 */
pmic1.$name = "CONFIG_PMIC0";

adc1.ppb2SOCNumber       = "ADC_SOC_NUMBER1";
adc1.soc0Trigger         = "ADC_TRIGGER_EPWM0_SOCA";
adc1.soc0SampleWindow    = 17;
adc1.soc1SampleWindow    = 17;
adc1.adcClockPrescaler   = "ADC_CLK_DIV_4_0";
adc1.soc1Trigger         = "ADC_TRIGGER_EPWM1_SOCA";
adc1.$name               = "CONFIG_ADC1";
adc1.enableInterrupt1    = true;
adc1.enableInterrupt2    = true;
adc1.enableConverter     = true;
adc1.interruptPulseMode  = "ADC_PULSE_END_OF_CONV";
adc1.interrupt1SOCSource = "ADC_SOC_NUMBER1";
adc1.soc1Channel         = "ADC_CH_ADCIN1";
adc1.ADC.$assign         = "ADC1";

epwm1.$name                                                   = "CONFIG_EPWM0";
epwm1.epwmTimebase_period                                     = 2048;
epwm1.epwmEventTrigger_EPWM_SOC_A_triggerEnable               = true;
epwm1.epwmEventTrigger_EPWM_SOC_A_triggerEventPrescalar       = "1";
epwm1.epwmEventTrigger_EPWM_SOC_A_triggerEventCountInitEnable = true;
epwm1.epwmEventTrigger_EPWM_SOC_A_triggerSource               = "EPWM_SOC_TBCTR_ZERO";
epwm1.EPWM.$assign                                            = "EPWM0";

epwm2.$name                                                   = "CONFIG_EPWM1";
epwm2.epwmEventTrigger_EPWM_SOC_A_triggerEnable               = true;
epwm2.epwmEventTrigger_EPWM_SOC_A_triggerEventPrescalar       = "1";
epwm2.epwmTimebase_period                                     = 9999;
epwm2.epwmEventTrigger_EPWM_SOC_A_triggerEventCountInitEnable = true;
epwm2.epwmEventTrigger_EPWM_SOC_A_triggerSource               = "EPWM_SOC_TBCTR_ZERO";
epwm2.EPWM.$assign                                            = "EPWM1";

mcspi1.$name                 = "CONFIG_MCSPI0";
pmic1.peripheralDriver       = mcspi1;
mcspi1.SPI.$assign           = "SPI1";
mcspi1.mcspiChannel[0].$name = "CONFIG_MCSPI_CH0";

const edma                  = scripting.addModule("/drivers/edma/edma", {}, false);
const edma1                 = edma.addInstance({}, false);
edma1.$name                 = "CONFIG_EDMA0";
mcspi1.edmaDriver           = edma1;
edma1.edmaRmDmaCh[0].$name  = "CONFIG_EDMA_RM0";
edma1.edmaRmQdmaCh[0].$name = "CONFIG_EDMA_RM1";
edma1.edmaRmTcc[0].$name    = "CONFIG_EDMA_RM2";
edma1.edmaRmParam[0].$name  = "CONFIG_EDMA_RM3";

debug_log.enableUartLog            = true;
debug_log.uartLog.$name            = "CONFIG_UART0";
debug_log.uartLog.UART.RXD.$assign = "UART0_RXD";
debug_log.uartLog.UART.TXD.$assign = "UART0_TXD";

mpu_armv71.$name             = "CONFIG_MPU_REGION0";
mpu_armv71.size              = 31;
mpu_armv71.attributes        = "Device";
mpu_armv71.accessPermissions = "Supervisor RD+WR, User RD";
mpu_armv71.allowExecute      = false;

mpu_armv72.$name             = "CONFIG_MPU_REGION1";
mpu_armv72.size              = 15;
mpu_armv72.accessPermissions = "Supervisor RD+WR, User RD";

mpu_armv73.$name             = "CONFIG_MPU_REGION2";
mpu_armv73.baseAddr          = 0x80000;
mpu_armv73.size              = 15;
mpu_armv73.accessPermissions = "Supervisor RD+WR, User RD";

mpu_armv74.$name             = "CONFIG_MPU_REGION3";
mpu_armv74.accessPermissions = "Supervisor RD+WR, User RD";
mpu_armv74.baseAddr          = 0x70000000;
mpu_armv74.size              = 21;

int_xbar1.$name      = "CONFIG_INT_XBAR0";
int_xbar1.xbarOutput = ["ADC1_INT1"];

int_xbar2.$name      = "CONFIG_INT_XBAR1";
int_xbar2.xbarOutput = ["ADC1_INT2"];
int_xbar2.instance   = "INT_XBAR_1";

/**
 * Pinmux solution for unlocked pins/peripherals. This ensures that minor changes to the automatic solver in a future
 * version of the tool will not impact the pinmux you originally saw.  These lines can be completely deleted in order to
 * re-solve from scratch.
 */
adc1.ADC.AIN0.$suggestSolution              = "ADC1_AIN0";
adc1.ADC.AIN1.$suggestSolution              = "ADC1_AIN1";
adc1.ADC.AIN2.$suggestSolution              = "ADC1_AIN2";
adc1.ADC.AIN3.$suggestSolution              = "ADC1_AIN3";
adc1.ADC.AIN4.$suggestSolution              = "ADC1_AIN4";
adc1.ADC.AIN5.$suggestSolution              = "ADC1_AIN5";
epwm1.EPWM.A.$suggestSolution               = "EPWM0_A";
epwm1.EPWM.B.$suggestSolution               = "EPWM0_B";
epwm2.EPWM.A.$suggestSolution               = "EPWM1_A";
epwm2.EPWM.B.$suggestSolution               = "EPWM1_B";
mcspi1.SPI.CLK.$suggestSolution             = "SPI1_CLK";
mcspi1.SPI.D0.$suggestSolution              = "SPI1_D0";
mcspi1.SPI.D1.$suggestSolution              = "SPI1_D1";
mcspi1.mcspiChannel[0].CSn.$suggestSolution = "SPI1_CS0";
debug_log.uartLog.UART.$suggestSolution     = "UART0";
