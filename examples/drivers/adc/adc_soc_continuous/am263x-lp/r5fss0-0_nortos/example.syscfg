/**
 * @cliArgs --device "AM263x_beta" --package "ZCZ" --part "AM263x" --context "r5fss0-0" --product "MCU_PLUS_SDK@07.03.01"
 * @versions {"tool":"1.17.0+3128"}
 */

/**
 * Import the modules used in this configuration.
 */
const adc        = scripting.addModule("/drivers/adc/adc", {}, false);
const adc1       = adc.addInstance();
const debug_log  = scripting.addModule("/kernel/dpl/debug_log");
const mpu_armv7  = scripting.addModule("/kernel/dpl/mpu_armv7", {}, false);
const mpu_armv71 = mpu_armv7.addInstance();
const mpu_armv72 = mpu_armv7.addInstance();
const mpu_armv73 = mpu_armv7.addInstance();
const mpu_armv74 = mpu_armv7.addInstance();

/**
 * Write custom configuration values to the imported modules.
 */
adc1.$name                          = "CONFIG_ADC1";
adc1.soc0InterruptTrigger           = "ADC_INT_SOC_TRIGGER_ADCINT2";
adc1.soc1InterruptTrigger           = "ADC_INT_SOC_TRIGGER_ADCINT2";
adc1.soc2InterruptTrigger           = "ADC_INT_SOC_TRIGGER_ADCINT2";
adc1.soc3InterruptTrigger           = "ADC_INT_SOC_TRIGGER_ADCINT2";
adc1.soc4InterruptTrigger           = "ADC_INT_SOC_TRIGGER_ADCINT2";
adc1.soc5InterruptTrigger           = "ADC_INT_SOC_TRIGGER_ADCINT2";
adc1.soc6InterruptTrigger           = "ADC_INT_SOC_TRIGGER_ADCINT2";
adc1.soc7InterruptTrigger           = "ADC_INT_SOC_TRIGGER_ADCINT2";
adc1.soc8InterruptTrigger           = "ADC_INT_SOC_TRIGGER_ADCINT1";
adc1.soc9InterruptTrigger           = "ADC_INT_SOC_TRIGGER_ADCINT1";
adc1.soc10InterruptTrigger          = "ADC_INT_SOC_TRIGGER_ADCINT1";
adc1.soc11InterruptTrigger          = "ADC_INT_SOC_TRIGGER_ADCINT1";
adc1.soc12InterruptTrigger          = "ADC_INT_SOC_TRIGGER_ADCINT1";
adc1.soc13InterruptTrigger          = "ADC_INT_SOC_TRIGGER_ADCINT1";
adc1.soc14InterruptTrigger          = "ADC_INT_SOC_TRIGGER_ADCINT1";
adc1.soc15InterruptTrigger          = "ADC_INT_SOC_TRIGGER_ADCINT1";
adc1.soc0SampleWindow               = 19;
adc1.soc1SampleWindow               = 19;
adc1.soc2SampleWindow               = 19;
adc1.soc3SampleWindow               = 19;
adc1.soc4SampleWindow               = 19;
adc1.soc5SampleWindow               = 19;
adc1.soc6SampleWindow               = 19;
adc1.soc7SampleWindow               = 19;
adc1.soc8SampleWindow               = 19;
adc1.soc9SampleWindow               = 19;
adc1.soc10SampleWindow              = 19;
adc1.soc11SampleWindow              = 19;
adc1.soc12SampleWindow              = 19;
adc1.soc13SampleWindow              = 19;
adc1.soc14SampleWindow              = 19;
adc1.soc15SampleWindow              = 19;
adc1.enableInterrupt1               = true;
adc1.enableInterrupt2               = true;
adc1.enableConverter                = true;
adc1.adcClockPrescaler              = "ADC_CLK_DIV_3_0";
adc1.interrupt2SOCSource            = "ADC_SOC_NUMBER15";
adc1.interrupt1SOCSource            = "ADC_SOC_NUMBER7";
adc1.enableInterrupt2ContinuousMode = true;
adc1.enableInterrupt1ContinuousMode = true;
adc1.ADC.$assign                    = "ADC1";

debug_log.enableUartLog            = true;
debug_log.uartLog.$name            = "CONFIG_UART0";
debug_log.uartLog.UART.RXD.$assign = "UART0_RXD";
debug_log.uartLog.UART.TXD.$assign = "UART0_TXD";

mpu_armv71.$name             = "CONFIG_MPU_REGION0";
mpu_armv71.size              = 31;
mpu_armv71.attributes        = "Device";
mpu_armv71.accessPermissions = "Supervisor RD+WR, User RD";
mpu_armv71.allowExecute      = false;

mpu_armv72.$name             = "CONFIG_MPU_REGION1";
mpu_armv72.size              = 15;
mpu_armv72.accessPermissions = "Supervisor RD+WR, User RD";

mpu_armv73.$name             = "CONFIG_MPU_REGION2";
mpu_armv73.baseAddr          = 0x80000;
mpu_armv73.size              = 15;
mpu_armv73.accessPermissions = "Supervisor RD+WR, User RD";

mpu_armv74.$name             = "CONFIG_MPU_REGION3";
mpu_armv74.accessPermissions = "Supervisor RD+WR, User RD";
mpu_armv74.baseAddr          = 0x70000000;
mpu_armv74.size              = 21;

/**
 * Pinmux solution for unlocked pins/peripherals. This ensures that minor changes to the automatic solver in a future
 * version of the tool will not impact the pinmux you originally saw.  These lines can be completely deleted in order to
 * re-solve from scratch.
 */
adc1.ADC.AIN0.$suggestSolution          = "ADC1_AIN0";
adc1.ADC.AIN1.$suggestSolution          = "ADC1_AIN1";
adc1.ADC.AIN2.$suggestSolution          = "ADC1_AIN2";
adc1.ADC.AIN3.$suggestSolution          = "ADC1_AIN3";
adc1.ADC.AIN4.$suggestSolution          = "ADC1_AIN4";
adc1.ADC.AIN5.$suggestSolution          = "ADC1_AIN5";
debug_log.uartLog.UART.$suggestSolution = "UART0";
