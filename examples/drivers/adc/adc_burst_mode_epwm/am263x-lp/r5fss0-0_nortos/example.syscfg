/**
 * @cliArgs --device "AM263x_beta" --package "ZCZ" --part "AM263x" --context "r5fss0-0" --product "MCU_PLUS_SDK@07.03.01"
 * @versions {"tool":"1.13.0+2553"}
 */

/**
 * Import the modules used in this configuration.
 */
const adc        = scripting.addModule("/drivers/adc/adc", {}, false);
const adc1       = adc.addInstance();
const epwm       = scripting.addModule("/drivers/epwm/epwm", {}, false);
const epwm1      = epwm.addInstance();
const debug_log  = scripting.addModule("/kernel/dpl/debug_log");
const mpu_armv7  = scripting.addModule("/kernel/dpl/mpu_armv7", {}, false);
const mpu_armv71 = mpu_armv7.addInstance();
const mpu_armv72 = mpu_armv7.addInstance();
const mpu_armv73 = mpu_armv7.addInstance();
const mpu_armv74 = mpu_armv7.addInstance();
const int_xbar   = scripting.addModule("/xbar/int_xbar/int_xbar", {}, false);
const int_xbar1  = int_xbar.addInstance();

/**
 * Write custom configuration values to the imported modules.
 */
adc1.adcClockPrescaler   = "ADC_CLK_DIV_3_0";
adc1.socHighPriorityMode = "ADC_PRI_THRU_SOC6_HIPRI";
adc1.enableConverter     = true;
adc1.burstTrigger        = "ADC_TRIGGER_EPWM0_SOCA";
adc1.burstSize           = 3;
adc1.enableBurstMode     = true;
adc1.soc7SampleWindow    = 20;
adc1.soc8SampleWindow    = 20;
adc1.soc9SampleWindow    = 20;
adc1.soc10SampleWindow   = 20;
adc1.soc11SampleWindow   = 20;
adc1.soc12SampleWindow   = 20;
adc1.soc13SampleWindow   = 20;
adc1.soc14SampleWindow   = 20;
adc1.soc15SampleWindow   = 20;
adc1.soc8Channel         = "ADC_CH_ADCIN1";
adc1.soc9Channel         = "ADC_CH_ADCIN2";
adc1.soc11Channel        = "ADC_CH_ADCIN1";
adc1.soc12Channel        = "ADC_CH_ADCIN2";
adc1.soc14Channel        = "ADC_CH_ADCIN1";
adc1.interrupt1SOCSource = "ADC_SOC_NUMBER9";
adc1.enableInterrupt1    = true;
adc1.interrupt2SOCSource = "ADC_SOC_NUMBER12";
adc1.enableInterrupt2    = true;
adc1.interrupt3SOCSource = "ADC_SOC_NUMBER15";
adc1.enableInterrupt3    = true;
adc1.soc15Channel        = "ADC_CH_ADCIN2";
adc1.$name               = "CONFIG_ADC1";
adc1.ADC.$assign         = "ADC1";
scripting.suppress("SOC7 is configured for Round Robin\. With burst mode enabled, the  burst mode trigger will override the selected trigger for this SOC", adc1, "soc7Trigger");
scripting.suppress("SOC8 is configured for Round Robin\. With burst mode enabled, the  burst mode trigger will override the selected trigger for this SOC", adc1, "soc8Trigger");
scripting.suppress("SOC9 is configured for Round Robin\. With burst mode enabled, the  burst mode trigger will override the selected trigger for this SOC", adc1, "soc9Trigger");
scripting.suppress("SOC10 is configured for Round Robin\. With burst mode enabled, the  burst mode trigger will override the selected trigger for this SOC", adc1, "soc10Trigger");
scripting.suppress("SOC11 is configured for Round Robin\. With burst mode enabled, the  burst mode trigger will override the selected trigger for this SOC", adc1, "soc11Trigger");
scripting.suppress("SOC12 is configured for Round Robin\. With burst mode enabled, the  burst mode trigger will override the selected trigger for this SOC", adc1, "soc12Trigger");
scripting.suppress("SOC13 is configured for Round Robin\. With burst mode enabled, the  burst mode trigger will override the selected trigger for this SOC", adc1, "soc13Trigger");
scripting.suppress("SOC14 is configured for Round Robin\. With burst mode enabled, the  burst mode trigger will override the selected trigger for this SOC", adc1, "soc14Trigger");
scripting.suppress("SOC15 is configured for Round Robin\. With burst mode enabled, the  burst mode trigger will override the selected trigger for this SOC", adc1, "soc15Trigger");

epwm1.$name                                                      = "CONFIG_EPWM0";
epwm1.epwmTimebase_emulationMode                                 = "EPWM_EMULATION_FREE_RUN";
epwm1.epwmActionQualifier_EPWM_AQ_OUTPUT_A_ON_TIMEBASE_UP_CMPA   = "EPWM_AQ_OUTPUT_HIGH";
epwm1.epwmActionQualifier_EPWM_AQ_OUTPUT_A_ON_TIMEBASE_DOWN_CMPA = "EPWM_AQ_OUTPUT_LOW";
epwm1.epwmEventTrigger_EPWM_SOC_A_triggerEnable                  = true;
epwm1.epwmEventTrigger_EPWM_SOC_A_triggerSource                  = "EPWM_SOC_TBCTR_U_CMPA";
epwm1.epwmEventTrigger_EPWM_SOC_A_triggerEventPrescalar          = "1";
epwm1.epwmCounterCompare_cmpA                                    = 1000;
epwm1.epwmTimebase_clockDiv                                      = "EPWM_CLOCK_DIVIDER_4";
epwm1.epwmEventTrigger_enableInterrupt                           = true;
epwm1.epwmEventTrigger_interruptSource                           = "EPWM_INT_TBCTR_U_CMPA";
epwm1.epwmTimebase_period                                        = 1999;

debug_log.enableUartLog            = true;
debug_log.uartLog.$name            = "CONFIG_UART0";
debug_log.uartLog.UART.RXD.$assign = "ball.A7";
debug_log.uartLog.UART.TXD.$assign = "ball.A6";

mpu_armv71.$name             = "CONFIG_MPU_REGION0";
mpu_armv71.size              = 31;
mpu_armv71.attributes        = "Device";
mpu_armv71.accessPermissions = "Supervisor RD+WR, User RD";
mpu_armv71.allowExecute      = false;

mpu_armv72.$name             = "CONFIG_MPU_REGION1";
mpu_armv72.size              = 15;
mpu_armv72.accessPermissions = "Supervisor RD+WR, User RD";

mpu_armv73.$name             = "CONFIG_MPU_REGION2";
mpu_armv73.baseAddr          = 0x80000;
mpu_armv73.size              = 15;
mpu_armv73.accessPermissions = "Supervisor RD+WR, User RD";

mpu_armv74.$name             = "CONFIG_MPU_REGION3";
mpu_armv74.accessPermissions = "Supervisor RD+WR, User RD";
mpu_armv74.baseAddr          = 0x70000000;
mpu_armv74.size              = 21;

int_xbar1.$name      = "CONFIG_INT_XBAR0";
int_xbar1.xbarOutput = ["ADC1_INT1","ADC1_INT2","ADC1_INT3"];

/**
 * Pinmux solution for unlocked pins/peripherals. This ensures that minor changes to the automatic solver in a future
 * version of the tool will not impact the pinmux you originally saw.  These lines can be completely deleted in order to
 * re-solve from scratch.
 */
adc1.ADC.AIN0.$suggestSolution          = "ball.T11";
adc1.ADC.AIN1.$suggestSolution          = "ball.U11";
adc1.ADC.AIN2.$suggestSolution          = "ball.T12";
adc1.ADC.AIN3.$suggestSolution          = "ball.V12";
adc1.ADC.AIN4.$suggestSolution          = "ball.U12";
adc1.ADC.AIN5.$suggestSolution          = "ball.R12";
epwm1.EPWM.$suggestSolution             = "EPWM0";
epwm1.EPWM.A.$suggestSolution           = "ball.B2";
epwm1.EPWM.B.$suggestSolution           = "ball.B1";
debug_log.uartLog.UART.$suggestSolution = "UART0";
