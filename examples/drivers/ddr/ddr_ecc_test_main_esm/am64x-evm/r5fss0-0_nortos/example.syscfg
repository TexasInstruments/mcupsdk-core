/**
 * @cliArgs --device "AM64x" --package "ALV" --part "Default" --context "r5fss0-0" --product "MCU_PLUS_SDK@07.03.01"
 * @versions {"tool":"1.13.0+2553"}
 */

/**
 * Import the modules used in this configuration.
 */
const ddr        = scripting.addModule("/drivers/ddr/ddr", {}, false);
const ddr1       = ddr.addInstance();
const esm        = scripting.addModule("/drivers/esm/esm", {}, false);
const esm1       = esm.addInstance();
const ipc        = scripting.addModule("/drivers/ipc/ipc");
const debug_log  = scripting.addModule("/kernel/dpl/debug_log");
const mpu_armv7  = scripting.addModule("/kernel/dpl/mpu_armv7", {}, false);
const mpu_armv71 = mpu_armv7.addInstance();
const mpu_armv72 = mpu_armv7.addInstance();
const mpu_armv73 = mpu_armv7.addInstance();
const mpu_armv74 = mpu_armv7.addInstance();
const mpu_armv75 = mpu_armv7.addInstance();
const mpu_armv76 = mpu_armv7.addInstance();

/**
 * Write custom configuration values to the imported modules.
 */
ddr1.$name         = "CONFIG_DDR0";
ddr1.eccEnableFlag = true;
ddr1.eccStart0     = 0x10000000;
ddr1.eccEnd0       = 0x10020000;
ddr1.eccStart1     = 0x10020000;
ddr1.eccEnd1       = 0x10040000;
ddr1.eccStart2     = 0x10040000;
ddr1.eccEnd2       = 0x10060000;

esm1.$name                             = "CONFIG_ESM0";
esm1.bClearErrors                      = true;
esm1.esmNotifier.create(2);
esm1.esmNotifier[0].$name              = "CONFIG_ESM_NOTIFY0";
esm1.esmNotifier[0].errorNumber        = 6;
esm1.esmNotifier[0].setIntrPriorityLvl = "LOW";
esm1.esmNotifier[0].notify             = "DDR_secHandler";
esm1.esmNotifier[1].$name              = "CONFIG_ESM_NOTIFY1";
esm1.esmNotifier[1].errorNumber        = 69;
esm1.esmNotifier[1].notify             = "DDR_dedHandler";

ipc.r5fss0_1 = "NONE";
ipc.r5fss1_0 = "NONE";
ipc.r5fss1_1 = "NONE";
ipc.m4fss0_0 = "notify";

debug_log.enableUartLog        = true;
debug_log.uartLog.$name        = "CONFIG_UART_CONSOLE";
debug_log.uartLog.intrEnable   = "DISABLE";
debug_log.uartLog.UART.$assign = "USART0";

mpu_armv71.$name             = "CONFIG_MPU_REGION0";
mpu_armv71.size              = 31;
mpu_armv71.attributes        = "Device";
mpu_armv71.accessPermissions = "Supervisor RD+WR, User RD";
mpu_armv71.allowExecute      = false;

mpu_armv72.$name             = "CONFIG_MPU_REGION1";
mpu_armv72.size              = 15;
mpu_armv72.accessPermissions = "Supervisor RD+WR, User RD";

mpu_armv73.$name             = "CONFIG_MPU_REGION2";
mpu_armv73.baseAddr          = 0x41010000;
mpu_armv73.size              = 15;
mpu_armv73.accessPermissions = "Supervisor RD+WR, User RD";

mpu_armv74.$name             = "CONFIG_MPU_REGION3";
mpu_armv74.accessPermissions = "Supervisor RD+WR, User RD";
mpu_armv74.baseAddr          = 0x70000000;
mpu_armv74.size              = 21;

mpu_armv75.$name             = "CONFIG_MPU_REGION4";
mpu_armv75.baseAddr          = 0x60000000;
mpu_armv75.size              = 28;
mpu_armv75.accessPermissions = "Supervisor RD, User RD";

mpu_armv76.$name    = "CONFIG_MPU_REGION5";
mpu_armv76.baseAddr = 0x80000000;
mpu_armv76.size     = 31;

/**
 * Pinmux solution for unlocked pins/peripherals. This ensures that minor changes to the automatic solver in a future
 * version of the tool will not impact the pinmux you originally saw.  These lines can be completely deleted in order to
 * re-solve from scratch.
 */
debug_log.uartLog.UART.RXD.$suggestSolution = "ball.D15";
debug_log.uartLog.UART.TXD.$suggestSolution = "ball.C16";
