/**
 * @cliArgs --device "AM64x" --package "ALV" --part "Default" --context "a53ss0-0" --product "MCU_PLUS_SDK@07.03.01"
 * @versions {"tool":"1.20.0+3587"}
 */

/**
 * Import the modules used in this configuration.
 */
const epwm       = scripting.addModule("/drivers/epwm/epwm", {}, false);
const epwm1      = epwm.addInstance();
const debug_log  = scripting.addModule("/kernel/dpl/debug_log");
const dpl_cfg = scripting.addModule("/kernel/dpl/dpl_cfg");
const mmu_armv8  = scripting.addModule("/kernel/dpl/mmu_armv8", {}, false);
const mmu_armv81 = mmu_armv8.addInstance();
const mmu_armv82 = mmu_armv8.addInstance();
const mmu_armv83 = mmu_armv8.addInstance();

/**
 * Write custom configuration values to the imported modules.
 */
epwm1.$name            = "CONFIG_EPWM0";
epwm1.EPWM.B.$used     = false;
epwm1.EPWM.SYNCO.$used = false;
epwm1.EPWM.SYNCI.rx    = false;
epwm1.EPWM.SYNCI.$used = false;

debug_log.enableCssLog         = false;
debug_log.enableUartLog        = true;
debug_log.uartLog.$name        = "CONFIG_UART_CONSOLE";
debug_log.uartLog.UART.$assign = "USART0";

const uart_v0_template  = scripting.addModule("/drivers/uart/v0/uart_v0_template", {}, false);
const uart_v0_template1 = uart_v0_template.addInstance({}, false);
uart_v0_template1.$name = "drivers_uart_v0_uart_v0_template0";
debug_log.uartLog.child = uart_v0_template1;

mmu_armv81.size  = 0x80000000;
mmu_armv81.$name = "SOC_MEM_REGION";

mmu_armv82.vAddr     = 0x70000000;
mmu_armv82.pAddr     = 0x70000000;
mmu_armv82.size      = 0x200000;
mmu_armv82.attribute = "MAIR7";
mmu_armv82.$name     = "MSRAM_REGION";

mmu_armv83.vAddr     = 0x80000000;
mmu_armv83.pAddr     = 0x80000000;
mmu_armv83.size      = 0x80000000;
mmu_armv83.attribute = "MAIR7";
mmu_armv83.$name     = "DDR_REGION";

/**
 * Pinmux solution for unlocked pins/peripherals. This ensures that minor changes to the automatic solver in a future
 * version of the tool will not impact the pinmux you originally saw.  These lines can be completely deleted in order to
 * re-solve from scratch.
 */
epwm1.EPWM.$suggestSolution                 = "EHRPWM0";
epwm1.EPWM.A.$suggestSolution               = "GPMC0_AD3";
debug_log.uartLog.UART.RXD.$suggestSolution = "UART0_RXD";
debug_log.uartLog.UART.TXD.$suggestSolution = "UART0_TXD";
