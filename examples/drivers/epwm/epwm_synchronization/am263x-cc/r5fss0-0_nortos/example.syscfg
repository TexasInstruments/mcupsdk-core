/**
 * @cliArgs --device "AM263x_beta" --package "ZCZ" --part "AM263x" --context "r5fss0-0" --product "MCU_PLUS_SDK@07.03.01"
 * @versions {"tool":"1.17.0+3128"}
 */

/**
 * Import the modules used in this configuration.
 */
const ecap        = scripting.addModule("/drivers/ecap/ecap", {}, false);
const ecap1       = ecap.addInstance();
const ecap2       = ecap.addInstance();
const ecap3       = ecap.addInstance();
const ecap4       = ecap.addInstance();
const ecap5       = ecap.addInstance();
const ecap6       = ecap.addInstance();
const epwm        = scripting.addModule("/drivers/epwm/epwm", {}, false);
const epwm1       = epwm.addInstance();
const epwm2       = epwm.addInstance();
const epwm3       = epwm.addInstance();
const epwm4       = epwm.addInstance();
const epwm5       = epwm.addInstance();
const epwm6       = epwm.addInstance();
const uart        = scripting.addModule("/drivers/uart/uart", {}, false);
const uart1       = uart.addInstance();
const mpu_armv7   = scripting.addModule("/kernel/dpl/mpu_armv7", {}, false);
const mpu_armv71  = mpu_armv7.addInstance();
const mpu_armv72  = mpu_armv7.addInstance();
const mpu_armv73  = mpu_armv7.addInstance();
const mpu_armv74  = mpu_armv7.addInstance();
const input_xbar  = scripting.addModule("/xbar/input_xbar/input_xbar", {}, false);
const input_xbar1 = input_xbar.addInstance();
const input_xbar2 = input_xbar.addInstance();
const input_xbar3 = input_xbar.addInstance();
const input_xbar4 = input_xbar.addInstance();
const input_xbar5 = input_xbar.addInstance();
const input_xbar6 = input_xbar.addInstance();

/**
 * Write custom configuration values to the imported modules.
 */
ecap1.useInterrupts     = false;
ecap1.enableLoadCounter = true;
ecap1.loadCounter       = true;
ecap1.syncInPulseSource = "ECAP_SYNC_IN_PULSE_SRC_SYNCOUT_EPWM0";
ecap1.$name             = "REF_CAPTURE";
ecap1.eventOnePolarity  = "ECAP_EVNT_FALLING_EDGE";
ecap1.syncOutMode       = "ECAP_SYNC_OUT_DISABLED";
ecap1.emulationMode     = "ECAP_EMULATION_FREE_RUN";
ecap1.ecapInput         = "ECAP_INPUT_INPUTXBAR0";

ecap2.ecapBase          = "CSL_CONTROLSS_ECAP1_U_BASE";
ecap2.$name             = "ECAP1_CAPTURE";
ecap2.enableInterrupt   = true;
ecap2.useInterrupts     = false;
ecap2.enableLoadCounter = true;
ecap2.loadCounter       = true;
ecap2.syncInPulseSource = "ECAP_SYNC_IN_PULSE_SRC_SYNCOUT_EPWM0";
ecap2.eventOnePolarity  = "ECAP_EVNT_FALLING_EDGE";
ecap2.emulationMode     = "ECAP_EMULATION_FREE_RUN";
ecap2.syncOutMode       = "ECAP_SYNC_OUT_DISABLED";

ecap3.$name             = "ECAP2_CAPTURE";
ecap3.ecapBase          = "CSL_CONTROLSS_ECAP2_U_BASE";
ecap3.useInterrupts     = false;
ecap3.enableLoadCounter = true;
ecap3.loadCounter       = true;
ecap3.syncInPulseSource = "ECAP_SYNC_IN_PULSE_SRC_SYNCOUT_EPWM0";
ecap3.eventOnePolarity  = "ECAP_EVNT_FALLING_EDGE";
ecap3.emulationMode     = "ECAP_EMULATION_FREE_RUN";
ecap3.syncOutMode       = "ECAP_SYNC_OUT_DISABLED";
ecap3.ecapInput         = "ECAP_INPUT_INPUTXBAR2";

ecap4.$name             = "ECAP3_CAPTURE";
ecap4.ecapBase          = "CSL_CONTROLSS_ECAP3_U_BASE";
ecap4.useInterrupts     = false;
ecap4.enableLoadCounter = true;
ecap4.loadCounter       = true;
ecap4.syncInPulseSource = "ECAP_SYNC_IN_PULSE_SRC_SYNCOUT_EPWM0";
ecap4.eventOnePolarity  = "ECAP_EVNT_FALLING_EDGE";
ecap4.emulationMode     = "ECAP_EMULATION_FREE_RUN";
ecap4.syncOutMode       = "ECAP_SYNC_OUT_DISABLED";
ecap4.ecapInput         = "ECAP_INPUT_INPUTXBAR3";

ecap5.ecapBase          = "CSL_CONTROLSS_ECAP4_U_BASE";
ecap5.$name             = "ECAP4_CAPTURE";
ecap5.eventOnePolarity  = "ECAP_EVNT_FALLING_EDGE";
ecap5.useInterrupts     = false;
ecap5.enableLoadCounter = true;
ecap5.loadCounter       = true;
ecap5.syncOutMode       = "ECAP_SYNC_OUT_DISABLED";
ecap5.ecapInput         = "ECAP_INPUT_INPUTXBAR4";
ecap5.syncInPulseSource = "ECAP_SYNC_IN_PULSE_SRC_SYNCOUT_EPWM0";
ecap5.emulationMode     = "ECAP_EMULATION_FREE_RUN";

ecap6.ecapBase          = "CSL_CONTROLSS_ECAP5_U_BASE";
ecap6.$name             = "ECAP5_CAPTURE";
ecap6.eventOnePolarity  = "ECAP_EVNT_FALLING_EDGE";
ecap6.useInterrupts     = false;
ecap6.loadCounter       = true;
ecap6.enableLoadCounter = true;
ecap6.syncOutMode       = "ECAP_SYNC_OUT_DISABLED";
ecap6.ecapInput         = "ECAP_INPUT_INPUTXBAR5";
ecap6.syncInPulseSource = "ECAP_SYNC_IN_PULSE_SRC_SYNCOUT_EPWM0";
ecap6.emulationMode     = "ECAP_EMULATION_FREE_RUN";

epwm1.$name                                                    = "CONFIG_EPWM0";
epwm1.epwmTimebase_period                                      = 2000;
epwm1.epwmTimebase_syncOutPulseMode                            = ["EPWM_SYNC_OUT_PULSE_ON_CNTR_ZERO"];
epwm1.epwmCounterCompare_cmpB                                  = 500;
epwm1.epwmActionQualifier_EPWM_AQ_OUTPUT_A_ON_TIMEBASE_ZERO    = "EPWM_AQ_OUTPUT_HIGH";
epwm1.epwmActionQualifier_EPWM_AQ_OUTPUT_A_ON_TIMEBASE_UP_CMPA = "EPWM_AQ_OUTPUT_LOW";
epwm1.epwmActionQualifier_EPWM_AQ_OUTPUT_B_ON_TIMEBASE_ZERO    = "EPWM_AQ_OUTPUT_HIGH";
epwm1.epwmActionQualifier_EPWM_AQ_OUTPUT_B_ON_TIMEBASE_UP_CMPB = "EPWM_AQ_OUTPUT_LOW";
epwm1.epwmTimebase_emulationMode                               = "EPWM_EMULATION_FREE_RUN";
epwm1.epwmTimebase_clockDiv                                    = "EPWM_CLOCK_DIVIDER_8";
epwm1.epwmTimebase_counterMode                                 = "EPWM_COUNTER_MODE_UP";
epwm1.epwmTimebase_syncInPulseSource                           = "EPWM_SYNC_IN_PULSE_SRC_SYNCOUT_EPWM0";
epwm1.epwmCounterCompare_cmpA                                  = 1000;
epwm1.EPWM.A.$assign                                           = "EPWM0_A";
epwm1.EPWM.B.$assign                                           = "EPWM0_B";

epwm2.$name                                                    = "CONFIG_EPWM1";
epwm2.epwmTimebase_counterMode                                 = "EPWM_COUNTER_MODE_UP";
epwm2.epwmTimebase_phaseEnable                                 = true;
epwm2.epwmTimebase_phaseShift                                  = 300;
epwm2.epwmCounterCompare_cmpA                                  = 1000;
epwm2.epwmCounterCompare_cmpB                                  = 500;
epwm2.epwmActionQualifier_EPWM_AQ_OUTPUT_A_ON_TIMEBASE_ZERO    = "EPWM_AQ_OUTPUT_HIGH";
epwm2.epwmActionQualifier_EPWM_AQ_OUTPUT_A_ON_TIMEBASE_UP_CMPA = "EPWM_AQ_OUTPUT_LOW";
epwm2.epwmActionQualifier_EPWM_AQ_OUTPUT_B_ON_TIMEBASE_ZERO    = "EPWM_AQ_OUTPUT_HIGH";
epwm2.epwmActionQualifier_EPWM_AQ_OUTPUT_B_ON_TIMEBASE_UP_CMPB = "EPWM_AQ_OUTPUT_LOW";
epwm2.epwmTimebase_period                                      = 2000;
epwm2.epwmTimebase_syncInPulseSource                           = "EPWM_SYNC_IN_PULSE_SRC_SYNCOUT_EPWM0";
epwm2.epwmTimebase_emulationMode                               = "EPWM_EMULATION_FREE_RUN";
epwm2.epwmTimebase_clockDiv                                    = "EPWM_CLOCK_DIVIDER_8";
epwm2.EPWM.$assign                                             = "EPWM1";
epwm2.EPWM.A.$assign                                           = "EPWM1_A";
epwm2.EPWM.B.$assign                                           = "EPWM1_B";

epwm3.$name                                                    = "CONFIG_EPWM2";
epwm3.epwmTimebase_period                                      = 2000;
epwm3.epwmTimebase_counterMode                                 = "EPWM_COUNTER_MODE_UP";
epwm3.epwmTimebase_phaseEnable                                 = true;
epwm3.epwmTimebase_phaseShift                                  = 600;
epwm3.epwmCounterCompare_cmpA                                  = 1000;
epwm3.epwmCounterCompare_cmpB                                  = 500;
epwm3.epwmActionQualifier_EPWM_AQ_OUTPUT_A_ON_TIMEBASE_ZERO    = "EPWM_AQ_OUTPUT_HIGH";
epwm3.epwmActionQualifier_EPWM_AQ_OUTPUT_A_ON_TIMEBASE_UP_CMPA = "EPWM_AQ_OUTPUT_LOW";
epwm3.epwmActionQualifier_EPWM_AQ_OUTPUT_B_ON_TIMEBASE_ZERO    = "EPWM_AQ_OUTPUT_HIGH";
epwm3.epwmActionQualifier_EPWM_AQ_OUTPUT_B_ON_TIMEBASE_UP_CMPB = "EPWM_AQ_OUTPUT_LOW";
epwm3.epwmTimebase_syncInPulseSource                           = "EPWM_SYNC_IN_PULSE_SRC_SYNCOUT_EPWM0";
epwm3.epwmTimebase_emulationMode                               = "EPWM_EMULATION_FREE_RUN";
epwm3.epwmTimebase_clockDiv                                    = "EPWM_CLOCK_DIVIDER_8";

epwm4.$name                                                    = "CONFIG_EPWM3";
epwm4.epwmTimebase_counterMode                                 = "EPWM_COUNTER_MODE_UP";
epwm4.epwmTimebase_phaseEnable                                 = true;
epwm4.epwmTimebase_phaseShift                                  = 900;
epwm4.epwmTimebase_period                                      = 2000;
epwm4.epwmTimebase_syncInPulseSource                           = "EPWM_SYNC_IN_PULSE_SRC_SYNCOUT_EPWM0";
epwm4.epwmCounterCompare_cmpA                                  = 1000;
epwm4.epwmCounterCompare_cmpB                                  = 500;
epwm4.epwmActionQualifier_EPWM_AQ_OUTPUT_A_ON_TIMEBASE_ZERO    = "EPWM_AQ_OUTPUT_HIGH";
epwm4.epwmActionQualifier_EPWM_AQ_OUTPUT_A_ON_TIMEBASE_UP_CMPA = "EPWM_AQ_OUTPUT_LOW";
epwm4.epwmActionQualifier_EPWM_AQ_OUTPUT_B_ON_TIMEBASE_ZERO    = "EPWM_AQ_OUTPUT_HIGH";
epwm4.epwmActionQualifier_EPWM_AQ_OUTPUT_B_ON_TIMEBASE_UP_CMPB = "EPWM_AQ_OUTPUT_LOW";
epwm4.epwmTimebase_emulationMode                               = "EPWM_EMULATION_FREE_RUN";
epwm4.epwmTimebase_clockDiv                                    = "EPWM_CLOCK_DIVIDER_8";
epwm4.EPWM.$assign                                             = "EPWM3";
epwm4.EPWM.A.$assign                                           = "EPWM3_A";
epwm4.EPWM.B.$assign                                           = "EPWM3_B";

epwm5.$name                      = "CONFIG_EPWM4";
epwm5.epwmTimebase_emulationMode = "EPWM_EMULATION_FREE_RUN";
epwm5.epwmTimebase_period        = 2000;
epwm5.EPWM.$assign               = "EPWM4";

epwm6.$name                      = "CONFIG_EPWM5";
epwm6.epwmTimebase_emulationMode = "EPWM_EMULATION_FREE_RUN";
epwm6.epwmTimebase_period        = 2000;
epwm6.EPWM.$assign               = "EPWM5";

uart1.$name            = "CONFIG_UART0";
uart1.UART.RXD.$assign = "UART0_RXD";
uart1.UART.TXD.$assign = "UART0_TXD";

mpu_armv71.$name        = "CONFIG_MPU_REGION0";
mpu_armv71.size         = 31;
mpu_armv71.allowExecute = false;
mpu_armv71.attributes   = "Device";

mpu_armv72.$name = "CONFIG_MPU_REGION1";
mpu_armv72.size  = 15;

mpu_armv73.$name    = "CONFIG_MPU_REGION2";
mpu_armv73.baseAddr = 0x80000;
mpu_armv73.size     = 15;

mpu_armv74.$name    = "CONFIG_MPU_REGION3";
mpu_armv74.baseAddr = 0x70000000;
mpu_armv74.size     = 21;

input_xbar1.$name      = "CONFIG_INPUT_XBAR0";
input_xbar1.xbarOutput = "GPIO43";

input_xbar2.$name      = "CONFIG_INPUT_XBAR1";
input_xbar2.xbarOutput = "GPIO45";
input_xbar2.instance   = "INPUT_XBAR_1";

input_xbar3.$name      = "CONFIG_INPUT_XBAR2";
input_xbar3.instance   = "INPUT_XBAR_2";
input_xbar3.xbarOutput = "GPIO47";

input_xbar4.$name      = "CONFIG_INPUT_XBAR3";
input_xbar4.instance   = "INPUT_XBAR_3";
input_xbar4.xbarOutput = "GPIO49";

input_xbar5.$name      = "CONFIG_INPUT_XBAR4";
input_xbar5.instance   = "INPUT_XBAR_4";
input_xbar5.xbarOutput = "GPIO51";

input_xbar6.$name      = "CONFIG_INPUT_XBAR5";
input_xbar6.instance   = "INPUT_XBAR_5";
input_xbar6.xbarOutput = "GPIO53";

/**
 * Pinmux solution for unlocked pins/peripherals. This ensures that minor changes to the automatic solver in a future
 * version of the tool will not impact the pinmux you originally saw.  These lines can be completely deleted in order to
 * re-solve from scratch.
 */
epwm1.EPWM.$suggestSolution   = "EPWM0";
epwm3.EPWM.$suggestSolution   = "EPWM2";
epwm3.EPWM.A.$suggestSolution = "EPWM2_A";
epwm3.EPWM.B.$suggestSolution = "EPWM2_B";
epwm5.EPWM.A.$suggestSolution = "EPWM4_A";
epwm5.EPWM.B.$suggestSolution = "EPWM4_B";
epwm6.EPWM.A.$suggestSolution = "EPWM5_A";
epwm6.EPWM.B.$suggestSolution = "EPWM5_B";
uart1.UART.$suggestSolution   = "UART0";
