/**
 * @cliArgs --device "AM263Px" --package "ZCZ_S" --part "AM263P4" --context "r5fss0-0" --product "MCU_PLUS_SDK@07.03.01"
 * @versions {"tool":"1.17.0+3128"}
 */

/**
 * Import the modules used in this configuration.
 */
const pmic            = scripting.addModule("/board/pmic/pmic", {}, false);
const pmic1           = pmic.addInstance();
const ecap        = scripting.addModule("/drivers/ecap/ecap", {}, false);
const ecap1       = ecap.addInstance();
const ecap2       = ecap.addInstance();
const ecap3       = ecap.addInstance();
const ecap4       = ecap.addInstance();
const ecap5       = ecap.addInstance();
const ecap6       = ecap.addInstance();
const epwm        = scripting.addModule("/drivers/epwm/epwm", {}, false);
const epwm1       = epwm.addInstance();
const epwm2       = epwm.addInstance();
const epwm3       = epwm.addInstance();
const epwm4       = epwm.addInstance();
const epwm5       = epwm.addInstance();
const epwm6       = epwm.addInstance();
const mcspi           = scripting.addModule("/drivers/mcspi/mcspi", {}, false);
const mcspi1          = mcspi.addInstance();
const debug_log   = scripting.addModule("/kernel/dpl/debug_log");
const dpl_cfg = scripting.addModule("/kernel/dpl/dpl_cfg");
const mpu_armv7   = scripting.addModule("/kernel/dpl/mpu_armv7", {}, false);
const mpu_armv71  = mpu_armv7.addInstance();
const mpu_armv72  = mpu_armv7.addInstance();
const mpu_armv73  = mpu_armv7.addInstance();
const mpu_armv74  = mpu_armv7.addInstance();
const default_linker  = scripting.addModule("/memory_configurator/default_linker", {}, false);
const default_linker1 = default_linker.addInstance();
const general         = scripting.addModule("/memory_configurator/general", {}, false);
const general1        = general.addInstance();
const region          = scripting.addModule("/memory_configurator/region", {}, false);
const region1         = region.addInstance();
const section         = scripting.addModule("/memory_configurator/section", {}, false);
const section1        = section.addInstance();
const section2        = section.addInstance();
const section3        = section.addInstance();
const section4        = section.addInstance();
const section5        = section.addInstance();
const section6        = section.addInstance();
const section7        = section.addInstance();
const section8        = section.addInstance();
const section9        = section.addInstance();
const section10       = section.addInstance();
const section11       = section.addInstance();
const section12       = section.addInstance();
const input_xbar  = scripting.addModule("/xbar/input_xbar/input_xbar", {}, false);
const input_xbar1 = input_xbar.addInstance();
const input_xbar2 = input_xbar.addInstance();
const input_xbar3 = input_xbar.addInstance();
const input_xbar4 = input_xbar.addInstance();
const input_xbar5 = input_xbar.addInstance();
const input_xbar6 = input_xbar.addInstance();

/**
 * Write custom configuration values to the imported modules.
 */
pmic1.$name = "CONFIG_PMIC0";

ecap1.syncInPulseSource = "ECAP_SYNC_IN_PULSE_SRC_SYNCOUT_EPWM0";
ecap1.ecapInput         = "ECAP_INPUT_INPUTXBAR0";
ecap1.useInterrupts     = false;
ecap1.$name             = "REF_CAPTURE";
ecap1.enableLoadCounter = true;
ecap1.loadCounter       = true;
ecap1.eventOnePolarity  = "ECAP_EVNT_FALLING_EDGE";
ecap1.syncOutMode       = "ECAP_SYNC_OUT_DISABLED";

ecap2.ecapBase          = "CSL_CONTROLSS_ECAP1_U_BASE";
ecap2.syncInPulseSource = "ECAP_SYNC_IN_PULSE_SRC_SYNCOUT_EPWM0";
ecap2.useInterrupts     = false;
ecap2.enableLoadCounter = true;
ecap2.loadCounter       = true;
ecap2.$name             = "ECAP1_CAPTURE";
ecap2.eventOnePolarity  = "ECAP_EVNT_FALLING_EDGE";
ecap2.syncOutMode       = "ECAP_SYNC_OUT_DISABLED";

ecap3.ecapBase          = "CSL_CONTROLSS_ECAP2_U_BASE";
ecap3.syncInPulseSource = "ECAP_SYNC_IN_PULSE_SRC_SYNCOUT_EPWM0";
ecap3.ecapInput         = "ECAP_INPUT_INPUTXBAR2";
ecap3.useInterrupts     = false;
ecap3.enableLoadCounter = true;
ecap3.loadCounter       = true;
ecap3.$name             = "ECAP2_CAPTURE";
ecap3.eventOnePolarity  = "ECAP_EVNT_FALLING_EDGE";
ecap3.syncOutMode       = "ECAP_SYNC_OUT_DISABLED";

ecap4.ecapBase          = "CSL_CONTROLSS_ECAP3_U_BASE";
ecap4.$name             = "ECAP3_CAPTURE";
ecap4.eventOnePolarity  = "ECAP_EVNT_FALLING_EDGE";
ecap4.useInterrupts     = false;
ecap4.enableLoadCounter = true;
ecap4.loadCounter       = true;
ecap4.syncOutMode       = "ECAP_SYNC_OUT_DISABLED";
ecap4.ecapInput         = "ECAP_INPUT_INPUTXBAR3";
ecap4.syncInPulseSource = "ECAP_SYNC_IN_PULSE_SRC_SYNCOUT_EPWM0";

ecap5.$name             = "ECAP4_CAPTURE";
ecap5.ecapBase          = "CSL_CONTROLSS_ECAP4_U_BASE";
ecap5.eventOnePolarity  = "ECAP_EVNT_FALLING_EDGE";
ecap5.useInterrupts     = false;
ecap5.enableLoadCounter = true;
ecap5.loadCounter       = true;
ecap5.syncOutMode       = "ECAP_SYNC_OUT_DISABLED";
ecap5.ecapInput         = "ECAP_INPUT_INPUTXBAR4";
ecap5.syncInPulseSource = "ECAP_SYNC_IN_PULSE_SRC_SYNCOUT_EPWM0";

ecap6.$name             = "ECAP5_CAPTURE";
ecap6.ecapBase          = "CSL_CONTROLSS_ECAP5_U_BASE";
ecap6.eventOnePolarity  = "ECAP_EVNT_FALLING_EDGE";
ecap6.useInterrupts     = false;
ecap6.enableLoadCounter = true;
ecap6.loadCounter       = true;
ecap6.syncOutMode       = "ECAP_SYNC_OUT_DISABLED";
ecap6.ecapInput         = "ECAP_INPUT_INPUTXBAR5";
ecap6.syncInPulseSource = "ECAP_SYNC_IN_PULSE_SRC_SYNCOUT_EPWM0";

epwm1.$name                                                    = "CONFIG_EPWM0";
epwm1.epwmTimebase_period                                      = 2000;
epwm1.epwmTimebase_syncOutPulseMode                            = ["EPWM_SYNC_OUT_PULSE_ON_CNTR_ZERO"];
epwm1.epwmTimebase_clockDiv                                    = "EPWM_CLOCK_DIVIDER_8";
epwm1.epwmTimebase_counterMode                                 = "EPWM_COUNTER_MODE_UP";
epwm1.epwmTimebase_syncInPulseSource                           = "EPWM_SYNC_IN_PULSE_SRC_SYNCOUT_EPWM0";
epwm1.epwmCounterCompare_cmpA                                  = 1000;
epwm1.epwmCounterCompare_cmpB                                  = 500;
epwm1.epwmActionQualifier_EPWM_AQ_OUTPUT_A_ON_TIMEBASE_ZERO    = "EPWM_AQ_OUTPUT_HIGH";
epwm1.epwmActionQualifier_EPWM_AQ_OUTPUT_A_ON_TIMEBASE_UP_CMPA = "EPWM_AQ_OUTPUT_LOW";
epwm1.epwmActionQualifier_EPWM_AQ_OUTPUT_B_ON_TIMEBASE_ZERO    = "EPWM_AQ_OUTPUT_HIGH";
epwm1.epwmActionQualifier_EPWM_AQ_OUTPUT_B_ON_TIMEBASE_UP_CMPB = "EPWM_AQ_OUTPUT_LOW";
epwm1.EPWM.$assign                                             = "EPWM0";

epwm2.$name                                                    = "CONFIG_EPWM1";
epwm2.epwmTimebase_syncInPulseSource                           = "EPWM_SYNC_IN_PULSE_SRC_SYNCOUT_EPWM0";
epwm2.epwmTimebase_period                                      = 2000;
epwm2.epwmTimebase_phaseEnable                                 = true;
epwm2.epwmTimebase_clockDiv                                    = "EPWM_CLOCK_DIVIDER_8";
epwm2.epwmTimebase_counterMode                                 = "EPWM_COUNTER_MODE_UP";
epwm2.epwmTimebase_phaseShift                                  = 300;
epwm2.epwmCounterCompare_cmpA                                  = 1000;
epwm2.epwmCounterCompare_cmpB                                  = 500;
epwm2.epwmActionQualifier_EPWM_AQ_OUTPUT_A_ON_TIMEBASE_ZERO    = "EPWM_AQ_OUTPUT_HIGH";
epwm2.epwmActionQualifier_EPWM_AQ_OUTPUT_A_ON_TIMEBASE_UP_CMPA = "EPWM_AQ_OUTPUT_LOW";
epwm2.epwmActionQualifier_EPWM_AQ_OUTPUT_B_ON_TIMEBASE_ZERO    = "EPWM_AQ_OUTPUT_HIGH";
epwm2.epwmActionQualifier_EPWM_AQ_OUTPUT_B_ON_TIMEBASE_UP_CMPB = "EPWM_AQ_OUTPUT_LOW";
epwm2.EPWM.$assign                                             = "EPWM1";

epwm3.$name                                                    = "CONFIG_EPWM2";
epwm3.epwmTimebase_syncInPulseSource                           = "EPWM_SYNC_IN_PULSE_SRC_SYNCOUT_EPWM0";
epwm3.epwmTimebase_period                                      = 2000;
epwm3.epwmDeadband_polarityFED                                 = "EPWM_DB_POLARITY_ACTIVE_LOW";
epwm3.epwmDeadband_polarityRED                                 = "EPWM_DB_POLARITY_ACTIVE_LOW";
epwm3.epwmTimebase_phaseEnable                                 = true;
epwm3.epwmTimebase_clockDiv                                    = "EPWM_CLOCK_DIVIDER_8";
epwm3.epwmTimebase_counterMode                                 = "EPWM_COUNTER_MODE_UP";
epwm3.epwmTimebase_phaseShift                                  = 600;
epwm3.epwmCounterCompare_cmpA                                  = 1000;
epwm3.epwmCounterCompare_cmpB                                  = 500;
epwm3.epwmActionQualifier_EPWM_AQ_OUTPUT_A_ON_TIMEBASE_ZERO    = "EPWM_AQ_OUTPUT_HIGH";
epwm3.epwmActionQualifier_EPWM_AQ_OUTPUT_A_ON_TIMEBASE_UP_CMPA = "EPWM_AQ_OUTPUT_LOW";
epwm3.epwmActionQualifier_EPWM_AQ_OUTPUT_B_ON_TIMEBASE_ZERO    = "EPWM_AQ_OUTPUT_HIGH";
epwm3.epwmActionQualifier_EPWM_AQ_OUTPUT_B_ON_TIMEBASE_UP_CMPB = "EPWM_AQ_OUTPUT_LOW";
epwm3.EPWM.$assign                                             = "EPWM2";

epwm4.$name                                                    = "CONFIG_EPWM3";
epwm4.epwmTimebase_syncInPulseSource                           = "EPWM_SYNC_IN_PULSE_SRC_SYNCOUT_EPWM0";
epwm4.epwmTimebase_period                                      = 2000;
epwm4.epwmDeadband_enableFED                                   = true;
epwm4.epwmDeadband_delayFED                                    = 200;
epwm4.epwmDeadband_polarityFED                                 = "EPWM_DB_POLARITY_ACTIVE_LOW";
epwm4.epwmTimebase_phaseEnable                                 = true;
epwm4.epwmTimebase_clockDiv                                    = "EPWM_CLOCK_DIVIDER_8";
epwm4.epwmTimebase_counterMode                                 = "EPWM_COUNTER_MODE_UP";
epwm4.epwmTimebase_phaseShift                                  = 900;
epwm4.epwmCounterCompare_cmpB                                  = 500;
epwm4.epwmCounterCompare_cmpA                                  = 1000;
epwm4.epwmActionQualifier_EPWM_AQ_OUTPUT_A_ON_TIMEBASE_ZERO    = "EPWM_AQ_OUTPUT_HIGH";
epwm4.epwmActionQualifier_EPWM_AQ_OUTPUT_A_ON_TIMEBASE_UP_CMPA = "EPWM_AQ_OUTPUT_LOW";
epwm4.epwmActionQualifier_EPWM_AQ_OUTPUT_B_ON_TIMEBASE_ZERO    = "EPWM_AQ_OUTPUT_HIGH";
epwm4.epwmActionQualifier_EPWM_AQ_OUTPUT_B_ON_TIMEBASE_UP_CMPB = "EPWM_AQ_OUTPUT_LOW";
epwm4.EPWM.$assign                                             = "EPWM3";

epwm5.$name                      = "CONFIG_EPWM4";
epwm5.epwmTimebase_period        = 2000;
epwm5.epwmTimebase_emulationMode = "EPWM_EMULATION_FREE_RUN";
epwm5.EPWM.$assign               = "EPWM4";
epwm5.EPWM.B.$assign             = "EPWM4_B";

epwm6.$name                      = "CONFIG_EPWM5";
epwm6.epwmTimebase_emulationMode = "EPWM_EMULATION_FREE_RUN";
epwm6.epwmTimebase_period        = 2000;

mcspi1.$name                 = "CONFIG_MCSPI0";
pmic1.peripheralDriver       = mcspi1;
mcspi1.SPI.$assign           = "SPI1";
mcspi1.mcspiChannel[0].$name = "CONFIG_MCSPI_CH0";

const edma                  = scripting.addModule("/drivers/edma/edma", {}, false);
const edma1                 = edma.addInstance({}, false);
edma1.$name                 = "CONFIG_EDMA0";
mcspi1.edmaDriver           = edma1;
edma1.edmaRmDmaCh[0].$name  = "CONFIG_EDMA_RM0";
edma1.edmaRmQdmaCh[0].$name = "CONFIG_EDMA_RM1";
edma1.edmaRmTcc[0].$name    = "CONFIG_EDMA_RM2";
edma1.edmaRmParam[0].$name  = "CONFIG_EDMA_RM3";

debug_log.enableUartLog            = true;
debug_log.uartLog.$name            = "CONFIG_UART0";
debug_log.uartLog.UART.RXD.$assign = "UART0_RXD";
debug_log.uartLog.UART.TXD.$assign = "UART0_TXD";

mpu_armv71.$name             = "CONFIG_MPU_REGION0";
mpu_armv71.size              = 31;
mpu_armv71.attributes        = "Device";
mpu_armv71.accessPermissions = "Supervisor RD+WR, User RD";
mpu_armv71.allowExecute      = false;

mpu_armv72.$name             = "CONFIG_MPU_REGION1";
mpu_armv72.size              = 15;
mpu_armv72.accessPermissions = "Supervisor RD+WR, User RD";

mpu_armv73.$name             = "CONFIG_MPU_REGION2";
mpu_armv73.baseAddr          = 0x80000;
mpu_armv73.size              = 15;
mpu_armv73.accessPermissions = "Supervisor RD+WR, User RD";

mpu_armv74.$name             = "CONFIG_MPU_REGION3";
mpu_armv74.accessPermissions = "Supervisor RD+WR, User RD";
mpu_armv74.baseAddr          = 0x70000000;
mpu_armv74.size              = 21;

default_linker1.$name = "memory_configurator_default_linker0";

general1.$name        = "CONFIG_GENERAL0";
general1.linker.$name = "TIARMCLANG0";

region1.$name                                = "MEMORY_REGION_CONFIGURATION0";
region1.memory_region.create(11);
region1.memory_region[0].type                = "TCMA";
region1.memory_region[0].$name               = "R5F_VECS";
region1.memory_region[0].size                = 0x40;
region1.memory_region[0].auto                = false;
region1.memory_region[1].type                = "TCMA";
region1.memory_region[1].$name               = "R5F_TCMA";
region1.memory_region[1].size                = 0x7FC0;
region1.memory_region[2].type                = "TCMB";
region1.memory_region[2].size                = 0x8000;
region1.memory_region[2].$name               = "R5F_TCMB";
region1.memory_region[3].$name               = "SBL";
region1.memory_region[3].auto                = false;
region1.memory_region[3].size                = 0x40000;
region1.memory_region[4].$name               = "OCRAM";
region1.memory_region[4].auto                = false;
region1.memory_region[4].manualStartAddress  = 0x70040000;
region1.memory_region[4].size                = 0x40000;
region1.memory_region[5].type                = "FLASH";
region1.memory_region[5].auto                = false;
region1.memory_region[5].manualStartAddress  = 0x60100000;
region1.memory_region[5].size                = 0x80000;
region1.memory_region[5].$name               = "FLASH";
region1.memory_region[6].$name               = "USER_SHM_MEM";
region1.memory_region[6].auto                = false;
region1.memory_region[6].manualStartAddress  = 0x701D0000;
region1.memory_region[6].size                = 0x4000;
region1.memory_region[6].isShared            = true;
region1.memory_region[6].shared_cores        = ["r5fss0-1","r5fss1-0","r5fss1-1"];
region1.memory_region[7].$name               = "LOG_SHM_MEM";
region1.memory_region[7].auto                = false;
region1.memory_region[7].manualStartAddress  = 0x701D4000;
region1.memory_region[7].size                = 0x4000;
region1.memory_region[7].isShared            = true;
region1.memory_region[7].shared_cores        = ["r5fss0-1","r5fss1-0","r5fss1-1"];
region1.memory_region[8].type                = "CUSTOM";
region1.memory_region[8].$name               = "RTOS_NORTOS_IPC_SHM_MEM";
region1.memory_region[8].auto                = false;
region1.memory_region[8].manualStartAddress  = 0x72000000;
region1.memory_region[8].size                = 0x3E80;
region1.memory_region[8].isShared            = true;
region1.memory_region[8].shared_cores        = ["r5fss0-1","r5fss1-0","r5fss1-1"];
region1.memory_region[9].type                = "CUSTOM";
region1.memory_region[9].$name               = "MAILBOX_HSM";
region1.memory_region[9].auto                = false;
region1.memory_region[9].manualStartAddress  = 0x44000000;
region1.memory_region[9].size                = 0x3CE;
region1.memory_region[9].isShared            = true;
region1.memory_region[9].shared_cores        = ["r5fss0-1","r5fss1-0","r5fss1-1"];
region1.memory_region[10].type               = "CUSTOM";
region1.memory_region[10].$name              = "MAILBOX_R5F";
region1.memory_region[10].auto               = false;
region1.memory_region[10].manualStartAddress = 0x44000400;
region1.memory_region[10].size               = 0x3CE;
region1.memory_region[10].isShared           = true;
region1.memory_region[10].shared_cores       = ["r5fss0-1","r5fss1-0","r5fss1-1"];

section1.load_memory                  = "R5F_VECS";
section1.group                        = false;
section1.$name                        = "Vector Table";
section1.output_section.create(1);
section1.output_section[0].$name      = ".vectors";
section1.output_section[0].palignment = true;

section2.load_memory                  = "OCRAM";
section2.$name                        = "Text Segments";
section2.output_section.create(5);
section2.output_section[0].$name      = ".text.hwi";
section2.output_section[0].palignment = true;
section2.output_section[1].$name      = ".text.cache";
section2.output_section[1].palignment = true;
section2.output_section[2].$name      = ".text.mpu";
section2.output_section[2].palignment = true;
section2.output_section[3].$name      = ".text.boot";
section2.output_section[3].palignment = true;
section2.output_section[4].$name      = ".text:abort";
section2.output_section[4].palignment = true;

section3.load_memory                  = "OCRAM";
section3.$name                        = "Code and Read-Only Data";
section3.output_section.create(2);
section3.output_section[0].$name      = ".text";
section3.output_section[0].palignment = true;
section3.output_section[1].$name      = ".rodata";
section3.output_section[1].palignment = true;

section4.load_memory                  = "OCRAM";
section4.$name                        = "Data Segment";
section4.output_section.create(1);
section4.output_section[0].$name      = ".data";
section4.output_section[0].palignment = true;

section5.load_memory                             = "OCRAM";
section5.$name                                   = "Memory Segments";
section5.output_section.create(3);
section5.output_section[0].$name                 = ".bss";
section5.output_section[0].output_sections_start = "__BSS_START";
section5.output_section[0].output_sections_end   = "__BSS_END";
section5.output_section[0].palignment            = true;
section5.output_section[1].$name                 = ".sysmem";
section5.output_section[1].palignment            = true;
section5.output_section[2].$name                 = ".stack";
section5.output_section[2].palignment            = true;

section6.load_memory                              = "OCRAM";
section6.$name                                    = "Stack Segments";
section6.output_section.create(5);
section6.output_section[0].$name                  = ".irqstack";
section6.output_section[0].output_sections_start  = "__IRQ_STACK_START";
section6.output_section[0].output_sections_end    = "__IRQ_STACK_END";
section6.output_section[0].input_section.create(1);
section6.output_section[0].input_section[0].$name = ". = . + __IRQ_STACK_SIZE;";
section6.output_section[1].$name                  = ".fiqstack";
section6.output_section[1].output_sections_start  = "__FIQ_STACK_START";
section6.output_section[1].output_sections_end    = "__FIQ_STACK_END";
section6.output_section[1].input_section.create(1);
section6.output_section[1].input_section[0].$name = ". = . + __FIQ_STACK_SIZE;";
section6.output_section[2].$name                  = ".svcstack";
section6.output_section[2].output_sections_start  = "__SVC_STACK_START";
section6.output_section[2].output_sections_end    = "__SVC_STACK_END";
section6.output_section[2].input_section.create(1);
section6.output_section[2].input_section[0].$name = ". = . + __SVC_STACK_SIZE;";
section6.output_section[3].$name                  = ".abortstack";
section6.output_section[3].output_sections_start  = "__ABORT_STACK_START";
section6.output_section[3].output_sections_end    = "__ABORT_STACK_END";
section6.output_section[3].input_section.create(1);
section6.output_section[3].input_section[0].$name = ". = . + __ABORT_STACK_SIZE;";
section6.output_section[4].$name                  = ".undefinedstack";
section6.output_section[4].output_sections_start  = "__UNDEFINED_STACK_START";
section6.output_section[4].output_sections_end    = "__UNDEFINED_STACK_END";
section6.output_section[4].input_section.create(1);
section6.output_section[4].input_section[0].$name = ". = . + __UNDEFINED_STACK_SIZE;";

section7.load_memory                  = "OCRAM";
section7.$name                        = "Initialization and Exception Handling";
section7.output_section.create(3);
section7.output_section[0].$name      = ".ARM.exidx";
section7.output_section[0].palignment = true;
section7.output_section[1].$name      = ".init_array";
section7.output_section[1].palignment = true;
section7.output_section[2].$name      = ".fini_array";
section7.output_section[2].palignment = true;

section8.load_memory                 = "USER_SHM_MEM";
section8.type                        = "NOLOAD";
section8.$name                       = "User Shared Memory";
section8.group                       = false;
section8.output_section.create(1);
section8.output_section[0].$name     = ".bss.user_shared_mem";
section8.output_section[0].alignment = 0;

section9.load_memory                 = "LOG_SHM_MEM";
section9.$name                       = "Log Shared Memory";
section9.group                       = false;
section9.type                        = "NOLOAD";
section9.output_section.create(1);
section9.output_section[0].$name     = ".bss.log_shared_mem";
section9.output_section[0].alignment = 0;

section10.load_memory                 = "RTOS_NORTOS_IPC_SHM_MEM";
section10.type                        = "NOLOAD";
section10.$name                       = "IPC Shared Memory";
section10.group                       = false;
section10.output_section.create(1);
section10.output_section[0].$name     = ".bss.ipc_vring_mem";
section10.output_section[0].alignment = 0;

section11.load_memory                 = "MAILBOX_HSM";
section11.type                        = "NOLOAD";
section11.$name                       = "SIPC HSM Queue Memory";
section11.group                       = false;
section11.output_section.create(1);
section11.output_section[0].$name     = ".bss.sipc_hsm_queue_mem";
section11.output_section[0].alignment = 0;

section12.load_memory                 = "MAILBOX_R5F";
section12.$name                       = "SIPC R5F Queue Memory";
section12.group                       = false;
section12.type                        = "NOLOAD";
section12.output_section.create(1);
section12.output_section[0].$name     = ".bss.sipc_secure_host_queue_mem";
section12.output_section[0].alignment = 0;

input_xbar1.$name      = "CONFIG_INPUT_XBAR0";
input_xbar1.xbarOutput = "GPIO43";

input_xbar2.$name      = "CONFIG_INPUT_XBAR1";
input_xbar2.instance   = "INPUT_XBAR_1";
input_xbar2.xbarOutput = "GPIO45";

input_xbar3.$name      = "CONFIG_INPUT_XBAR2";
input_xbar3.instance   = "INPUT_XBAR_2";
input_xbar3.xbarOutput = "GPIO47";

input_xbar4.$name      = "CONFIG_INPUT_XBAR3";
input_xbar4.xbarOutput = "GPIO49";
input_xbar4.instance   = "INPUT_XBAR_3";

input_xbar5.$name      = "CONFIG_INPUT_XBAR4";
input_xbar5.instance   = "INPUT_XBAR_4";
input_xbar5.xbarOutput = "GPIO51";

input_xbar6.$name      = "CONFIG_INPUT_XBAR5";
input_xbar6.instance   = "INPUT_XBAR_5";
input_xbar6.xbarOutput = "GPIO53";

/**
 * Pinmux solution for unlocked pins/peripherals. This ensures that minor changes to the automatic solver in a future
 * version of the tool will not impact the pinmux you originally saw.  These lines can be completely deleted in order to
 * re-solve from scratch.
 */
epwm1.EPWM.A.$suggestSolution           = "EPWM0_A";
epwm1.EPWM.B.$suggestSolution           = "EPWM0_B";
epwm2.EPWM.A.$suggestSolution           = "EPWM1_A";
epwm2.EPWM.B.$suggestSolution           = "EPWM1_B";
epwm3.EPWM.A.$suggestSolution           = "EPWM2_A";
epwm3.EPWM.B.$suggestSolution           = "EPWM2_B";
epwm4.EPWM.A.$suggestSolution           = "EPWM3_A";
epwm4.EPWM.B.$suggestSolution           = "EPWM3_B";
epwm5.EPWM.A.$suggestSolution           = "EPWM4_A";
epwm6.EPWM.$suggestSolution             = "EPWM5";
epwm6.EPWM.A.$suggestSolution           = "EPWM5_A";
epwm6.EPWM.B.$suggestSolution           = "EPWM5_B";
debug_log.uartLog.UART.$suggestSolution = "UART0";
mcspi1.SPI.CLK.$suggestSolution             = "SPI1_CLK";
mcspi1.SPI.D0.$suggestSolution              = "SPI1_D0";
mcspi1.SPI.D1.$suggestSolution              = "SPI1_D1";
mcspi1.mcspiChannel[0].CSn.$suggestSolution = "SPI1_CS0";
