/**
 * @cliArgs --device "AM261x_ZCZ" --package "ZCZ" --part "AM2611" --context "r5fss0-0" --product "MCU_PLUS_SDK@07.03.01"
 * @versions {"tool":"1.18.0+3266"}
 */

/**
 * Import the modules used in this configuration.
 */
const epwm            = scripting.addModule("/drivers/epwm/epwm", {}, false);
const epwm1           = epwm.addInstance();
const epwm2           = epwm.addInstance();
const epwm3           = epwm.addInstance();
const epwm4           = epwm.addInstance();
const epwm5           = epwm.addInstance();
const epwm6           = epwm.addInstance();
const epwm7           = epwm.addInstance();
const debug_log       = scripting.addModule("/kernel/dpl/debug_log");
const dpl_cfg = scripting.addModule("/kernel/dpl/dpl_cfg");
const mpu_armv7       = scripting.addModule("/kernel/dpl/mpu_armv7", {}, false);
const mpu_armv71      = mpu_armv7.addInstance();
const mpu_armv72      = mpu_armv7.addInstance();
const mpu_armv73      = mpu_armv7.addInstance();
const mpu_armv74      = mpu_armv7.addInstance();
const default_linker  = scripting.addModule("/memory_configurator/default_linker", {}, false);
const default_linker1 = default_linker.addInstance();
const general         = scripting.addModule("/memory_configurator/general", {}, false);
const general1        = general.addInstance();
const region          = scripting.addModule("/memory_configurator/region", {}, false);
const region1         = region.addInstance();
const section         = scripting.addModule("/memory_configurator/section", {}, false);
const section1        = section.addInstance();
const section2        = section.addInstance();
const section3        = section.addInstance();
const section4        = section.addInstance();
const section5        = section.addInstance();
const section6        = section.addInstance();
const section7        = section.addInstance();
const section8        = section.addInstance();
const section9        = section.addInstance();
const section10       = section.addInstance();
const section11       = section.addInstance();
const section12       = section.addInstance();
const epwm_xbar       = scripting.addModule("/xbar/epwm_xbar/epwm_xbar", {}, false);
const epwm_xbar1      = epwm_xbar.addInstance();
const icl_xbar        = scripting.addModule("/xbar/icl_xbar/icl_xbar", {}, false);
const icl_xbar1       = icl_xbar.addInstance();
const icl_xbar2       = icl_xbar.addInstance();
const icl_xbar3       = icl_xbar.addInstance();
const icl_xbar4       = icl_xbar.addInstance();
const icl_xbar5       = icl_xbar.addInstance();
const icl_xbar6       = icl_xbar.addInstance();

/**
 * Write custom configuration values to the imported modules.
 */
epwm1.$name                                                    = "CONFIG_EPWM0";
epwm1.epwmXCMP_SplitCheck                                      = true;
epwm1.epwmTimebase_counterMode                                 = "EPWM_COUNTER_MODE_UP";
epwm1.epwmTimebase_period                                      = 24000;
epwm1.epwmActionQualifier_EPWM_AQ_OUTPUT_A_ON_TIMEBASE_UP_CMPA = "EPWM_AQ_OUTPUT_HIGH";
epwm1.epwmActionQualifier_EPWM_AQ_OUTPUT_A_ON_TIMEBASE_PERIOD  = "EPWM_AQ_OUTPUT_LOW";
epwm1.epwmActionQualifier_EPWM_AQ_OUTPUT_B_ON_TIMEBASE_UP_CMPA = "EPWM_AQ_OUTPUT_LOW";
epwm1.epwmActionQualifier_EPWM_AQ_OUTPUT_B_ON_TIMEBASE_PERIOD  = "EPWM_AQ_OUTPUT_HIGH";
epwm1.epwmTripZone_EPWM_TZ_ACTION_EVENT_DCAEVT1                = "EPWM_TZ_ACTION_HIGH";
epwm1.epwmDigitalCompare_EPWM_TZ_DC_OUTPUT_A1                  = "EPWM_TZ_EVENT_DCXH_HIGH";
epwm1.epwmTripZone_EPWM_TZ_ACTION_EVENT_TZA                    = "EPWM_TZ_ACTION_DISABLE";
epwm1.epwmTripZone_EPWM_TZ_ACTION_EVENT_TZB                    = "EPWM_TZ_ACTION_DISABLE";
epwm1.epwmTripZone_EPWM_TZ_ACTION_EVENT_DCAEVT2                = "EPWM_TZ_ACTION_DISABLE";
epwm1.epwmTripZone_EPWM_TZ_ACTION_EVENT_DCBEVT1                = "EPWM_TZ_ACTION_DISABLE";
epwm1.epwmTripZone_EPWM_TZ_ACTION_EVENT_DCBEVT2                = "EPWM_TZ_ACTION_DISABLE";
epwm1.epwmCounterCompare_cmpA                                  = 20000;
epwm1.epwmTimebase_syncInPulseSource                           = "EPWM_SYNC_IN_PULSE_SRC_SYNCOUT_EPWM1";
epwm1.epwmICL_useICLB                                          = true;
epwm1.epwmICLB_LUTDEC_1                                        = "1";
epwm1.epwmICLB_LUTDEC_5                                        = "1";
epwm1.EPWM.$assign                                             = "EPWM0";

epwm2.$name                                                    = "CONFIG_EPWM1";
epwm2.epwmCounterCompare_cmpA                                  = 8000;
epwm2.epwmActionQualifier_EPWM_AQ_OUTPUT_A_ON_TIMEBASE_UP_CMPA = "EPWM_AQ_OUTPUT_HIGH";
epwm2.epwmActionQualifier_EPWM_AQ_OUTPUT_A_ON_TIMEBASE_UP_CMPB = "EPWM_AQ_OUTPUT_LOW";
epwm2.epwmCounterCompare_cmpB                                  = 9000;
epwm2.epwmTimebase_counterMode                                 = "EPWM_COUNTER_MODE_UP_DOWN";
epwm2.epwmTimebase_period                                      = 24000;
epwm2.epwmTimebase_syncOutPulseMode                            = ["EPWM_SYNC_OUT_PULSE_ON_CNTR_ZERO"];
epwm2.EPWM.$assign                                             = "EPWM1";
epwm2.EPWM.B.$assign                                           = "GPIO46";

epwm3.$name              = "CONFIG_EPWM2";
epwm3.epwmICL_useICLA    = true;
epwm3.epwmICL_useICLB    = true;
epwm3.epwmICLB_IN3source = "1";
epwm3.epwmICLA_LUTDEC_4  = "1";
epwm3.epwmICLA_LUTDEC_5  = "1";
epwm3.epwmICLA_LUTDEC_6  = "1";
epwm3.epwmICLA_LUTDEC_7  = "1";
epwm3.epwmICLB_LUTDEC_4  = "1";
epwm3.epwmICLB_LUTDEC_5  = "1";
epwm3.epwmICLB_LUTDEC_6  = "1";
epwm3.epwmICLB_LUTDEC_7  = "1";
epwm3.EPWM.$assign       = "EPWM2";

epwm4.$name                                                      = "CONFIG_EPWM3";
epwm4.epwmTimebase_period                                        = 24000;
epwm4.epwmTimebase_counterMode                                   = "EPWM_COUNTER_MODE_UP_DOWN";
epwm4.epwmCounterCompare_cmpA                                    = 8000;
epwm4.epwmCounterCompare_cmpB                                    = 16000;
epwm4.epwmActionQualifier_EPWM_AQ_OUTPUT_A_ON_TIMEBASE_ZERO      = "EPWM_AQ_OUTPUT_LOW";
epwm4.epwmActionQualifier_EPWM_AQ_OUTPUT_A_ON_TIMEBASE_UP_CMPA   = "EPWM_AQ_OUTPUT_HIGH";
epwm4.epwmActionQualifier_EPWM_AQ_OUTPUT_A_ON_TIMEBASE_PERIOD    = "EPWM_AQ_OUTPUT_HIGH";
epwm4.epwmActionQualifier_EPWM_AQ_OUTPUT_A_ON_TIMEBASE_UP_CMPB   = "EPWM_AQ_OUTPUT_LOW";
epwm4.epwmActionQualifier_EPWM_AQ_OUTPUT_A_ON_TIMEBASE_DOWN_CMPB = "EPWM_AQ_OUTPUT_LOW";
epwm4.epwmActionQualifier_EPWM_AQ_OUTPUT_A_ON_TIMEBASE_DOWN_CMPA = "EPWM_AQ_OUTPUT_HIGH";
epwm4.epwmActionQualifier_EPWM_AQ_OUTPUT_B_ON_TIMEBASE_PERIOD    = "EPWM_AQ_OUTPUT_HIGH";
epwm4.epwmActionQualifier_EPWM_AQ_OUTPUT_B_ON_TIMEBASE_ZERO      = "EPWM_AQ_OUTPUT_LOW";
epwm4.epwmICL_useICLA                                            = true;
epwm4.epwmICL_useICLB                                            = true;
epwm4.epwmICLA_LUTDEC_1                                          = "1";
epwm4.epwmICLA_LUTDEC_2                                          = "1";
epwm4.epwmICLA_LUTDEC_5                                          = "1";
epwm4.epwmICLA_LUTDEC_6                                          = "1";
epwm4.epwmICLB_LUTDEC_0                                          = "1";
epwm4.epwmICLB_LUTDEC_4                                          = "1";
epwm4.epwmICLB_LUTDEC_3                                          = "1";
epwm4.epwmICLB_LUTDEC_7                                          = "1";
epwm4.epwmTimebase_syncOutPulseMode                              = ["EPWM_SYNC_OUT_PULSE_ON_CNTR_ZERO"];
epwm4.EPWM.$assign                                               = "EPWM3";
epwm4.EPWM.B.$assign                                           = "GPIO50";

epwm5.$name              = "CONFIG_EPWM4";
epwm5.epwmICL_useICLA    = true;
epwm5.epwmICL_useICLB    = true;
epwm5.epwmICLA_LUTDEC_4  = "1";
epwm5.epwmICLA_LUTDEC_5  = "1";
epwm5.epwmICLA_LUTDEC_6  = "1";
epwm5.epwmICLA_LUTDEC_7  = "1";
epwm5.epwmICLB_LUTDEC_4  = "1";
epwm5.epwmICLB_LUTDEC_5  = "1";
epwm5.epwmICLB_LUTDEC_6  = "1";
epwm5.epwmICLB_LUTDEC_7  = "1";
epwm5.epwmICLA_IN3source = "2";
epwm5.epwmICLB_IN3source = "3";
epwm5.EPWM.$assign       = "EPWM4";

epwm6.$name                                                      = "CONFIG_EPWM5";
epwm6.epwmTimebase_period                                        = 24000;
epwm6.epwmTimebase_counterMode                                   = "EPWM_COUNTER_MODE_UP_DOWN";
epwm6.epwmTimebase_syncInPulseSource                             = "EPWM_SYNC_IN_PULSE_SRC_SYNCOUT_EPWM3";
epwm6.epwmActionQualifier_EPWM_AQ_OUTPUT_A_ON_TIMEBASE_ZERO      = "EPWM_AQ_OUTPUT_LOW";
epwm6.epwmActionQualifier_EPWM_AQ_OUTPUT_A_ON_TIMEBASE_PERIOD    = "EPWM_AQ_OUTPUT_HIGH";
epwm6.epwmActionQualifier_EPWM_AQ_OUTPUT_A_ON_TIMEBASE_UP_CMPA   = "EPWM_AQ_OUTPUT_HIGH";
epwm6.epwmActionQualifier_EPWM_AQ_OUTPUT_A_ON_TIMEBASE_DOWN_CMPA = "EPWM_AQ_OUTPUT_HIGH";
epwm6.epwmActionQualifier_EPWM_AQ_OUTPUT_A_ON_TIMEBASE_UP_CMPB   = "EPWM_AQ_OUTPUT_LOW";
epwm6.epwmActionQualifier_EPWM_AQ_OUTPUT_A_ON_TIMEBASE_DOWN_CMPB = "EPWM_AQ_OUTPUT_LOW";
epwm6.epwmActionQualifier_EPWM_AQ_OUTPUT_B_ON_TIMEBASE_ZERO      = "EPWM_AQ_OUTPUT_LOW";
epwm6.epwmActionQualifier_EPWM_AQ_OUTPUT_B_ON_TIMEBASE_PERIOD    = "EPWM_AQ_OUTPUT_HIGH";
epwm6.epwmCounterCompare_cmpA                                    = 8000;
epwm6.epwmCounterCompare_cmpB                                    = 16000;
epwm6.epwmICL_useICLA                                            = true;
epwm6.epwmICL_useICLB                                            = true;
epwm6.epwmICLA_LUTDEC_0                                          = "1";
epwm6.epwmICLA_LUTDEC_1                                          = "1";
epwm6.epwmICLA_LUTDEC_2                                          = "1";
epwm6.epwmICLA_LUTDEC_5                                          = "1";
epwm6.epwmICLA_LUTDEC_4                                          = "1";
epwm6.epwmICLA_LUTDEC_6                                          = "1";
epwm6.epwmICLB_LUTDEC_0                                          = "1";
epwm6.epwmICLB_LUTDEC_4                                          = "1";
epwm6.EPWM.$assign                                               = "EPWM5";

epwm7.$name              = "CONFIG_EPWM6";
epwm7.epwmICL_useICLA    = true;
epwm7.epwmICL_useICLB    = true;
epwm7.epwmICLA_IN3source = "4";
epwm7.epwmICLB_IN3source = "5";
epwm7.epwmICLA_LUTDEC_4  = "1";
epwm7.epwmICLA_LUTDEC_5  = "1";
epwm7.epwmICLA_LUTDEC_6  = "1";
epwm7.epwmICLA_LUTDEC_7  = "1";
epwm7.epwmICLB_LUTDEC_4  = "1";
epwm7.epwmICLB_LUTDEC_5  = "1";
epwm7.epwmICLB_LUTDEC_6  = "1";
epwm7.epwmICLB_LUTDEC_7  = "1";
epwm7.EPWM.$assign       = "EPWM6";
epwm7.EPWM.B.$assign     = "GPIO56";

const mcspi                  = scripting.addModule("/drivers/mcspi/mcspi", {}, false);
const mcspi1                 = mcspi.addInstance({}, false);
debug_log.enableUartLog            = true;
debug_log.uartLog.$name            = "CONFIG_UART0";
debug_log.uartLog.UART.RXD.$assign = "GPIO27";
debug_log.uartLog.UART.TXD.$assign = "GPIO28";

mpu_armv71.$name             = "CONFIG_MPU_REGION0";
mpu_armv71.size              = 31;
mpu_armv71.attributes        = "Device";
mpu_armv71.accessPermissions = "Supervisor RD+WR, User RD";
mpu_armv71.allowExecute      = false;

mpu_armv72.$name             = "CONFIG_MPU_REGION1";
mpu_armv72.size              = 15;
mpu_armv72.accessPermissions = "Supervisor RD+WR, User RD";

mpu_armv73.$name             = "CONFIG_MPU_REGION2";
mpu_armv73.baseAddr          = 0x80000;
mpu_armv73.size              = 15;
mpu_armv73.accessPermissions = "Supervisor RD+WR, User RD";

mpu_armv74.$name             = "CONFIG_MPU_REGION3";
mpu_armv74.accessPermissions = "Supervisor RD+WR, User RD";
mpu_armv74.baseAddr          = 0x70000000;
mpu_armv74.size              = 21;

default_linker1.$name = "memory_configurator_default_linker0";

general1.$name        = "CONFIG_GENERAL0";
general1.linker.$name = "TIARMCLANG0";

region1.$name                                = "MEMORY_REGION_CONFIGURATION0";
region1.memory_region.create(11);
region1.memory_region[0].type                = "TCMA";
region1.memory_region[0].$name               = "R5F_VECS";
region1.memory_region[0].size                = 0x40;
region1.memory_region[0].auto                = false;
region1.memory_region[1].type                = "TCMA";
region1.memory_region[1].$name               = "R5F_TCMA";
region1.memory_region[1].size                = 0x7FC0;
region1.memory_region[2].type                = "TCMB";
region1.memory_region[2].size                = 0x8000;
region1.memory_region[2].$name               = "R5F_TCMB";
region1.memory_region[3].$name               = "SBL";
region1.memory_region[3].auto                = false;
region1.memory_region[3].size                = 0x40000;
region1.memory_region[4].$name               = "OCRAM";
region1.memory_region[4].auto                = false;
region1.memory_region[4].manualStartAddress  = 0x70040000;
region1.memory_region[4].size                = 0x40000;
region1.memory_region[5].type                = "FLASH";
region1.memory_region[5].auto                = false;
region1.memory_region[5].manualStartAddress  = 0x60100000;
region1.memory_region[5].size                = 0x80000;
region1.memory_region[5].$name               = "FLASH";
region1.memory_region[6].$name               = "USER_SHM_MEM";
region1.memory_region[6].auto                = false;
region1.memory_region[6].manualStartAddress  = 0x70150000; 
region1.memory_region[6].size                = 0x4000;
region1.memory_region[6].isShared            = true;
region1.memory_region[6].shared_cores        = ["r5fss0-1"];
region1.memory_region[7].$name               = "LOG_SHM_MEM";
region1.memory_region[7].auto                = false;
region1.memory_region[7].manualStartAddress  = 0x70154000; 
region1.memory_region[7].size                = 0x4000;
region1.memory_region[7].isShared            = true;
region1.memory_region[7].shared_cores        = ["r5fss0-1"];
region1.memory_region[8].type                = "CUSTOM";
region1.memory_region[8].$name               = "RTOS_NORTOS_IPC_SHM_MEM";
region1.memory_region[8].auto                = false;
region1.memory_region[8].manualStartAddress  = 0x72000000;
region1.memory_region[8].size                = 0x3E80;
region1.memory_region[8].isShared            = true;
region1.memory_region[8].shared_cores        = ["r5fss0-1"];
region1.memory_region[9].type                = "CUSTOM";
region1.memory_region[9].$name               = "MAILBOX_HSM";
region1.memory_region[9].auto                = false;
region1.memory_region[9].manualStartAddress  = 0x44000000;
region1.memory_region[9].size                = 0x3CE;
region1.memory_region[9].isShared            = true;
region1.memory_region[9].shared_cores        = ["r5fss0-1"];
region1.memory_region[10].type               = "CUSTOM";
region1.memory_region[10].$name              = "MAILBOX_R5F";
region1.memory_region[10].auto               = false;
region1.memory_region[10].manualStartAddress = 0x44000400;
region1.memory_region[10].size               = 0x3CE;
region1.memory_region[10].isShared           = true;
region1.memory_region[10].shared_cores       = ["r5fss0-1"];

section1.load_memory                  = "R5F_VECS";
section1.group                        = false;
section1.$name                        = "Vector Table";
section1.output_section.create(1);
section1.output_section[0].$name      = ".vectors";
section1.output_section[0].palignment = true;

section2.load_memory                  = "OCRAM";
section2.$name                        = "Text Segments";
section2.output_section.create(5);
section2.output_section[0].$name      = ".text.hwi";
section2.output_section[0].palignment = true;
section2.output_section[1].$name      = ".text.cache";
section2.output_section[1].palignment = true;
section2.output_section[2].$name      = ".text.mpu";
section2.output_section[2].palignment = true;
section2.output_section[3].$name      = ".text.boot";
section2.output_section[3].palignment = true;
section2.output_section[4].$name      = ".text:abort";
section2.output_section[4].palignment = true;

section3.load_memory                  = "OCRAM";
section3.$name                        = "Code and Read-Only Data";
section3.output_section.create(2);
section3.output_section[0].$name      = ".text";
section3.output_section[0].palignment = true;
section3.output_section[1].$name      = ".rodata";
section3.output_section[1].palignment = true;

section4.load_memory                  = "OCRAM";
section4.$name                        = "Data Segment";
section4.output_section.create(1);
section4.output_section[0].$name      = ".data";
section4.output_section[0].palignment = true;

section5.load_memory                             = "OCRAM";
section5.$name                                   = "Memory Segments";
section5.output_section.create(3);
section5.output_section[0].$name                 = ".bss";
section5.output_section[0].output_sections_start = "__BSS_START";
section5.output_section[0].output_sections_end   = "__BSS_END";
section5.output_section[0].palignment            = true;
section5.output_section[1].$name                 = ".sysmem";
section5.output_section[1].palignment            = true;
section5.output_section[2].$name                 = ".stack";
section5.output_section[2].palignment            = true;

section6.load_memory                              = "OCRAM";
section6.$name                                    = "Stack Segments";
section6.output_section.create(5);
section6.output_section[0].$name                  = ".irqstack";
section6.output_section[0].output_sections_start  = "__IRQ_STACK_START";
section6.output_section[0].output_sections_end    = "__IRQ_STACK_END";
section6.output_section[0].input_section.create(1);
section6.output_section[0].input_section[0].$name = ". = . + __IRQ_STACK_SIZE;";
section6.output_section[1].$name                  = ".fiqstack";
section6.output_section[1].output_sections_start  = "__FIQ_STACK_START";
section6.output_section[1].output_sections_end    = "__FIQ_STACK_END";
section6.output_section[1].input_section.create(1);
section6.output_section[1].input_section[0].$name = ". = . + __FIQ_STACK_SIZE;";
section6.output_section[2].$name                  = ".svcstack";
section6.output_section[2].output_sections_start  = "__SVC_STACK_START";
section6.output_section[2].output_sections_end    = "__SVC_STACK_END";
section6.output_section[2].input_section.create(1);
section6.output_section[2].input_section[0].$name = ". = . + __SVC_STACK_SIZE;";
section6.output_section[3].$name                  = ".abortstack";
section6.output_section[3].output_sections_start  = "__ABORT_STACK_START";
section6.output_section[3].output_sections_end    = "__ABORT_STACK_END";
section6.output_section[3].input_section.create(1);
section6.output_section[3].input_section[0].$name = ". = . + __ABORT_STACK_SIZE;";
section6.output_section[4].$name                  = ".undefinedstack";
section6.output_section[4].output_sections_start  = "__UNDEFINED_STACK_START";
section6.output_section[4].output_sections_end    = "__UNDEFINED_STACK_END";
section6.output_section[4].input_section.create(1);
section6.output_section[4].input_section[0].$name = ". = . + __UNDEFINED_STACK_SIZE;";

section7.load_memory                  = "OCRAM";
section7.$name                        = "Initialization and Exception Handling";
section7.output_section.create(3);
section7.output_section[0].$name      = ".ARM.exidx";
section7.output_section[0].palignment = true;
section7.output_section[1].$name      = ".init_array";
section7.output_section[1].palignment = true;
section7.output_section[2].$name      = ".fini_array";
section7.output_section[2].palignment = true;

section8.load_memory                 = "USER_SHM_MEM";
section8.type                        = "NOLOAD";
section8.$name                       = "User Shared Memory";
section8.group                       = false;
section8.output_section.create(1);
section8.output_section[0].$name     = ".bss.user_shared_mem";
section8.output_section[0].alignment = 0;

section9.load_memory                 = "LOG_SHM_MEM";
section9.$name                       = "Log Shared Memory";
section9.group                       = false;
section9.type                        = "NOLOAD";
section9.output_section.create(1);
section9.output_section[0].$name     = ".bss.log_shared_mem";
section9.output_section[0].alignment = 0;

section10.load_memory                 = "RTOS_NORTOS_IPC_SHM_MEM";
section10.type                        = "NOLOAD";
section10.$name                       = "IPC Shared Memory";
section10.group                       = false;
section10.output_section.create(1);
section10.output_section[0].$name     = ".bss.ipc_vring_mem";
section10.output_section[0].alignment = 0;

section11.load_memory                 = "MAILBOX_HSM";
section11.type                        = "NOLOAD";
section11.$name                       = "SIPC HSM Queue Memory";
section11.group                       = false;
section11.output_section.create(1);
section11.output_section[0].$name     = ".bss.sipc_hsm_queue_mem";
section11.output_section[0].alignment = 0;

section12.load_memory                 = "MAILBOX_R5F";
section12.$name                       = "SIPC R5F Queue Memory";
section12.group                       = false;
section12.type                        = "NOLOAD";
section12.output_section.create(1);
section12.output_section[0].$name     = ".bss.sipc_secure_host_queue_mem";
section12.output_section[0].alignment = 0;

epwm_xbar1.$name                 = "CONFIG_EPWM_XBAR0";
epwm_xbar1.xbarOutput            = ["GPIO45"];
epwm_xbar1["xbarConfig-0"].$name = "CONFIG_INPUT_XBAR0";

icl_xbar1.$name      = "CONFIG_ICL_XBAR0";
icl_xbar1.xbarOutput = ["MDL0_OUTA"];

icl_xbar2.$name      = "CONFIG_ICL_XBAR1";
icl_xbar2.xbarOutput = ["MDL0_OUTB"];
icl_xbar2.instance   = "ICL_XBAR_1";

icl_xbar3.$name      = "CONFIG_ICL_XBAR2";
icl_xbar3.xbarOutput = ["MDL3_OUTA"];
icl_xbar3.instance   = "ICL_XBAR_2";

icl_xbar4.$name      = "CONFIG_ICL_XBAR3";
icl_xbar4.xbarOutput = ["MDL3_OUTB"];
icl_xbar4.instance   = "ICL_XBAR_3";

icl_xbar5.$name      = "CONFIG_ICL_XBAR4";
icl_xbar5.xbarOutput = ["MDL5_OUTA"];
icl_xbar5.instance   = "ICL_XBAR_4";

icl_xbar6.$name      = "CONFIG_ICL_XBAR5";
icl_xbar6.xbarOutput = ["MDL5_OUTB"];
icl_xbar6.instance   = "ICL_XBAR_5";

/**
 * Pinmux solution for unlocked pins/peripherals. This ensures that minor changes to the automatic solver in a future
 * version of the tool will not impact the pinmux you originally saw.  These lines can be completely deleted in order to
 * re-solve from scratch.
 */
epwm1.EPWM.A.$assign               = "GPIO43";
epwm1.EPWM.B.$assign               = "GPIO44";
epwm2.EPWM.A.$assign               = "GPIO45";
epwm3.EPWM.A.$assign               = "GPIO47";
epwm3.EPWM.B.$assign               = "GPIO48";
epwm4.EPWM.A.$assign               = "GPIO49";
epwm5.EPWM.A.$assign               = "GPIO51";
epwm5.EPWM.B.$assign               = "GPIO52";
epwm6.EPWM.A.$assign               = "GPIO53";
epwm6.EPWM.B.$assign               = "GPIO54";
epwm7.EPWM.A.$assign               = "GPIO55";
mcspi1.SPI.$suggestSolution                 = "SPI1";
debug_log.uartLog.UART.$suggestSolution     = "UART0";
