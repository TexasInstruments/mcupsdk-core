/**
 * @cliArgs --device "AM64x_beta" --package "ALV" --part "Default" --context "r5fss0-0" --product "MCU_PLUS_SDK@07.03.00"
 * @versions {"data":"2021031521","timestamp":"2021031521","tool":"1.8.0+1863","templates":null}
 */

/**
 * Import the modules used in this configuration.
 */
const epwm            = scripting.addModule("/drivers/epwm/epwm", {}, false);
const epwm1           = epwm.addInstance();
const epwm2           = epwm.addInstance();
const epwm3           = epwm.addInstance();
const gpio            = scripting.addModule("/drivers/gpio/gpio", {}, false);
const gpio1           = gpio.addInstance();
const addr_translate  = scripting.addModule("/kernel/dpl/addr_translate", {}, false);
const addr_translate1 = addr_translate.addInstance();
const clock           = scripting.addModule("/kernel/dpl/clock");
const debug_log       = scripting.addModule("/kernel/dpl/debug_log");
const mpu_armv7       = scripting.addModule("/kernel/dpl/mpu_armv7", {}, false);
const mpu_armv71      = mpu_armv7.addInstance();
const mpu_armv72      = mpu_armv7.addInstance();
const mpu_armv73      = mpu_armv7.addInstance();
const mpu_armv74      = mpu_armv7.addInstance();

/**
 * Write custom configuration values to the imported modules.
 */
epwm1.$name            = "CONFIG_EPWM0";
epwm1.EPWM.$assign     = "EHRPWM0";
epwm1.EPWM.A.rx        = false;
epwm1.EPWM.B.rx        = false;
epwm1.EPWM.SYNCO.$used = false;
epwm1.EPWM.SYNCI.$used = false;

epwm2.$name            = "CONFIG_EPWM1";
epwm2.EPWM.$assign     = "EHRPWM1";
epwm2.EPWM.A.rx        = false;
epwm2.EPWM.B.rx        = false;
epwm2.EPWM.SYNCO.$used = false;
epwm2.EPWM.SYNCI.$used = false;

epwm3.$name            = "CONFIG_EPWM2";
epwm3.EPWM.$assign     = "EHRPWM2";
epwm3.EPWM.A.rx        = false;
epwm3.EPWM.B.rx        = false;
epwm3.EPWM.SYNCO.$used = false;
epwm3.EPWM.SYNCI.$used = false;

gpio1.$name                = "CONFIG_GPIO0";
gpio1.pinDir               = "OUTPUT";
gpio1.GPIO.$assign         = "GPIO0";
gpio1.GPIO.gpioPin.rx      = false;
gpio1.GPIO.gpioPin.$assign = "U7";

addr_translate1.$name = "CONFIG_ADDR_TRANSLATE_REGION0";

debug_log.enableUartLog            = true;
debug_log.uartLog.$name            = "CONFIG_UART1";
debug_log.uartLog.UART.$assign     = "USART0";
debug_log.uartLog.UART.RXD.$assign = "D15";
debug_log.uartLog.UART.TXD.$assign = "C16";

mpu_armv71.$name             = "CONFIG_MPU_REGION0";
mpu_armv71.size              = 31;
mpu_armv71.attributes        = "Device";
mpu_armv71.accessPermissions = "Supervisor RD+WR, User RD";
mpu_armv71.allowExecute      = false;

mpu_armv72.$name             = "CONFIG_MPU_REGION1";
mpu_armv72.size              = 15;
mpu_armv72.accessPermissions = "Supervisor RD+WR, User RD";

mpu_armv73.$name             = "CONFIG_MPU_REGION2";
mpu_armv73.baseAddr          = 0x41010000;
mpu_armv73.size              = 15;
mpu_armv73.accessPermissions = "Supervisor RD+WR, User RD";

mpu_armv74.$name             = "CONFIG_MPU_REGION3";
mpu_armv74.baseAddr          = 0x70000000;
mpu_armv74.size              = 21;
mpu_armv74.accessPermissions = "Supervisor RD+WR, User RD";

/**
 * Pinmux solution for unlocked pins/peripherals. This ensures that minor changes to the automatic solver in a future
 * version of the tool will not impact the pinmux you originally saw.  These lines can be completely deleted in order to
 * re-solve from scratch.
 */
epwm1.EPWM.A.$suggestSolution = "U20";
epwm1.EPWM.B.$suggestSolution = "U18";
epwm2.EPWM.A.$suggestSolution = "U19";
epwm2.EPWM.B.$suggestSolution = "V20";
epwm3.EPWM.A.$suggestSolution = "V19";
epwm3.EPWM.B.$suggestSolution = "T17";
