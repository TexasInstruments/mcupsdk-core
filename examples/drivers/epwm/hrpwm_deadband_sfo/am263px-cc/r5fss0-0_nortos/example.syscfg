/**
 * These arguments were used when this file was generated. They will be automatically applied on subsequent loads
 * via the GUI or CLI. Run CLI with '--help' for additional information on how to override these arguments.
 * @cliArgs --device "AM263Px" --package "ZCZ_C" --part "AM263P1" --context "r5fss0-0" --product "MCU_PLUS_SDK@07.03.01"
 * @versions {"tool":"1.12.1+2446"}
 */

/**
 * Import the modules used in this configuration.
 */
const epwm       = scripting.addModule("/drivers/epwm/epwm", {}, false);
const epwm1      = epwm.addInstance();
const epwm2      = epwm.addInstance();
const epwm3      = epwm.addInstance();
const debug_log  = scripting.addModule("/kernel/dpl/debug_log");
const mpu_armv7  = scripting.addModule("/kernel/dpl/mpu_armv7", {}, false);
const mpu_armv71 = mpu_armv7.addInstance();
const mpu_armv72 = mpu_armv7.addInstance();
const mpu_armv73 = mpu_armv7.addInstance();
const mpu_armv74 = mpu_armv7.addInstance();
const int_xbar   = scripting.addModule("/xbar/int_xbar/int_xbar", {}, false);
const int_xbar1  = int_xbar.addInstance();
const int_xbar2  = int_xbar.addInstance();
const int_xbar3  = int_xbar.addInstance();

/**
 * Write custom configuration values to the imported modules.
 */
epwm1.$name                                                    = "CONFIG_EPWM0";
epwm1.epwmTimebase_emulationMode                               = "EPWM_EMULATION_FREE_RUN";
epwm1.epwmTimebase_clockDiv                                    = "EPWM_CLOCK_DIVIDER_4";
epwm1.epwmTimebase_syncOutPulseMode                            = ["EPWM_SYNC_OUT_PULSE_ON_ALL"];
epwm1.epwmCounterCompare_cmpA                                  = 18750;
epwm1.epwmCounterCompare_cmpB                                  = 18750;
epwm1.epwmEventTrigger_enableInterrupt                         = true;
epwm1.epwmEventTrigger_interruptEventCount                     = "1";
epwm1.epwmTimebase_counterMode                                 = "EPWM_COUNTER_MODE_UP";
epwm1.epwmTimebase_period                                      = 50000;
epwm1.epwmActionQualifier_EPWM_AQ_OUTPUT_A_ON_TIMEBASE_ZERO    = "EPWM_AQ_OUTPUT_HIGH";
epwm1.epwmActionQualifier_EPWM_AQ_OUTPUT_A_ON_TIMEBASE_UP_CMPA = "EPWM_AQ_OUTPUT_LOW";
epwm1.epwmActionQualifier_EPWM_AQ_OUTPUT_B_ON_TIMEBASE_ZERO    = "EPWM_AQ_OUTPUT_HIGH";
epwm1.epwmActionQualifier_EPWM_AQ_OUTPUT_B_ON_TIMEBASE_UP_CMPB = "EPWM_AQ_OUTPUT_LOW";
epwm1.EPWM.$assign                                             = "EPWM0";

epwm2.$name                                                  = "CONFIG_EPWM1";
epwm2.epwmTimebase_counterMode                               = "EPWM_COUNTER_MODE_UP";
epwm2.epwmXCMP_enableMode                                    = true;
epwm2.epwmXCMP_SplitCheck                                    = true;
epwm2.epwmXCMP_Split_A                                       = "EPWM_XCMP_4_CMPA";
epwm2.epwmXCMP_Split_B                                       = "EPWM_XCMP_4_CMPB";
epwm2.epwmTimebase_emulationMode                             = "EPWM_EMULATION_FREE_RUN";
epwm2.epwmTimebase_clockDiv                                  = "EPWM_CLOCK_DIVIDER_4";
epwm2.epwmTimebase_syncOutPulseMode                          = ["EPWM_SYNC_OUT_PULSE_ON_ALL"];
epwm2.epwmXAQCTL_EPWM_AQ_OUTPUT_A_ON_TIMEBASE_XCMP1_SHADOW_3 = "EPWM_AQ_OUTPUT_HIGH";
epwm2.epwmXAQCTL_EPWM_AQ_OUTPUT_A_ON_TIMEBASE_XCMP2_SHADOW_3 = "EPWM_AQ_OUTPUT_LOW";
epwm2.epwmXAQCTL_EPWM_AQ_OUTPUT_A_ON_TIMEBASE_XCMP5_SHADOW_3 = "EPWM_AQ_OUTPUT_HIGH";
epwm2.epwmXAQCTL_EPWM_AQ_OUTPUT_A_ON_TIMEBASE_XCMP6_SHADOW_3 = "EPWM_AQ_OUTPUT_LOW";
epwm2.epwmXAQCTL_EPWM_AQ_OUTPUT_A_ON_TIMEBASE_XCMP1_SHADOW_2 = "EPWM_AQ_OUTPUT_LOW";
epwm2.epwmXAQCTL_EPWM_AQ_OUTPUT_A_ON_TIMEBASE_XCMP2_SHADOW_2 = "EPWM_AQ_OUTPUT_LOW";
epwm2.epwmXAQCTL_EPWM_AQ_OUTPUT_A_ON_TIMEBASE_XCMP5_SHADOW_2 = "EPWM_AQ_OUTPUT_LOW";
epwm2.epwmXAQCTL_EPWM_AQ_OUTPUT_A_ON_TIMEBASE_XCMP6_SHADOW_2 = "EPWM_AQ_OUTPUT_LOW";
epwm2.epwmXAQCTL_EPWM_AQ_OUTPUT_A_ON_TIMEBASE_XCMP1_SHADOW_1 = "EPWM_AQ_OUTPUT_HIGH";
epwm2.epwmXAQCTL_EPWM_AQ_OUTPUT_A_ON_TIMEBASE_XCMP2_SHADOW_1 = "EPWM_AQ_OUTPUT_LOW";
epwm2.epwmXAQCTL_EPWM_AQ_OUTPUT_A_ON_TIMEBASE_XCMP5_SHADOW_1 = "EPWM_AQ_OUTPUT_HIGH";
epwm2.epwmXAQCTL_EPWM_AQ_OUTPUT_A_ON_TIMEBASE_XCMP6_SHADOW_1 = "EPWM_AQ_OUTPUT_LOW";
epwm2.epwmTimebase_period                                    = 50000;
epwm2.epwmXAQCTL_EPWM_AQ_OUTPUT_A_ON_TIMEBASE_XCMP1_ACTIVE   = "EPWM_AQ_OUTPUT_HIGH";
epwm2.epwmXAQCTL_EPWM_AQ_OUTPUT_A_ON_TIMEBASE_XCMP2_ACTIVE   = "EPWM_AQ_OUTPUT_LOW";
epwm2.epwmXCMP2_Active                                       = 500;
epwm2.epwmXCMP6_Active                                       = 500;
epwm2.epwmXTBPRD_Active                                      = 50000;
epwm2.epwmXAQCTL_EPWM_AQ_OUTPUT_B_ON_TIMEBASE_XCMP5_ACTIVE   = "EPWM_AQ_OUTPUT_HIGH";
epwm2.epwmXAQCTL_EPWM_AQ_OUTPUT_B_ON_TIMEBASE_XCMP6_ACTIVE   = "EPWM_AQ_OUTPUT_LOW";
epwm2.EPWM.$assign                                           = "EPWM1";

epwm3.$name                                                  = "CONFIG_EPWM2";
epwm3.epwmXCMP_enableMode                                    = true;
epwm3.epwmTimebase_counterMode                               = "EPWM_COUNTER_MODE_UP";
epwm3.epwmXLOADCTL_Loadmode                                  = "EPWM_XCMP_XLOADCTL_LOADMODE_LOADMULTIPLE";
epwm3.epwmXLOADCTL_Shadowlevel                               = "EPWM_XCMP_XLOADCTL_SHDWLEVEL_3";
epwm3.epwmXLOADCTL_RepeatBuf2                                = 7;
epwm3.epwmXLOADCTL_RepeatBuf3                                = 4;
epwm3.epwmTimebase_clockDiv                                  = "EPWM_CLOCK_DIVIDER_4";
epwm3.epwmTimebase_emulationMode                             = "EPWM_EMULATION_FREE_RUN";
epwm3.epwmTimebase_period                                    = 50000;
epwm3.epwmXCMP_SplitCheck                                    = true;
epwm3.epwmXCMP_Split_A                                       = "EPWM_XCMP_4_CMPA";
epwm3.epwmXCMP_Split_B                                       = "EPWM_XCMP_4_CMPB";
epwm3.epwmXCMP2_Shdw1                                        = 100;
epwm3.epwmXCMP6_Shdw1                                        = 200;
epwm3.epwmXTBPRD_Shdw3                                       = 500;
epwm3.epwmXTBPRD_Shdw2                                       = 500;
epwm3.epwmXTBPRD_Shdw1                                       = 500;
epwm3.epwmXCMP2_Shdw3                                        = 250;
epwm3.epwmXCMP5_Shdw3                                        = 250;
epwm3.epwmXCMP6_Shdw3                                        = 500;
epwm3.epwmXAQCTL_EPWM_AQ_OUTPUT_A_ON_TIMEBASE_XCMP1_ACTIVE   = "EPWM_AQ_OUTPUT_HIGH";
epwm3.epwmXAQCTL_EPWM_AQ_OUTPUT_A_ON_TIMEBASE_XCMP2_ACTIVE   = "EPWM_AQ_OUTPUT_LOW";
epwm3.epwmXAQCTL_EPWM_AQ_OUTPUT_A_ON_TIMEBASE_XCMP2_SHADOW_1 = "EPWM_AQ_OUTPUT_LOW";
epwm3.epwmXAQCTL_EPWM_AQ_OUTPUT_A_ON_TIMEBASE_XCMP1_SHADOW_2 = "EPWM_AQ_OUTPUT_LOW";
epwm3.epwmXAQCTL_EPWM_AQ_OUTPUT_A_ON_TIMEBASE_XCMP2_SHADOW_2 = "EPWM_AQ_OUTPUT_LOW";
epwm3.epwmXAQCTL_EPWM_AQ_OUTPUT_A_ON_TIMEBASE_XCMP1_SHADOW_3 = "EPWM_AQ_OUTPUT_HIGH";
epwm3.epwmXAQCTL_EPWM_AQ_OUTPUT_A_ON_TIMEBASE_XCMP2_SHADOW_3 = "EPWM_AQ_OUTPUT_LOW";
epwm3.epwmXCMP2_Active                                       = 500;
epwm3.epwmXCMP6_Active                                       = 500;
epwm3.epwmXAQCTL_EPWM_AQ_OUTPUT_A_ON_TIMEBASE_XCMP1_SHADOW_1 = "EPWM_AQ_OUTPUT_HIGH";
epwm3.epwmXTBPRD_Active                                      = 50000;
epwm3.epwmXAQCTL_EPWM_AQ_OUTPUT_B_ON_TIMEBASE_XCMP5_ACTIVE   = "EPWM_AQ_OUTPUT_HIGH";
epwm3.epwmXAQCTL_EPWM_AQ_OUTPUT_B_ON_TIMEBASE_XCMP6_ACTIVE   = "EPWM_AQ_OUTPUT_LOW";
epwm3.epwmXAQCTL_EPWM_AQ_OUTPUT_B_ON_TIMEBASE_XCMP5_SHADOW_1 = "EPWM_AQ_OUTPUT_HIGH";
epwm3.epwmXAQCTL_EPWM_AQ_OUTPUT_B_ON_TIMEBASE_XCMP6_SHADOW_1 = "EPWM_AQ_OUTPUT_LOW";
epwm3.epwmXAQCTL_EPWM_AQ_OUTPUT_B_ON_TIMEBASE_XCMP5_SHADOW_2 = "EPWM_AQ_OUTPUT_LOW";
epwm3.epwmXAQCTL_EPWM_AQ_OUTPUT_B_ON_TIMEBASE_XCMP6_SHADOW_2 = "EPWM_AQ_OUTPUT_LOW";
epwm3.epwmXAQCTL_EPWM_AQ_OUTPUT_B_ON_TIMEBASE_XCMP5_SHADOW_3 = "EPWM_AQ_OUTPUT_HIGH";
epwm3.epwmXAQCTL_EPWM_AQ_OUTPUT_B_ON_TIMEBASE_XCMP6_SHADOW_3 = "EPWM_AQ_OUTPUT_LOW";
epwm3.EPWM.$assign                                           = "EPWM2";

debug_log.enableUartLog            = true;
debug_log.uartLog.$name            = "CONFIG_UART0";
debug_log.uartLog.UART.RXD.$assign = "ball.A7";
debug_log.uartLog.UART.TXD.$assign = "ball.A6";

mpu_armv71.$name             = "CONFIG_MPU_REGION0";
mpu_armv71.size              = 31;
mpu_armv71.attributes        = "Device";
mpu_armv71.accessPermissions = "Supervisor RD+WR, User RD";
mpu_armv71.allowExecute      = false;

mpu_armv72.$name             = "CONFIG_MPU_REGION1";
mpu_armv72.size              = 15;
mpu_armv72.accessPermissions = "Supervisor RD+WR, User RD";

mpu_armv73.$name             = "CONFIG_MPU_REGION2";
mpu_armv73.baseAddr          = 0x80000;
mpu_armv73.size              = 15;
mpu_armv73.accessPermissions = "Supervisor RD+WR, User RD";

mpu_armv74.$name             = "CONFIG_MPU_REGION3";
mpu_armv74.accessPermissions = "Supervisor RD+WR, User RD";
mpu_armv74.baseAddr          = 0x70000000;
mpu_armv74.size              = 21;

int_xbar1.$name      = "CONFIG_INT_XBAR0";
int_xbar1.xbarOutput = ["EPWM0_INT"];

int_xbar2.$name      = "CONFIG_INT_XBAR1";
int_xbar2.instance   = "INT_XBAR_1";
int_xbar2.xbarOutput = ["EPWM1_INT"];

int_xbar3.$name      = "CONFIG_INT_XBAR2";
int_xbar3.instance   = "INT_XBAR_2";
int_xbar3.xbarOutput = ["EPWM2_INT"];

/**
 * Pinmux solution for unlocked pins/peripherals. This ensures that minor changes to the automatic solver in a future
 * version of the tool will not impact the pinmux you originally saw.  These lines can be completely deleted in order to
 * re-solve from scratch.
 */
epwm1.EPWM.A.$suggestSolution           = "ball.B2";
epwm1.EPWM.B.$suggestSolution           = "ball.B1";
epwm2.EPWM.A.$suggestSolution           = "ball.D3";
epwm2.EPWM.B.$suggestSolution           = "ball.D2";
epwm3.EPWM.A.$suggestSolution           = "ball.C2";
epwm3.EPWM.B.$suggestSolution           = "ball.C1";
debug_log.uartLog.UART.$suggestSolution = "UART0";
