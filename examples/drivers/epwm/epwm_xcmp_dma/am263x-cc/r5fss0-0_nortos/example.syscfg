/**
 * @cliArgs --device "AM263x_beta" --package "ZCZ" --part "AM263x" --context "r5fss0-0" --product "MCU_PLUS_SDK@07.03.01"
 * @versions {"tool":"1.18.0+3266"}
 */

/**
 * Import the modules used in this configuration.
 */
const edma       = scripting.addModule("/drivers/edma/edma", {}, false);
const edma1      = edma.addInstance();
const epwm       = scripting.addModule("/drivers/epwm/epwm", {}, false);
const epwm1      = epwm.addInstance();
const epwm2      = epwm.addInstance();
const epwm3      = epwm.addInstance();
const epwm4      = epwm.addInstance();
const epwm5      = epwm.addInstance();
const epwm6      = epwm.addInstance();
const debug_log  = scripting.addModule("/kernel/dpl/debug_log");
const mpu_armv7  = scripting.addModule("/kernel/dpl/mpu_armv7", {}, false);
const mpu_armv71 = mpu_armv7.addInstance();
const mpu_armv72 = mpu_armv7.addInstance();
const mpu_armv73 = mpu_armv7.addInstance();
const mpu_armv74 = mpu_armv7.addInstance();
const int_xbar   = scripting.addModule("/xbar/int_xbar/int_xbar", {}, false);
const int_xbar1  = int_xbar.addInstance();

/**
 * Write custom configuration values to the imported modules.
 */
edma1.$name                 = "CONFIG_EDMA0";
edma1.edmaRmDmaCh[0].$name  = "CONFIG_EDMA_RM0";
edma1.edmaRmQdmaCh[0].$name = "CONFIG_EDMA_RM1";
edma1.edmaRmTcc[0].$name    = "CONFIG_EDMA_RM2";
edma1.edmaRmParam[0].$name  = "CONFIG_EDMA_RM3";

epwm1.$name                                                  = "CONFIG_EPWM0";
epwm1.epwmTimebase_period                                    = 100;
epwm1.epwmXCMP_enableMode                                    = true;
epwm1.epwmXCMP_SplitCheck                                    = true;
epwm1.epwmXCMP_Split_A                                       = "EPWM_XCMP_4_CMPA";
epwm1.epwmXCMP_Split_B                                       = "EPWM_XCMP_4_CMPB";
epwm1.epwmXCMP1_Active                                       = 10;
epwm1.epwmXCMP2_Active                                       = 20;
epwm1.epwmXCMP3_Active                                       = 30;
epwm1.epwmXCMP4_Active                                       = 40;
epwm1.epwmXCMP5_Active                                       = 50;
epwm1.epwmXCMP6_Active                                       = 60;
epwm1.epwmXCMP7_Active                                       = 70;
epwm1.epwmXCMP8_Active                                       = 80;
epwm1.epwmXAQCTL_EPWM_AQ_OUTPUT_A_ON_TIMEBASE_XCMP1_ACTIVE   = "EPWM_AQ_OUTPUT_HIGH";
epwm1.epwmXAQCTL_EPWM_AQ_OUTPUT_A_ON_TIMEBASE_XCMP2_ACTIVE   = "EPWM_AQ_OUTPUT_LOW";
epwm1.epwmXAQCTL_EPWM_AQ_OUTPUT_B_ON_TIMEBASE_XCMP5_ACTIVE   = "EPWM_AQ_OUTPUT_HIGH";
epwm1.epwmXAQCTL_EPWM_AQ_OUTPUT_B_ON_TIMEBASE_XCMP6_ACTIVE   = "EPWM_AQ_OUTPUT_LOW";
epwm1.epwmXTBPRD_Active                                      = 100;
epwm1.epwmXLOADCTL_Shadowlevel                               = "EPWM_XCMP_XLOADCTL_SHDWLEVEL_3";
epwm1.epwmXTBPRD_Shdw1                                       = 100;
epwm1.epwmXTBPRD_Shdw2                                       = 100;
epwm1.epwmXTBPRD_Shdw3                                       = 100;
epwm1.epwmXCMP1_Shdw1                                        = 10;
epwm1.epwmXCMP2_Shdw1                                        = 20;
epwm1.epwmXCMP3_Shdw1                                        = 30;
epwm1.epwmXCMP4_Shdw1                                        = 40;
epwm1.epwmXCMP5_Shdw1                                        = 50;
epwm1.epwmXCMP6_Shdw1                                        = 60;
epwm1.epwmXCMP7_Shdw1                                        = 70;
epwm1.epwmXCMP8_Shdw1                                        = 80;
epwm1.epwmXCMP1_Shdw2                                        = 10;
epwm1.epwmXCMP2_Shdw2                                        = 20;
epwm1.epwmXCMP3_Shdw2                                        = 30;
epwm1.epwmXCMP4_Shdw2                                        = 40;
epwm1.epwmXCMP5_Shdw2                                        = 50;
epwm1.epwmXCMP6_Shdw2                                        = 60;
epwm1.epwmXCMP7_Shdw2                                        = 70;
epwm1.epwmXCMP8_Shdw2                                        = 80;
epwm1.epwmXCMP1_Shdw3                                        = 10;
epwm1.epwmXCMP2_Shdw3                                        = 20;
epwm1.epwmXCMP3_Shdw3                                        = 30;
epwm1.epwmXCMP4_Shdw3                                        = 40;
epwm1.epwmXCMP5_Shdw3                                        = 50;
epwm1.epwmXCMP6_Shdw3                                        = 60;
epwm1.epwmXCMP7_Shdw3                                        = 70;
epwm1.epwmXCMP8_Shdw3                                        = 80;
epwm1.epwmXAQCTL_EPWM_AQ_OUTPUT_A_ON_TIMEBASE_XCMP1_SHADOW_1 = "EPWM_AQ_OUTPUT_HIGH";
epwm1.epwmXAQCTL_EPWM_AQ_OUTPUT_A_ON_TIMEBASE_XCMP2_SHADOW_1 = "EPWM_AQ_OUTPUT_LOW";
epwm1.epwmXAQCTL_EPWM_AQ_OUTPUT_B_ON_TIMEBASE_XCMP5_SHADOW_1 = "EPWM_AQ_OUTPUT_HIGH";
epwm1.epwmXAQCTL_EPWM_AQ_OUTPUT_B_ON_TIMEBASE_XCMP6_SHADOW_1 = "EPWM_AQ_OUTPUT_LOW";
epwm1.epwmXAQCTL_EPWM_AQ_OUTPUT_A_ON_TIMEBASE_XCMP1_SHADOW_2 = "EPWM_AQ_OUTPUT_HIGH";
epwm1.epwmXAQCTL_EPWM_AQ_OUTPUT_A_ON_TIMEBASE_XCMP2_SHADOW_2 = "EPWM_AQ_OUTPUT_LOW";
epwm1.epwmXAQCTL_EPWM_AQ_OUTPUT_B_ON_TIMEBASE_XCMP5_SHADOW_2 = "EPWM_AQ_OUTPUT_HIGH";
epwm1.epwmXAQCTL_EPWM_AQ_OUTPUT_B_ON_TIMEBASE_XCMP6_SHADOW_2 = "EPWM_AQ_OUTPUT_LOW";
epwm1.epwmXAQCTL_EPWM_AQ_OUTPUT_A_ON_TIMEBASE_XCMP1_SHADOW_3 = "EPWM_AQ_OUTPUT_HIGH";
epwm1.epwmXAQCTL_EPWM_AQ_OUTPUT_A_ON_TIMEBASE_XCMP2_SHADOW_3 = "EPWM_AQ_OUTPUT_LOW";
epwm1.epwmXAQCTL_EPWM_AQ_OUTPUT_B_ON_TIMEBASE_XCMP5_SHADOW_3 = "EPWM_AQ_OUTPUT_HIGH";
epwm1.epwmXAQCTL_EPWM_AQ_OUTPUT_B_ON_TIMEBASE_XCMP6_SHADOW_3 = "EPWM_AQ_OUTPUT_LOW";
epwm1.epwmXLOADCTL_RepeatBuf3                                = 5;
epwm1.epwmXLOADCTL_RepeatBuf2                                = 5;
epwm1.epwmTimebase_emulationMode                             = "EPWM_EMULATION_FREE_RUN";
epwm1.epwmXLOADCTL_Loadmode                                  = "EPWM_XCMP_XLOADCTL_LOADMODE_LOADMULTIPLE";
epwm1.EPWM.$assign                                           = "EPWM0";

epwm2.$name                                                  = "CONFIG_EPWM1";
epwm2.epwmTimebase_period                                    = 100;
epwm2.epwmXCMP_enableMode                                    = true;
epwm2.epwmXCMP_SplitCheck                                    = true;
epwm2.epwmXCMP_Split_A                                       = "EPWM_XCMP_4_CMPA";
epwm2.epwmXCMP_Split_B                                       = "EPWM_XCMP_4_CMPB";
epwm2.epwmXCMP1_Active                                       = 10;
epwm2.epwmXCMP2_Active                                       = 20;
epwm2.epwmXCMP3_Active                                       = 30;
epwm2.epwmXCMP4_Active                                       = 40;
epwm2.epwmXCMP5_Active                                       = 50;
epwm2.epwmXCMP6_Active                                       = 60;
epwm2.epwmXCMP7_Active                                       = 70;
epwm2.epwmXCMP8_Active                                       = 80;
epwm2.epwmXAQCTL_EPWM_AQ_OUTPUT_A_ON_TIMEBASE_XCMP1_ACTIVE   = "EPWM_AQ_OUTPUT_HIGH";
epwm2.epwmXAQCTL_EPWM_AQ_OUTPUT_A_ON_TIMEBASE_XCMP2_ACTIVE   = "EPWM_AQ_OUTPUT_LOW";
epwm2.epwmXAQCTL_EPWM_AQ_OUTPUT_B_ON_TIMEBASE_XCMP5_ACTIVE   = "EPWM_AQ_OUTPUT_HIGH";
epwm2.epwmXAQCTL_EPWM_AQ_OUTPUT_B_ON_TIMEBASE_XCMP6_ACTIVE   = "EPWM_AQ_OUTPUT_LOW";
epwm2.epwmXTBPRD_Active                                      = 100;
epwm2.epwmXLOADCTL_Shadowlevel                               = "EPWM_XCMP_XLOADCTL_SHDWLEVEL_3";
epwm2.epwmXTBPRD_Shdw1                                       = 100;
epwm2.epwmXTBPRD_Shdw2                                       = 100;
epwm2.epwmXTBPRD_Shdw3                                       = 100;
epwm2.epwmXCMP1_Shdw1                                        = 10;
epwm2.epwmXCMP2_Shdw1                                        = 20;
epwm2.epwmXCMP3_Shdw1                                        = 30;
epwm2.epwmXCMP4_Shdw1                                        = 40;
epwm2.epwmXCMP5_Shdw1                                        = 50;
epwm2.epwmXCMP6_Shdw1                                        = 60;
epwm2.epwmXCMP7_Shdw1                                        = 70;
epwm2.epwmXCMP8_Shdw1                                        = 80;
epwm2.epwmXCMP1_Shdw2                                        = 10;
epwm2.epwmXCMP2_Shdw2                                        = 20;
epwm2.epwmXCMP3_Shdw2                                        = 30;
epwm2.epwmXCMP4_Shdw2                                        = 40;
epwm2.epwmXCMP5_Shdw2                                        = 50;
epwm2.epwmXCMP6_Shdw2                                        = 60;
epwm2.epwmXCMP7_Shdw2                                        = 70;
epwm2.epwmXCMP8_Shdw2                                        = 80;
epwm2.epwmXCMP1_Shdw3                                        = 10;
epwm2.epwmXCMP2_Shdw3                                        = 20;
epwm2.epwmXCMP3_Shdw3                                        = 30;
epwm2.epwmXCMP4_Shdw3                                        = 40;
epwm2.epwmXCMP5_Shdw3                                        = 50;
epwm2.epwmXCMP6_Shdw3                                        = 60;
epwm2.epwmXCMP7_Shdw3                                        = 70;
epwm2.epwmXCMP8_Shdw3                                        = 80;
epwm2.epwmXAQCTL_EPWM_AQ_OUTPUT_A_ON_TIMEBASE_XCMP1_SHADOW_1 = "EPWM_AQ_OUTPUT_HIGH";
epwm2.epwmXAQCTL_EPWM_AQ_OUTPUT_A_ON_TIMEBASE_XCMP2_SHADOW_1 = "EPWM_AQ_OUTPUT_LOW";
epwm2.epwmXAQCTL_EPWM_AQ_OUTPUT_B_ON_TIMEBASE_XCMP5_SHADOW_1 = "EPWM_AQ_OUTPUT_HIGH";
epwm2.epwmXAQCTL_EPWM_AQ_OUTPUT_B_ON_TIMEBASE_XCMP6_SHADOW_1 = "EPWM_AQ_OUTPUT_LOW";
epwm2.epwmXAQCTL_EPWM_AQ_OUTPUT_A_ON_TIMEBASE_XCMP1_SHADOW_2 = "EPWM_AQ_OUTPUT_HIGH";
epwm2.epwmXAQCTL_EPWM_AQ_OUTPUT_A_ON_TIMEBASE_XCMP2_SHADOW_2 = "EPWM_AQ_OUTPUT_LOW";
epwm2.epwmXAQCTL_EPWM_AQ_OUTPUT_B_ON_TIMEBASE_XCMP5_SHADOW_2 = "EPWM_AQ_OUTPUT_HIGH";
epwm2.epwmXAQCTL_EPWM_AQ_OUTPUT_B_ON_TIMEBASE_XCMP6_SHADOW_2 = "EPWM_AQ_OUTPUT_LOW";
epwm2.epwmXAQCTL_EPWM_AQ_OUTPUT_A_ON_TIMEBASE_XCMP1_SHADOW_3 = "EPWM_AQ_OUTPUT_HIGH";
epwm2.epwmXAQCTL_EPWM_AQ_OUTPUT_A_ON_TIMEBASE_XCMP2_SHADOW_3 = "EPWM_AQ_OUTPUT_LOW";
epwm2.epwmXAQCTL_EPWM_AQ_OUTPUT_B_ON_TIMEBASE_XCMP5_SHADOW_3 = "EPWM_AQ_OUTPUT_HIGH";
epwm2.epwmXAQCTL_EPWM_AQ_OUTPUT_B_ON_TIMEBASE_XCMP6_SHADOW_3 = "EPWM_AQ_OUTPUT_LOW";
epwm2.epwmXLOADCTL_RepeatBuf2                                = 5;
epwm2.epwmXLOADCTL_RepeatBuf3                                = 5;
epwm2.epwmTimebase_emulationMode                             = "EPWM_EMULATION_FREE_RUN";
epwm2.epwmXLOADCTL_Loadmode                                  = "EPWM_XCMP_XLOADCTL_LOADMODE_LOADMULTIPLE";
epwm2.EPWM.$assign                                           = "EPWM1";

epwm3.$name                                                  = "CONFIG_EPWM2";
epwm3.epwmTimebase_period                                    = 100;
epwm3.epwmXCMP_enableMode                                    = true;
epwm3.epwmXCMP_SplitCheck                                    = true;
epwm3.epwmXCMP_Split_A                                       = "EPWM_XCMP_4_CMPA";
epwm3.epwmXCMP_Split_B                                       = "EPWM_XCMP_4_CMPB";
epwm3.epwmXCMP1_Active                                       = 10;
epwm3.epwmXCMP2_Active                                       = 20;
epwm3.epwmXCMP3_Active                                       = 30;
epwm3.epwmXCMP4_Active                                       = 40;
epwm3.epwmXCMP5_Active                                       = 50;
epwm3.epwmXCMP6_Active                                       = 60;
epwm3.epwmXCMP7_Active                                       = 70;
epwm3.epwmXCMP8_Active                                       = 80;
epwm3.epwmXAQCTL_EPWM_AQ_OUTPUT_A_ON_TIMEBASE_XCMP1_ACTIVE   = "EPWM_AQ_OUTPUT_HIGH";
epwm3.epwmXAQCTL_EPWM_AQ_OUTPUT_A_ON_TIMEBASE_XCMP2_ACTIVE   = "EPWM_AQ_OUTPUT_LOW";
epwm3.epwmXAQCTL_EPWM_AQ_OUTPUT_B_ON_TIMEBASE_XCMP5_ACTIVE   = "EPWM_AQ_OUTPUT_HIGH";
epwm3.epwmXAQCTL_EPWM_AQ_OUTPUT_B_ON_TIMEBASE_XCMP6_ACTIVE   = "EPWM_AQ_OUTPUT_LOW";
epwm3.epwmXTBPRD_Active                                      = 100;
epwm3.epwmXLOADCTL_Shadowlevel                               = "EPWM_XCMP_XLOADCTL_SHDWLEVEL_3";
epwm3.epwmXTBPRD_Shdw1                                       = 100;
epwm3.epwmXTBPRD_Shdw2                                       = 100;
epwm3.epwmXTBPRD_Shdw3                                       = 100;
epwm3.epwmXCMP1_Shdw1                                        = 10;
epwm3.epwmXCMP2_Shdw1                                        = 20;
epwm3.epwmXCMP3_Shdw1                                        = 30;
epwm3.epwmXCMP4_Shdw1                                        = 40;
epwm3.epwmXCMP5_Shdw1                                        = 50;
epwm3.epwmXCMP6_Shdw1                                        = 60;
epwm3.epwmXCMP7_Shdw1                                        = 70;
epwm3.epwmXCMP8_Shdw1                                        = 80;
epwm3.epwmXCMP1_Shdw2                                        = 10;
epwm3.epwmXCMP2_Shdw2                                        = 20;
epwm3.epwmXCMP3_Shdw2                                        = 30;
epwm3.epwmXCMP4_Shdw2                                        = 40;
epwm3.epwmXCMP5_Shdw2                                        = 50;
epwm3.epwmXCMP6_Shdw2                                        = 60;
epwm3.epwmXCMP7_Shdw2                                        = 70;
epwm3.epwmXCMP8_Shdw2                                        = 80;
epwm3.epwmXCMP1_Shdw3                                        = 10;
epwm3.epwmXCMP2_Shdw3                                        = 20;
epwm3.epwmXCMP3_Shdw3                                        = 30;
epwm3.epwmXCMP4_Shdw3                                        = 40;
epwm3.epwmXCMP5_Shdw3                                        = 50;
epwm3.epwmXCMP6_Shdw3                                        = 60;
epwm3.epwmXCMP7_Shdw3                                        = 70;
epwm3.epwmXCMP8_Shdw3                                        = 80;
epwm3.epwmXAQCTL_EPWM_AQ_OUTPUT_A_ON_TIMEBASE_XCMP1_SHADOW_1 = "EPWM_AQ_OUTPUT_HIGH";
epwm3.epwmXAQCTL_EPWM_AQ_OUTPUT_A_ON_TIMEBASE_XCMP2_SHADOW_1 = "EPWM_AQ_OUTPUT_LOW";
epwm3.epwmXAQCTL_EPWM_AQ_OUTPUT_B_ON_TIMEBASE_XCMP5_SHADOW_1 = "EPWM_AQ_OUTPUT_HIGH";
epwm3.epwmXAQCTL_EPWM_AQ_OUTPUT_B_ON_TIMEBASE_XCMP6_SHADOW_1 = "EPWM_AQ_OUTPUT_LOW";
epwm3.epwmXAQCTL_EPWM_AQ_OUTPUT_A_ON_TIMEBASE_XCMP1_SHADOW_2 = "EPWM_AQ_OUTPUT_HIGH";
epwm3.epwmXAQCTL_EPWM_AQ_OUTPUT_A_ON_TIMEBASE_XCMP2_SHADOW_2 = "EPWM_AQ_OUTPUT_LOW";
epwm3.epwmXAQCTL_EPWM_AQ_OUTPUT_B_ON_TIMEBASE_XCMP5_SHADOW_2 = "EPWM_AQ_OUTPUT_HIGH";
epwm3.epwmXAQCTL_EPWM_AQ_OUTPUT_B_ON_TIMEBASE_XCMP6_SHADOW_2 = "EPWM_AQ_OUTPUT_LOW";
epwm3.epwmXAQCTL_EPWM_AQ_OUTPUT_A_ON_TIMEBASE_XCMP1_SHADOW_3 = "EPWM_AQ_OUTPUT_HIGH";
epwm3.epwmXAQCTL_EPWM_AQ_OUTPUT_A_ON_TIMEBASE_XCMP2_SHADOW_3 = "EPWM_AQ_OUTPUT_LOW";
epwm3.epwmXAQCTL_EPWM_AQ_OUTPUT_B_ON_TIMEBASE_XCMP5_SHADOW_3 = "EPWM_AQ_OUTPUT_HIGH";
epwm3.epwmXAQCTL_EPWM_AQ_OUTPUT_B_ON_TIMEBASE_XCMP6_SHADOW_3 = "EPWM_AQ_OUTPUT_LOW";
epwm3.epwmXLOADCTL_RepeatBuf3                                = 5;
epwm3.epwmXLOADCTL_RepeatBuf2                                = 5;
epwm3.epwmTimebase_emulationMode                             = "EPWM_EMULATION_FREE_RUN";
epwm3.epwmXLOADCTL_Loadmode                                  = "EPWM_XCMP_XLOADCTL_LOADMODE_LOADMULTIPLE";
epwm3.EPWM.$assign                                           = "EPWM2";

epwm4.$name                                                  = "CONFIG_EPWM3";
epwm4.epwmTimebase_period                                    = 100;
epwm4.epwmXCMP_enableMode                                    = true;
epwm4.epwmXCMP_SplitCheck                                    = true;
epwm4.epwmXCMP_Split_A                                       = "EPWM_XCMP_4_CMPA";
epwm4.epwmXCMP_Split_B                                       = "EPWM_XCMP_4_CMPB";
epwm4.epwmXCMP1_Active                                       = 10;
epwm4.epwmXCMP2_Active                                       = 20;
epwm4.epwmXCMP3_Active                                       = 30;
epwm4.epwmXCMP4_Active                                       = 40;
epwm4.epwmXCMP5_Active                                       = 50;
epwm4.epwmXCMP6_Active                                       = 60;
epwm4.epwmXCMP7_Active                                       = 70;
epwm4.epwmXCMP8_Active                                       = 80;
epwm4.epwmXAQCTL_EPWM_AQ_OUTPUT_A_ON_TIMEBASE_XCMP1_ACTIVE   = "EPWM_AQ_OUTPUT_HIGH";
epwm4.epwmXAQCTL_EPWM_AQ_OUTPUT_A_ON_TIMEBASE_XCMP2_ACTIVE   = "EPWM_AQ_OUTPUT_LOW";
epwm4.epwmXAQCTL_EPWM_AQ_OUTPUT_B_ON_TIMEBASE_XCMP5_ACTIVE   = "EPWM_AQ_OUTPUT_HIGH";
epwm4.epwmXAQCTL_EPWM_AQ_OUTPUT_B_ON_TIMEBASE_XCMP6_ACTIVE   = "EPWM_AQ_OUTPUT_LOW";
epwm4.epwmXTBPRD_Active                                      = 100;
epwm4.epwmXLOADCTL_Shadowlevel                               = "EPWM_XCMP_XLOADCTL_SHDWLEVEL_3";
epwm4.epwmXTBPRD_Shdw1                                       = 100;
epwm4.epwmXTBPRD_Shdw2                                       = 100;
epwm4.epwmXTBPRD_Shdw3                                       = 100;
epwm4.epwmXCMP1_Shdw1                                        = 10;
epwm4.epwmXCMP2_Shdw1                                        = 20;
epwm4.epwmXCMP3_Shdw1                                        = 30;
epwm4.epwmXCMP4_Shdw1                                        = 40;
epwm4.epwmXCMP5_Shdw1                                        = 50;
epwm4.epwmXCMP6_Shdw1                                        = 60;
epwm4.epwmXCMP7_Shdw1                                        = 70;
epwm4.epwmXCMP8_Shdw1                                        = 80;
epwm4.epwmXCMP1_Shdw2                                        = 10;
epwm4.epwmXCMP2_Shdw2                                        = 20;
epwm4.epwmXCMP3_Shdw2                                        = 30;
epwm4.epwmXCMP4_Shdw2                                        = 40;
epwm4.epwmXCMP5_Shdw2                                        = 50;
epwm4.epwmXCMP6_Shdw2                                        = 60;
epwm4.epwmXCMP7_Shdw2                                        = 70;
epwm4.epwmXCMP8_Shdw2                                        = 80;
epwm4.epwmXCMP1_Shdw3                                        = 10;
epwm4.epwmXCMP2_Shdw3                                        = 20;
epwm4.epwmXCMP3_Shdw3                                        = 30;
epwm4.epwmXCMP4_Shdw3                                        = 40;
epwm4.epwmXCMP5_Shdw3                                        = 50;
epwm4.epwmXCMP6_Shdw3                                        = 60;
epwm4.epwmXCMP7_Shdw3                                        = 70;
epwm4.epwmXCMP8_Shdw3                                        = 80;
epwm4.epwmXAQCTL_EPWM_AQ_OUTPUT_A_ON_TIMEBASE_XCMP1_SHADOW_1 = "EPWM_AQ_OUTPUT_HIGH";
epwm4.epwmXAQCTL_EPWM_AQ_OUTPUT_A_ON_TIMEBASE_XCMP2_SHADOW_1 = "EPWM_AQ_OUTPUT_LOW";
epwm4.epwmXAQCTL_EPWM_AQ_OUTPUT_B_ON_TIMEBASE_XCMP5_SHADOW_1 = "EPWM_AQ_OUTPUT_HIGH";
epwm4.epwmXAQCTL_EPWM_AQ_OUTPUT_B_ON_TIMEBASE_XCMP6_SHADOW_1 = "EPWM_AQ_OUTPUT_LOW";
epwm4.epwmXAQCTL_EPWM_AQ_OUTPUT_A_ON_TIMEBASE_XCMP1_SHADOW_2 = "EPWM_AQ_OUTPUT_HIGH";
epwm4.epwmXAQCTL_EPWM_AQ_OUTPUT_A_ON_TIMEBASE_XCMP2_SHADOW_2 = "EPWM_AQ_OUTPUT_LOW";
epwm4.epwmXAQCTL_EPWM_AQ_OUTPUT_B_ON_TIMEBASE_XCMP5_SHADOW_2 = "EPWM_AQ_OUTPUT_HIGH";
epwm4.epwmXAQCTL_EPWM_AQ_OUTPUT_B_ON_TIMEBASE_XCMP6_SHADOW_2 = "EPWM_AQ_OUTPUT_LOW";
epwm4.epwmXAQCTL_EPWM_AQ_OUTPUT_A_ON_TIMEBASE_XCMP1_SHADOW_3 = "EPWM_AQ_OUTPUT_HIGH";
epwm4.epwmXAQCTL_EPWM_AQ_OUTPUT_A_ON_TIMEBASE_XCMP2_SHADOW_3 = "EPWM_AQ_OUTPUT_LOW";
epwm4.epwmXAQCTL_EPWM_AQ_OUTPUT_B_ON_TIMEBASE_XCMP5_SHADOW_3 = "EPWM_AQ_OUTPUT_HIGH";
epwm4.epwmXAQCTL_EPWM_AQ_OUTPUT_B_ON_TIMEBASE_XCMP6_SHADOW_3 = "EPWM_AQ_OUTPUT_LOW";
epwm4.epwmXLOADCTL_RepeatBuf3                                = 5;
epwm4.epwmXLOADCTL_RepeatBuf2                                = 5;
epwm4.epwmTimebase_emulationMode                             = "EPWM_EMULATION_FREE_RUN";
epwm4.epwmXLOADCTL_Loadmode                                  = "EPWM_XCMP_XLOADCTL_LOADMODE_LOADMULTIPLE";
epwm4.EPWM.$assign                                           = "EPWM3";

epwm5.$name                                                  = "CONFIG_EPWM4";
epwm5.epwmTimebase_period                                    = 100;
epwm5.epwmXCMP_enableMode                                    = true;
epwm5.epwmXCMP_SplitCheck                                    = true;
epwm5.epwmXCMP_Split_A                                       = "EPWM_XCMP_4_CMPA";
epwm5.epwmXCMP_Split_B                                       = "EPWM_XCMP_4_CMPB";
epwm5.epwmXCMP1_Active                                       = 10;
epwm5.epwmXCMP2_Active                                       = 20;
epwm5.epwmXCMP3_Active                                       = 30;
epwm5.epwmXCMP4_Active                                       = 40;
epwm5.epwmXCMP5_Active                                       = 50;
epwm5.epwmXCMP6_Active                                       = 60;
epwm5.epwmXCMP7_Active                                       = 70;
epwm5.epwmXCMP8_Active                                       = 80;
epwm5.epwmXAQCTL_EPWM_AQ_OUTPUT_A_ON_TIMEBASE_XCMP1_ACTIVE   = "EPWM_AQ_OUTPUT_HIGH";
epwm5.epwmXAQCTL_EPWM_AQ_OUTPUT_A_ON_TIMEBASE_XCMP2_ACTIVE   = "EPWM_AQ_OUTPUT_LOW";
epwm5.epwmXAQCTL_EPWM_AQ_OUTPUT_B_ON_TIMEBASE_XCMP5_ACTIVE   = "EPWM_AQ_OUTPUT_HIGH";
epwm5.epwmXAQCTL_EPWM_AQ_OUTPUT_B_ON_TIMEBASE_XCMP6_ACTIVE   = "EPWM_AQ_OUTPUT_LOW";
epwm5.epwmXTBPRD_Active                                      = 100;
epwm5.epwmXLOADCTL_Shadowlevel                               = "EPWM_XCMP_XLOADCTL_SHDWLEVEL_3";
epwm5.epwmXTBPRD_Shdw1                                       = 100;
epwm5.epwmXTBPRD_Shdw2                                       = 100;
epwm5.epwmXTBPRD_Shdw3                                       = 100;
epwm5.epwmXCMP1_Shdw1                                        = 10;
epwm5.epwmXCMP2_Shdw1                                        = 20;
epwm5.epwmXCMP3_Shdw1                                        = 30;
epwm5.epwmXCMP4_Shdw1                                        = 40;
epwm5.epwmXCMP5_Shdw1                                        = 50;
epwm5.epwmXCMP6_Shdw1                                        = 60;
epwm5.epwmXCMP7_Shdw1                                        = 70;
epwm5.epwmXCMP8_Shdw1                                        = 80;
epwm5.epwmXCMP1_Shdw2                                        = 10;
epwm5.epwmXCMP2_Shdw2                                        = 20;
epwm5.epwmXCMP3_Shdw2                                        = 30;
epwm5.epwmXCMP4_Shdw2                                        = 40;
epwm5.epwmXCMP5_Shdw2                                        = 50;
epwm5.epwmXCMP6_Shdw2                                        = 60;
epwm5.epwmXCMP7_Shdw2                                        = 70;
epwm5.epwmXCMP8_Shdw2                                        = 80;
epwm5.epwmXCMP1_Shdw3                                        = 10;
epwm5.epwmXCMP2_Shdw3                                        = 20;
epwm5.epwmXCMP3_Shdw3                                        = 30;
epwm5.epwmXCMP4_Shdw3                                        = 40;
epwm5.epwmXCMP5_Shdw3                                        = 50;
epwm5.epwmXCMP6_Shdw3                                        = 60;
epwm5.epwmXCMP7_Shdw3                                        = 70;
epwm5.epwmXCMP8_Shdw3                                        = 80;
epwm5.epwmXAQCTL_EPWM_AQ_OUTPUT_A_ON_TIMEBASE_XCMP1_SHADOW_1 = "EPWM_AQ_OUTPUT_HIGH";
epwm5.epwmXAQCTL_EPWM_AQ_OUTPUT_A_ON_TIMEBASE_XCMP2_SHADOW_1 = "EPWM_AQ_OUTPUT_LOW";
epwm5.epwmXAQCTL_EPWM_AQ_OUTPUT_B_ON_TIMEBASE_XCMP5_SHADOW_1 = "EPWM_AQ_OUTPUT_HIGH";
epwm5.epwmXAQCTL_EPWM_AQ_OUTPUT_B_ON_TIMEBASE_XCMP6_SHADOW_1 = "EPWM_AQ_OUTPUT_LOW";
epwm5.epwmXAQCTL_EPWM_AQ_OUTPUT_A_ON_TIMEBASE_XCMP1_SHADOW_2 = "EPWM_AQ_OUTPUT_HIGH";
epwm5.epwmXAQCTL_EPWM_AQ_OUTPUT_A_ON_TIMEBASE_XCMP2_SHADOW_2 = "EPWM_AQ_OUTPUT_LOW";
epwm5.epwmXAQCTL_EPWM_AQ_OUTPUT_B_ON_TIMEBASE_XCMP5_SHADOW_2 = "EPWM_AQ_OUTPUT_HIGH";
epwm5.epwmXAQCTL_EPWM_AQ_OUTPUT_B_ON_TIMEBASE_XCMP6_SHADOW_2 = "EPWM_AQ_OUTPUT_LOW";
epwm5.epwmXAQCTL_EPWM_AQ_OUTPUT_A_ON_TIMEBASE_XCMP1_SHADOW_3 = "EPWM_AQ_OUTPUT_HIGH";
epwm5.epwmXAQCTL_EPWM_AQ_OUTPUT_A_ON_TIMEBASE_XCMP2_SHADOW_3 = "EPWM_AQ_OUTPUT_LOW";
epwm5.epwmXAQCTL_EPWM_AQ_OUTPUT_B_ON_TIMEBASE_XCMP5_SHADOW_3 = "EPWM_AQ_OUTPUT_HIGH";
epwm5.epwmXAQCTL_EPWM_AQ_OUTPUT_B_ON_TIMEBASE_XCMP6_SHADOW_3 = "EPWM_AQ_OUTPUT_LOW";
epwm5.epwmXLOADCTL_RepeatBuf3                                = 5;
epwm5.epwmXLOADCTL_RepeatBuf2                                = 5;
epwm5.epwmTimebase_emulationMode                             = "EPWM_EMULATION_FREE_RUN";
epwm5.epwmXLOADCTL_Loadmode                                  = "EPWM_XCMP_XLOADCTL_LOADMODE_LOADMULTIPLE";
epwm5.EPWM.$assign                                           = "EPWM4";

epwm6.$name                                          = "ISR_SOURCE_EPWM";
epwm6.epwmTimebase_period                            = 100;
epwm6.epwmEventTrigger_enableInterrupt               = true;
epwm6.epwmEventTrigger_interruptSource               = "EPWM_INT_TBCTR_PERIOD";
epwm6.epwmEventTrigger_interruptEventCount           = "1";
epwm6.epwmEventTrigger_interruptEventCountInitEnable = true;
epwm6.EPWM.$assign                                   = "EPWM31";

debug_log.enableUartLog            = true;
debug_log.uartLog.$name            = "CONFIG_UART0";
debug_log.uartLog.UART.RXD.$assign = "UART0_RXD";
debug_log.uartLog.UART.TXD.$assign = "UART0_TXD";

mpu_armv71.$name             = "CONFIG_MPU_REGION0";
mpu_armv71.size              = 31;
mpu_armv71.attributes        = "Device";
mpu_armv71.accessPermissions = "Supervisor RD+WR, User RD";
mpu_armv71.allowExecute      = false;

mpu_armv72.$name             = "CONFIG_MPU_REGION1";
mpu_armv72.size              = 15;
mpu_armv72.accessPermissions = "Supervisor RD+WR, User RD";

mpu_armv73.$name             = "CONFIG_MPU_REGION2";
mpu_armv73.baseAddr          = 0x80000;
mpu_armv73.size              = 15;
mpu_armv73.accessPermissions = "Supervisor RD+WR, User RD";

mpu_armv74.$name             = "CONFIG_MPU_REGION3";
mpu_armv74.accessPermissions = "Supervisor RD+WR, User RD";
mpu_armv74.baseAddr          = 0x70000000;
mpu_armv74.size              = 21;

int_xbar1.$name      = "CONFIG_INT_XBAR0";
int_xbar1.xbarOutput = ["EPWM31_INT"];

/**
 * Pinmux solution for unlocked pins/peripherals. This ensures that minor changes to the automatic solver in a future
 * version of the tool will not impact the pinmux you originally saw.  These lines can be completely deleted in order to
 * re-solve from scratch.
 */
epwm1.EPWM.A.$suggestSolution           = "EPWM0_A";
epwm1.EPWM.B.$suggestSolution           = "EPWM0_B";
epwm2.EPWM.A.$suggestSolution           = "EPWM1_A";
epwm2.EPWM.B.$suggestSolution           = "EPWM1_B";
epwm3.EPWM.A.$suggestSolution           = "EPWM2_A";
epwm3.EPWM.B.$suggestSolution           = "EPWM2_B";
epwm4.EPWM.A.$suggestSolution           = "EPWM3_A";
epwm4.EPWM.B.$suggestSolution           = "EPWM3_B";
epwm5.EPWM.A.$suggestSolution           = "EPWM4_A";
epwm5.EPWM.B.$suggestSolution           = "EPWM4_B";
epwm6.EPWM.A.$suggestSolution           = "PR0_PRU1_GPIO10";
epwm6.EPWM.B.$suggestSolution           = "PR0_PRU1_GPIO8";
debug_log.uartLog.UART.$suggestSolution = "UART0";
