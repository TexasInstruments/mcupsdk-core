/**
 * @cliArgs --device "AM261x_ZCZ" --package "ZCZ" --part "AM2611" --context "r5fss0-0" --product "MCU_PLUS_SDK@07.03.01"
 * @versions {"tool":"1.20.0+3587"}
 */

/**
 * Import the modules used in this configuration.
 */
const edma            = scripting.addModule("/drivers/edma/edma", {}, false);
const edma1           = edma.addInstance();
const epwm            = scripting.addModule("/drivers/epwm/epwm", {}, false);
const epwm1           = epwm.addInstance();
const epwm2           = epwm.addInstance();
const epwm3           = epwm.addInstance();
const epwm4           = epwm.addInstance();
const epwm5           = epwm.addInstance();
const epwm6           = epwm.addInstance();
const debug_log       = scripting.addModule("/kernel/dpl/debug_log");
const dpl_cfg = scripting.addModule("/kernel/dpl/dpl_cfg");
const mpu_armv7       = scripting.addModule("/kernel/dpl/mpu_armv7", {}, false);
const mpu_armv71      = mpu_armv7.addInstance();
const mpu_armv72      = mpu_armv7.addInstance();
const mpu_armv73      = mpu_armv7.addInstance();
const mpu_armv74      = mpu_armv7.addInstance();
const default_linker  = scripting.addModule("/memory_configurator/default_linker", {}, false);
const default_linker1 = default_linker.addInstance();
const general         = scripting.addModule("/memory_configurator/general", {}, false);
const general1        = general.addInstance();
const region          = scripting.addModule("/memory_configurator/region", {}, false);
const region1         = region.addInstance();
const section         = scripting.addModule("/memory_configurator/section", {}, false);
const section1        = section.addInstance();
const section2        = section.addInstance();
const section3        = section.addInstance();
const section4        = section.addInstance();
const section5        = section.addInstance();
const section6        = section.addInstance();
const section7        = section.addInstance();
const section8        = section.addInstance();
const section9        = section.addInstance();
const section10       = section.addInstance();
const section11       = section.addInstance();
const section12       = section.addInstance();
const section13       = section.addInstance();
const int_xbar        = scripting.addModule("/xbar/int_xbar/int_xbar", {}, false);
const int_xbar1       = int_xbar.addInstance();

/**
 * Write custom configuration values to the imported modules.
 */
edma1.$name                 = "CONFIG_EDMA0";
edma1.edmaRmDmaCh[0].$name  = "CONFIG_EDMA_RM0";
edma1.edmaRmQdmaCh[0].$name = "CONFIG_EDMA_RM1";
edma1.edmaRmTcc[0].$name    = "CONFIG_EDMA_RM2";
edma1.edmaRmParam[0].$name  = "CONFIG_EDMA_RM3";

epwm1.$name                                                  = "CONFIG_EPWM0";
epwm1.epwmTimebase_period                                    = 100;
epwm1.epwmXCMP_enableMode                                    = true;
epwm1.epwmXCMP_SplitCheck                                    = true;
epwm1.epwmXCMP_Split_A                                       = "EPWM_XCMP_4_CMPA";
epwm1.epwmXCMP_Split_B                                       = "EPWM_XCMP_4_CMPB";
epwm1.epwmXCMP1_Active                                       = 10;
epwm1.epwmXCMP2_Active                                       = 20;
epwm1.epwmXCMP3_Active                                       = 30;
epwm1.epwmXCMP4_Active                                       = 40;
epwm1.epwmXCMP5_Active                                       = 50;
epwm1.epwmXCMP6_Active                                       = 60;
epwm1.epwmXCMP7_Active                                       = 70;
epwm1.epwmXCMP8_Active                                       = 80;
epwm1.epwmXAQCTL_EPWM_AQ_OUTPUT_A_ON_TIMEBASE_XCMP1_ACTIVE   = "EPWM_AQ_OUTPUT_HIGH";
epwm1.epwmXAQCTL_EPWM_AQ_OUTPUT_A_ON_TIMEBASE_XCMP2_ACTIVE   = "EPWM_AQ_OUTPUT_LOW";
epwm1.epwmXAQCTL_EPWM_AQ_OUTPUT_B_ON_TIMEBASE_XCMP5_ACTIVE   = "EPWM_AQ_OUTPUT_HIGH";
epwm1.epwmXAQCTL_EPWM_AQ_OUTPUT_B_ON_TIMEBASE_XCMP6_ACTIVE   = "EPWM_AQ_OUTPUT_LOW";
epwm1.epwmXTBPRD_Active                                      = 100;
epwm1.epwmXLOADCTL_Shadowlevel                               = "EPWM_XCMP_XLOADCTL_SHDWLEVEL_3";
epwm1.epwmXTBPRD_Shdw1                                       = 100;
epwm1.epwmXTBPRD_Shdw2                                       = 100;
epwm1.epwmXTBPRD_Shdw3                                       = 100;
epwm1.epwmXCMP1_Shdw1                                        = 10;
epwm1.epwmXCMP2_Shdw1                                        = 20;
epwm1.epwmXCMP3_Shdw1                                        = 30;
epwm1.epwmXCMP4_Shdw1                                        = 40;
epwm1.epwmXCMP5_Shdw1                                        = 50;
epwm1.epwmXCMP6_Shdw1                                        = 60;
epwm1.epwmXCMP7_Shdw1                                        = 70;
epwm1.epwmXCMP8_Shdw1                                        = 80;
epwm1.epwmXCMP1_Shdw2                                        = 10;
epwm1.epwmXCMP2_Shdw2                                        = 20;
epwm1.epwmXCMP3_Shdw2                                        = 30;
epwm1.epwmXCMP4_Shdw2                                        = 40;
epwm1.epwmXCMP5_Shdw2                                        = 50;
epwm1.epwmXCMP6_Shdw2                                        = 60;
epwm1.epwmXCMP7_Shdw2                                        = 70;
epwm1.epwmXCMP8_Shdw2                                        = 80;
epwm1.epwmXCMP1_Shdw3                                        = 10;
epwm1.epwmXCMP2_Shdw3                                        = 20;
epwm1.epwmXCMP3_Shdw3                                        = 30;
epwm1.epwmXCMP4_Shdw3                                        = 40;
epwm1.epwmXCMP5_Shdw3                                        = 50;
epwm1.epwmXCMP6_Shdw3                                        = 60;
epwm1.epwmXCMP7_Shdw3                                        = 70;
epwm1.epwmXCMP8_Shdw3                                        = 80;
epwm1.epwmXAQCTL_EPWM_AQ_OUTPUT_A_ON_TIMEBASE_XCMP1_SHADOW_1 = "EPWM_AQ_OUTPUT_HIGH";
epwm1.epwmXAQCTL_EPWM_AQ_OUTPUT_A_ON_TIMEBASE_XCMP2_SHADOW_1 = "EPWM_AQ_OUTPUT_LOW";
epwm1.epwmXAQCTL_EPWM_AQ_OUTPUT_B_ON_TIMEBASE_XCMP5_SHADOW_1 = "EPWM_AQ_OUTPUT_HIGH";
epwm1.epwmXAQCTL_EPWM_AQ_OUTPUT_B_ON_TIMEBASE_XCMP6_SHADOW_1 = "EPWM_AQ_OUTPUT_LOW";
epwm1.epwmXAQCTL_EPWM_AQ_OUTPUT_A_ON_TIMEBASE_XCMP1_SHADOW_2 = "EPWM_AQ_OUTPUT_HIGH";
epwm1.epwmXAQCTL_EPWM_AQ_OUTPUT_A_ON_TIMEBASE_XCMP2_SHADOW_2 = "EPWM_AQ_OUTPUT_LOW";
epwm1.epwmXAQCTL_EPWM_AQ_OUTPUT_B_ON_TIMEBASE_XCMP5_SHADOW_2 = "EPWM_AQ_OUTPUT_HIGH";
epwm1.epwmXAQCTL_EPWM_AQ_OUTPUT_B_ON_TIMEBASE_XCMP6_SHADOW_2 = "EPWM_AQ_OUTPUT_LOW";
epwm1.epwmXAQCTL_EPWM_AQ_OUTPUT_A_ON_TIMEBASE_XCMP1_SHADOW_3 = "EPWM_AQ_OUTPUT_HIGH";
epwm1.epwmXAQCTL_EPWM_AQ_OUTPUT_A_ON_TIMEBASE_XCMP2_SHADOW_3 = "EPWM_AQ_OUTPUT_LOW";
epwm1.epwmXAQCTL_EPWM_AQ_OUTPUT_B_ON_TIMEBASE_XCMP5_SHADOW_3 = "EPWM_AQ_OUTPUT_HIGH";
epwm1.epwmXAQCTL_EPWM_AQ_OUTPUT_B_ON_TIMEBASE_XCMP6_SHADOW_3 = "EPWM_AQ_OUTPUT_LOW";
epwm1.epwmXLOADCTL_RepeatBuf3                                = 5;
epwm1.epwmXLOADCTL_RepeatBuf2                                = 5;
epwm1.epwmTimebase_emulationMode                             = "EPWM_EMULATION_FREE_RUN";
epwm1.epwmXLOADCTL_Loadmode                                  = "EPWM_XCMP_XLOADCTL_LOADMODE_LOADMULTIPLE";
epwm1.EPWM.$assign                                           = "EPWM0";

epwm2.$name                                                  = "CONFIG_EPWM1";
epwm2.epwmTimebase_period                                    = 100;
epwm2.epwmXCMP_enableMode                                    = true;
epwm2.epwmXCMP_SplitCheck                                    = true;
epwm2.epwmXCMP_Split_A                                       = "EPWM_XCMP_4_CMPA";
epwm2.epwmXCMP_Split_B                                       = "EPWM_XCMP_4_CMPB";
epwm2.epwmXCMP1_Active                                       = 10;
epwm2.epwmXCMP2_Active                                       = 20;
epwm2.epwmXCMP3_Active                                       = 30;
epwm2.epwmXCMP4_Active                                       = 40;
epwm2.epwmXCMP5_Active                                       = 50;
epwm2.epwmXCMP6_Active                                       = 60;
epwm2.epwmXCMP7_Active                                       = 70;
epwm2.epwmXCMP8_Active                                       = 80;
epwm2.epwmXAQCTL_EPWM_AQ_OUTPUT_A_ON_TIMEBASE_XCMP1_ACTIVE   = "EPWM_AQ_OUTPUT_HIGH";
epwm2.epwmXAQCTL_EPWM_AQ_OUTPUT_A_ON_TIMEBASE_XCMP2_ACTIVE   = "EPWM_AQ_OUTPUT_LOW";
epwm2.epwmXAQCTL_EPWM_AQ_OUTPUT_B_ON_TIMEBASE_XCMP5_ACTIVE   = "EPWM_AQ_OUTPUT_HIGH";
epwm2.epwmXAQCTL_EPWM_AQ_OUTPUT_B_ON_TIMEBASE_XCMP6_ACTIVE   = "EPWM_AQ_OUTPUT_LOW";
epwm2.epwmXTBPRD_Active                                      = 100;
epwm2.epwmXLOADCTL_Shadowlevel                               = "EPWM_XCMP_XLOADCTL_SHDWLEVEL_3";
epwm2.epwmXTBPRD_Shdw1                                       = 100;
epwm2.epwmXTBPRD_Shdw2                                       = 100;
epwm2.epwmXTBPRD_Shdw3                                       = 100;
epwm2.epwmXCMP1_Shdw1                                        = 10;
epwm2.epwmXCMP2_Shdw1                                        = 20;
epwm2.epwmXCMP3_Shdw1                                        = 30;
epwm2.epwmXCMP4_Shdw1                                        = 40;
epwm2.epwmXCMP5_Shdw1                                        = 50;
epwm2.epwmXCMP6_Shdw1                                        = 60;
epwm2.epwmXCMP7_Shdw1                                        = 70;
epwm2.epwmXCMP8_Shdw1                                        = 80;
epwm2.epwmXCMP1_Shdw2                                        = 10;
epwm2.epwmXCMP2_Shdw2                                        = 20;
epwm2.epwmXCMP3_Shdw2                                        = 30;
epwm2.epwmXCMP4_Shdw2                                        = 40;
epwm2.epwmXCMP5_Shdw2                                        = 50;
epwm2.epwmXCMP6_Shdw2                                        = 60;
epwm2.epwmXCMP7_Shdw2                                        = 70;
epwm2.epwmXCMP8_Shdw2                                        = 80;
epwm2.epwmXCMP1_Shdw3                                        = 10;
epwm2.epwmXCMP2_Shdw3                                        = 20;
epwm2.epwmXCMP3_Shdw3                                        = 30;
epwm2.epwmXCMP4_Shdw3                                        = 40;
epwm2.epwmXCMP5_Shdw3                                        = 50;
epwm2.epwmXCMP6_Shdw3                                        = 60;
epwm2.epwmXCMP7_Shdw3                                        = 70;
epwm2.epwmXCMP8_Shdw3                                        = 80;
epwm2.epwmXAQCTL_EPWM_AQ_OUTPUT_A_ON_TIMEBASE_XCMP1_SHADOW_1 = "EPWM_AQ_OUTPUT_HIGH";
epwm2.epwmXAQCTL_EPWM_AQ_OUTPUT_A_ON_TIMEBASE_XCMP2_SHADOW_1 = "EPWM_AQ_OUTPUT_LOW";
epwm2.epwmXAQCTL_EPWM_AQ_OUTPUT_B_ON_TIMEBASE_XCMP5_SHADOW_1 = "EPWM_AQ_OUTPUT_HIGH";
epwm2.epwmXAQCTL_EPWM_AQ_OUTPUT_B_ON_TIMEBASE_XCMP6_SHADOW_1 = "EPWM_AQ_OUTPUT_LOW";
epwm2.epwmXAQCTL_EPWM_AQ_OUTPUT_A_ON_TIMEBASE_XCMP1_SHADOW_2 = "EPWM_AQ_OUTPUT_HIGH";
epwm2.epwmXAQCTL_EPWM_AQ_OUTPUT_A_ON_TIMEBASE_XCMP2_SHADOW_2 = "EPWM_AQ_OUTPUT_LOW";
epwm2.epwmXAQCTL_EPWM_AQ_OUTPUT_B_ON_TIMEBASE_XCMP5_SHADOW_2 = "EPWM_AQ_OUTPUT_HIGH";
epwm2.epwmXAQCTL_EPWM_AQ_OUTPUT_B_ON_TIMEBASE_XCMP6_SHADOW_2 = "EPWM_AQ_OUTPUT_LOW";
epwm2.epwmXAQCTL_EPWM_AQ_OUTPUT_A_ON_TIMEBASE_XCMP1_SHADOW_3 = "EPWM_AQ_OUTPUT_HIGH";
epwm2.epwmXAQCTL_EPWM_AQ_OUTPUT_A_ON_TIMEBASE_XCMP2_SHADOW_3 = "EPWM_AQ_OUTPUT_LOW";
epwm2.epwmXAQCTL_EPWM_AQ_OUTPUT_B_ON_TIMEBASE_XCMP5_SHADOW_3 = "EPWM_AQ_OUTPUT_HIGH";
epwm2.epwmXAQCTL_EPWM_AQ_OUTPUT_B_ON_TIMEBASE_XCMP6_SHADOW_3 = "EPWM_AQ_OUTPUT_LOW";
epwm2.epwmXLOADCTL_RepeatBuf2                                = 5;
epwm2.epwmXLOADCTL_RepeatBuf3                                = 5;
epwm2.epwmTimebase_emulationMode                             = "EPWM_EMULATION_FREE_RUN";
epwm2.epwmXLOADCTL_Loadmode                                  = "EPWM_XCMP_XLOADCTL_LOADMODE_LOADMULTIPLE";
epwm2.EPWM.$assign                                           = "EPWM1";

epwm3.$name                                                  = "CONFIG_EPWM2";
epwm3.epwmTimebase_period                                    = 100;
epwm3.epwmXCMP_enableMode                                    = true;
epwm3.epwmXCMP_SplitCheck                                    = true;
epwm3.epwmXCMP_Split_A                                       = "EPWM_XCMP_4_CMPA";
epwm3.epwmXCMP_Split_B                                       = "EPWM_XCMP_4_CMPB";
epwm3.epwmXCMP1_Active                                       = 10;
epwm3.epwmXCMP2_Active                                       = 20;
epwm3.epwmXCMP3_Active                                       = 30;
epwm3.epwmXCMP4_Active                                       = 40;
epwm3.epwmXCMP5_Active                                       = 50;
epwm3.epwmXCMP6_Active                                       = 60;
epwm3.epwmXCMP7_Active                                       = 70;
epwm3.epwmXCMP8_Active                                       = 80;
epwm3.epwmXAQCTL_EPWM_AQ_OUTPUT_A_ON_TIMEBASE_XCMP1_ACTIVE   = "EPWM_AQ_OUTPUT_HIGH";
epwm3.epwmXAQCTL_EPWM_AQ_OUTPUT_A_ON_TIMEBASE_XCMP2_ACTIVE   = "EPWM_AQ_OUTPUT_LOW";
epwm3.epwmXAQCTL_EPWM_AQ_OUTPUT_B_ON_TIMEBASE_XCMP5_ACTIVE   = "EPWM_AQ_OUTPUT_HIGH";
epwm3.epwmXAQCTL_EPWM_AQ_OUTPUT_B_ON_TIMEBASE_XCMP6_ACTIVE   = "EPWM_AQ_OUTPUT_LOW";
epwm3.epwmXTBPRD_Active                                      = 100;
epwm3.epwmXLOADCTL_Shadowlevel                               = "EPWM_XCMP_XLOADCTL_SHDWLEVEL_3";
epwm3.epwmXTBPRD_Shdw1                                       = 100;
epwm3.epwmXTBPRD_Shdw2                                       = 100;
epwm3.epwmXTBPRD_Shdw3                                       = 100;
epwm3.epwmXCMP1_Shdw1                                        = 10;
epwm3.epwmXCMP2_Shdw1                                        = 20;
epwm3.epwmXCMP3_Shdw1                                        = 30;
epwm3.epwmXCMP4_Shdw1                                        = 40;
epwm3.epwmXCMP5_Shdw1                                        = 50;
epwm3.epwmXCMP6_Shdw1                                        = 60;
epwm3.epwmXCMP7_Shdw1                                        = 70;
epwm3.epwmXCMP8_Shdw1                                        = 80;
epwm3.epwmXCMP1_Shdw2                                        = 10;
epwm3.epwmXCMP2_Shdw2                                        = 20;
epwm3.epwmXCMP3_Shdw2                                        = 30;
epwm3.epwmXCMP4_Shdw2                                        = 40;
epwm3.epwmXCMP5_Shdw2                                        = 50;
epwm3.epwmXCMP6_Shdw2                                        = 60;
epwm3.epwmXCMP7_Shdw2                                        = 70;
epwm3.epwmXCMP8_Shdw2                                        = 80;
epwm3.epwmXCMP1_Shdw3                                        = 10;
epwm3.epwmXCMP2_Shdw3                                        = 20;
epwm3.epwmXCMP3_Shdw3                                        = 30;
epwm3.epwmXCMP4_Shdw3                                        = 40;
epwm3.epwmXCMP5_Shdw3                                        = 50;
epwm3.epwmXCMP6_Shdw3                                        = 60;
epwm3.epwmXCMP7_Shdw3                                        = 70;
epwm3.epwmXCMP8_Shdw3                                        = 80;
epwm3.epwmXAQCTL_EPWM_AQ_OUTPUT_A_ON_TIMEBASE_XCMP1_SHADOW_1 = "EPWM_AQ_OUTPUT_HIGH";
epwm3.epwmXAQCTL_EPWM_AQ_OUTPUT_A_ON_TIMEBASE_XCMP2_SHADOW_1 = "EPWM_AQ_OUTPUT_LOW";
epwm3.epwmXAQCTL_EPWM_AQ_OUTPUT_B_ON_TIMEBASE_XCMP5_SHADOW_1 = "EPWM_AQ_OUTPUT_HIGH";
epwm3.epwmXAQCTL_EPWM_AQ_OUTPUT_B_ON_TIMEBASE_XCMP6_SHADOW_1 = "EPWM_AQ_OUTPUT_LOW";
epwm3.epwmXAQCTL_EPWM_AQ_OUTPUT_A_ON_TIMEBASE_XCMP1_SHADOW_2 = "EPWM_AQ_OUTPUT_HIGH";
epwm3.epwmXAQCTL_EPWM_AQ_OUTPUT_A_ON_TIMEBASE_XCMP2_SHADOW_2 = "EPWM_AQ_OUTPUT_LOW";
epwm3.epwmXAQCTL_EPWM_AQ_OUTPUT_B_ON_TIMEBASE_XCMP5_SHADOW_2 = "EPWM_AQ_OUTPUT_HIGH";
epwm3.epwmXAQCTL_EPWM_AQ_OUTPUT_B_ON_TIMEBASE_XCMP6_SHADOW_2 = "EPWM_AQ_OUTPUT_LOW";
epwm3.epwmXAQCTL_EPWM_AQ_OUTPUT_A_ON_TIMEBASE_XCMP1_SHADOW_3 = "EPWM_AQ_OUTPUT_HIGH";
epwm3.epwmXAQCTL_EPWM_AQ_OUTPUT_A_ON_TIMEBASE_XCMP2_SHADOW_3 = "EPWM_AQ_OUTPUT_LOW";
epwm3.epwmXAQCTL_EPWM_AQ_OUTPUT_B_ON_TIMEBASE_XCMP5_SHADOW_3 = "EPWM_AQ_OUTPUT_HIGH";
epwm3.epwmXAQCTL_EPWM_AQ_OUTPUT_B_ON_TIMEBASE_XCMP6_SHADOW_3 = "EPWM_AQ_OUTPUT_LOW";
epwm3.epwmXLOADCTL_RepeatBuf3                                = 5;
epwm3.epwmXLOADCTL_RepeatBuf2                                = 5;
epwm3.epwmTimebase_emulationMode                             = "EPWM_EMULATION_FREE_RUN";
epwm3.epwmXLOADCTL_Loadmode                                  = "EPWM_XCMP_XLOADCTL_LOADMODE_LOADMULTIPLE";
epwm3.EPWM.$assign                                           = "EPWM2";

epwm4.$name                                                  = "CONFIG_EPWM3";
epwm4.epwmTimebase_period                                    = 100;
epwm4.epwmXCMP_enableMode                                    = true;
epwm4.epwmXCMP_SplitCheck                                    = true;
epwm4.epwmXCMP_Split_A                                       = "EPWM_XCMP_4_CMPA";
epwm4.epwmXCMP_Split_B                                       = "EPWM_XCMP_4_CMPB";
epwm4.epwmXCMP1_Active                                       = 10;
epwm4.epwmXCMP2_Active                                       = 20;
epwm4.epwmXCMP3_Active                                       = 30;
epwm4.epwmXCMP4_Active                                       = 40;
epwm4.epwmXCMP5_Active                                       = 50;
epwm4.epwmXCMP6_Active                                       = 60;
epwm4.epwmXCMP7_Active                                       = 70;
epwm4.epwmXCMP8_Active                                       = 80;
epwm4.epwmXAQCTL_EPWM_AQ_OUTPUT_A_ON_TIMEBASE_XCMP1_ACTIVE   = "EPWM_AQ_OUTPUT_HIGH";
epwm4.epwmXAQCTL_EPWM_AQ_OUTPUT_A_ON_TIMEBASE_XCMP2_ACTIVE   = "EPWM_AQ_OUTPUT_LOW";
epwm4.epwmXAQCTL_EPWM_AQ_OUTPUT_B_ON_TIMEBASE_XCMP5_ACTIVE   = "EPWM_AQ_OUTPUT_HIGH";
epwm4.epwmXAQCTL_EPWM_AQ_OUTPUT_B_ON_TIMEBASE_XCMP6_ACTIVE   = "EPWM_AQ_OUTPUT_LOW";
epwm4.epwmXTBPRD_Active                                      = 100;
epwm4.epwmXLOADCTL_Shadowlevel                               = "EPWM_XCMP_XLOADCTL_SHDWLEVEL_3";
epwm4.epwmXTBPRD_Shdw1                                       = 100;
epwm4.epwmXTBPRD_Shdw2                                       = 100;
epwm4.epwmXTBPRD_Shdw3                                       = 100;
epwm4.epwmXCMP1_Shdw1                                        = 10;
epwm4.epwmXCMP2_Shdw1                                        = 20;
epwm4.epwmXCMP3_Shdw1                                        = 30;
epwm4.epwmXCMP4_Shdw1                                        = 40;
epwm4.epwmXCMP5_Shdw1                                        = 50;
epwm4.epwmXCMP6_Shdw1                                        = 60;
epwm4.epwmXCMP7_Shdw1                                        = 70;
epwm4.epwmXCMP8_Shdw1                                        = 80;
epwm4.epwmXCMP1_Shdw2                                        = 10;
epwm4.epwmXCMP2_Shdw2                                        = 20;
epwm4.epwmXCMP3_Shdw2                                        = 30;
epwm4.epwmXCMP4_Shdw2                                        = 40;
epwm4.epwmXCMP5_Shdw2                                        = 50;
epwm4.epwmXCMP6_Shdw2                                        = 60;
epwm4.epwmXCMP7_Shdw2                                        = 70;
epwm4.epwmXCMP8_Shdw2                                        = 80;
epwm4.epwmXCMP1_Shdw3                                        = 10;
epwm4.epwmXCMP2_Shdw3                                        = 20;
epwm4.epwmXCMP3_Shdw3                                        = 30;
epwm4.epwmXCMP4_Shdw3                                        = 40;
epwm4.epwmXCMP5_Shdw3                                        = 50;
epwm4.epwmXCMP6_Shdw3                                        = 60;
epwm4.epwmXCMP7_Shdw3                                        = 70;
epwm4.epwmXCMP8_Shdw3                                        = 80;
epwm4.epwmXAQCTL_EPWM_AQ_OUTPUT_A_ON_TIMEBASE_XCMP1_SHADOW_1 = "EPWM_AQ_OUTPUT_HIGH";
epwm4.epwmXAQCTL_EPWM_AQ_OUTPUT_A_ON_TIMEBASE_XCMP2_SHADOW_1 = "EPWM_AQ_OUTPUT_LOW";
epwm4.epwmXAQCTL_EPWM_AQ_OUTPUT_B_ON_TIMEBASE_XCMP5_SHADOW_1 = "EPWM_AQ_OUTPUT_HIGH";
epwm4.epwmXAQCTL_EPWM_AQ_OUTPUT_B_ON_TIMEBASE_XCMP6_SHADOW_1 = "EPWM_AQ_OUTPUT_LOW";
epwm4.epwmXAQCTL_EPWM_AQ_OUTPUT_A_ON_TIMEBASE_XCMP1_SHADOW_2 = "EPWM_AQ_OUTPUT_HIGH";
epwm4.epwmXAQCTL_EPWM_AQ_OUTPUT_A_ON_TIMEBASE_XCMP2_SHADOW_2 = "EPWM_AQ_OUTPUT_LOW";
epwm4.epwmXAQCTL_EPWM_AQ_OUTPUT_B_ON_TIMEBASE_XCMP5_SHADOW_2 = "EPWM_AQ_OUTPUT_HIGH";
epwm4.epwmXAQCTL_EPWM_AQ_OUTPUT_B_ON_TIMEBASE_XCMP6_SHADOW_2 = "EPWM_AQ_OUTPUT_LOW";
epwm4.epwmXAQCTL_EPWM_AQ_OUTPUT_A_ON_TIMEBASE_XCMP1_SHADOW_3 = "EPWM_AQ_OUTPUT_HIGH";
epwm4.epwmXAQCTL_EPWM_AQ_OUTPUT_A_ON_TIMEBASE_XCMP2_SHADOW_3 = "EPWM_AQ_OUTPUT_LOW";
epwm4.epwmXAQCTL_EPWM_AQ_OUTPUT_B_ON_TIMEBASE_XCMP5_SHADOW_3 = "EPWM_AQ_OUTPUT_HIGH";
epwm4.epwmXAQCTL_EPWM_AQ_OUTPUT_B_ON_TIMEBASE_XCMP6_SHADOW_3 = "EPWM_AQ_OUTPUT_LOW";
epwm4.epwmXLOADCTL_RepeatBuf3                                = 5;
epwm4.epwmXLOADCTL_RepeatBuf2                                = 5;
epwm4.epwmTimebase_emulationMode                             = "EPWM_EMULATION_FREE_RUN";
epwm4.epwmXLOADCTL_Loadmode                                  = "EPWM_XCMP_XLOADCTL_LOADMODE_LOADMULTIPLE";
epwm4.EPWM.$assign                                           = "EPWM3";

epwm5.$name                                                  = "CONFIG_EPWM4";
epwm5.epwmTimebase_period                                    = 100;
epwm5.epwmXCMP_enableMode                                    = true;
epwm5.epwmXCMP_SplitCheck                                    = true;
epwm5.epwmXCMP_Split_A                                       = "EPWM_XCMP_4_CMPA";
epwm5.epwmXCMP_Split_B                                       = "EPWM_XCMP_4_CMPB";
epwm5.epwmXCMP1_Active                                       = 10;
epwm5.epwmXCMP2_Active                                       = 20;
epwm5.epwmXCMP3_Active                                       = 30;
epwm5.epwmXCMP4_Active                                       = 40;
epwm5.epwmXCMP5_Active                                       = 50;
epwm5.epwmXCMP6_Active                                       = 60;
epwm5.epwmXCMP7_Active                                       = 70;
epwm5.epwmXCMP8_Active                                       = 80;
epwm5.epwmXAQCTL_EPWM_AQ_OUTPUT_A_ON_TIMEBASE_XCMP1_ACTIVE   = "EPWM_AQ_OUTPUT_HIGH";
epwm5.epwmXAQCTL_EPWM_AQ_OUTPUT_A_ON_TIMEBASE_XCMP2_ACTIVE   = "EPWM_AQ_OUTPUT_LOW";
epwm5.epwmXAQCTL_EPWM_AQ_OUTPUT_B_ON_TIMEBASE_XCMP5_ACTIVE   = "EPWM_AQ_OUTPUT_HIGH";
epwm5.epwmXAQCTL_EPWM_AQ_OUTPUT_B_ON_TIMEBASE_XCMP6_ACTIVE   = "EPWM_AQ_OUTPUT_LOW";
epwm5.epwmXTBPRD_Active                                      = 100;
epwm5.epwmXLOADCTL_Shadowlevel                               = "EPWM_XCMP_XLOADCTL_SHDWLEVEL_3";
epwm5.epwmXTBPRD_Shdw1                                       = 100;
epwm5.epwmXTBPRD_Shdw2                                       = 100;
epwm5.epwmXTBPRD_Shdw3                                       = 100;
epwm5.epwmXCMP1_Shdw1                                        = 10;
epwm5.epwmXCMP2_Shdw1                                        = 20;
epwm5.epwmXCMP3_Shdw1                                        = 30;
epwm5.epwmXCMP4_Shdw1                                        = 40;
epwm5.epwmXCMP5_Shdw1                                        = 50;
epwm5.epwmXCMP6_Shdw1                                        = 60;
epwm5.epwmXCMP7_Shdw1                                        = 70;
epwm5.epwmXCMP8_Shdw1                                        = 80;
epwm5.epwmXCMP1_Shdw2                                        = 10;
epwm5.epwmXCMP2_Shdw2                                        = 20;
epwm5.epwmXCMP3_Shdw2                                        = 30;
epwm5.epwmXCMP4_Shdw2                                        = 40;
epwm5.epwmXCMP5_Shdw2                                        = 50;
epwm5.epwmXCMP6_Shdw2                                        = 60;
epwm5.epwmXCMP7_Shdw2                                        = 70;
epwm5.epwmXCMP8_Shdw2                                        = 80;
epwm5.epwmXCMP1_Shdw3                                        = 10;
epwm5.epwmXCMP2_Shdw3                                        = 20;
epwm5.epwmXCMP3_Shdw3                                        = 30;
epwm5.epwmXCMP4_Shdw3                                        = 40;
epwm5.epwmXCMP5_Shdw3                                        = 50;
epwm5.epwmXCMP6_Shdw3                                        = 60;
epwm5.epwmXCMP7_Shdw3                                        = 70;
epwm5.epwmXCMP8_Shdw3                                        = 80;
epwm5.epwmXAQCTL_EPWM_AQ_OUTPUT_A_ON_TIMEBASE_XCMP1_SHADOW_1 = "EPWM_AQ_OUTPUT_HIGH";
epwm5.epwmXAQCTL_EPWM_AQ_OUTPUT_A_ON_TIMEBASE_XCMP2_SHADOW_1 = "EPWM_AQ_OUTPUT_LOW";
epwm5.epwmXAQCTL_EPWM_AQ_OUTPUT_B_ON_TIMEBASE_XCMP5_SHADOW_1 = "EPWM_AQ_OUTPUT_HIGH";
epwm5.epwmXAQCTL_EPWM_AQ_OUTPUT_B_ON_TIMEBASE_XCMP6_SHADOW_1 = "EPWM_AQ_OUTPUT_LOW";
epwm5.epwmXAQCTL_EPWM_AQ_OUTPUT_A_ON_TIMEBASE_XCMP1_SHADOW_2 = "EPWM_AQ_OUTPUT_HIGH";
epwm5.epwmXAQCTL_EPWM_AQ_OUTPUT_A_ON_TIMEBASE_XCMP2_SHADOW_2 = "EPWM_AQ_OUTPUT_LOW";
epwm5.epwmXAQCTL_EPWM_AQ_OUTPUT_B_ON_TIMEBASE_XCMP5_SHADOW_2 = "EPWM_AQ_OUTPUT_HIGH";
epwm5.epwmXAQCTL_EPWM_AQ_OUTPUT_B_ON_TIMEBASE_XCMP6_SHADOW_2 = "EPWM_AQ_OUTPUT_LOW";
epwm5.epwmXAQCTL_EPWM_AQ_OUTPUT_A_ON_TIMEBASE_XCMP1_SHADOW_3 = "EPWM_AQ_OUTPUT_HIGH";
epwm5.epwmXAQCTL_EPWM_AQ_OUTPUT_A_ON_TIMEBASE_XCMP2_SHADOW_3 = "EPWM_AQ_OUTPUT_LOW";
epwm5.epwmXAQCTL_EPWM_AQ_OUTPUT_B_ON_TIMEBASE_XCMP5_SHADOW_3 = "EPWM_AQ_OUTPUT_HIGH";
epwm5.epwmXAQCTL_EPWM_AQ_OUTPUT_B_ON_TIMEBASE_XCMP6_SHADOW_3 = "EPWM_AQ_OUTPUT_LOW";
epwm5.epwmXLOADCTL_RepeatBuf3                                = 5;
epwm5.epwmXLOADCTL_RepeatBuf2                                = 5;
epwm5.epwmTimebase_emulationMode                             = "EPWM_EMULATION_FREE_RUN";
epwm5.epwmXLOADCTL_Loadmode                                  = "EPWM_XCMP_XLOADCTL_LOADMODE_LOADMULTIPLE";
epwm5.EPWM.$assign                                           = "EPWM4";

epwm6.$name                                          = "ISR_SOURCE_EPWM";
epwm6.epwmTimebase_period                            = 100;
epwm6.epwmEventTrigger_enableInterrupt               = true;
epwm6.epwmEventTrigger_interruptSource               = "EPWM_INT_TBCTR_PERIOD";
epwm6.epwmEventTrigger_interruptEventCount           = "1";
epwm6.epwmEventTrigger_interruptEventCountInitEnable = true;
epwm6.EPWM.$assign                                   = "EPWM31";

debug_log.enableUartLog            = true;
debug_log.uartLog.$name            = "CONFIG_UART0";
debug_log.uartLog.UART.RXD.$assign = "GPIO27";
debug_log.uartLog.UART.TXD.$assign = "GPIO28";
debug_log.uartLog.child.$name      = "drivers_uart_v2_uart_v2_template0";

mpu_armv71.$name             = "CONFIG_MPU_REGION0";
mpu_armv71.size              = 31;
mpu_armv71.attributes        = "Device";
mpu_armv71.accessPermissions = "Supervisor RD+WR, User RD";
mpu_armv71.allowExecute      = false;

mpu_armv72.$name             = "CONFIG_MPU_REGION1";
mpu_armv72.size              = 15;
mpu_armv72.accessPermissions = "Supervisor RD+WR, User RD";

mpu_armv73.$name             = "CONFIG_MPU_REGION2";
mpu_armv73.baseAddr          = 0x80000;
mpu_armv73.size              = 15;
mpu_armv73.accessPermissions = "Supervisor RD+WR, User RD";

mpu_armv74.$name             = "CONFIG_MPU_REGION3";
mpu_armv74.accessPermissions = "Supervisor RD+WR, User RD";
mpu_armv74.baseAddr          = 0x70000000;
mpu_armv74.size              = 21;

default_linker1.$name = "memory_configurator_default_linker0";

general1.$name        = "CONFIG_GENERAL0";
general1.linker.$name = "TIARMCLANG0";

region1.$name                                = "MEMORY_REGION_CONFIGURATION0";
region1.memory_region.create(11);
region1.memory_region[0].type                = "TCMA";
region1.memory_region[0].$name               = "R5F_VECS";
region1.memory_region[0].size                = 0x40;
region1.memory_region[0].auto                = false;
region1.memory_region[1].type                = "TCMA";
region1.memory_region[1].$name               = "R5F_TCMA";
region1.memory_region[1].size                = 0x7FC0;
region1.memory_region[2].type                = "TCMB";
region1.memory_region[2].size                = 0x8000;
region1.memory_region[2].$name               = "R5F_TCMB";
region1.memory_region[3].$name               = "SBL";
region1.memory_region[3].auto                = false;
region1.memory_region[3].size                = 0x40000;
region1.memory_region[4].$name               = "OCRAM";
region1.memory_region[4].auto                = false;
region1.memory_region[4].manualStartAddress  = 0x70040000;
region1.memory_region[4].size                = 0x40000;
region1.memory_region[5].type                = "FLASH";
region1.memory_region[5].auto                = false;
region1.memory_region[5].manualStartAddress  = 0x60100000;
region1.memory_region[5].size                = 0x80000;
region1.memory_region[5].$name               = "FLASH";
region1.memory_region[6].$name               = "USER_SHM_MEM";
region1.memory_region[6].auto                = false;
region1.memory_region[6].manualStartAddress  = 0x70150000; 
region1.memory_region[6].size                = 0x4000;
region1.memory_region[6].isShared            = true;
region1.memory_region[6].shared_cores        = ["r5fss0-1"];
region1.memory_region[7].$name               = "LOG_SHM_MEM";
region1.memory_region[7].auto                = false;
region1.memory_region[7].manualStartAddress  = 0x70154000; 
region1.memory_region[7].size                = 0x4000;
region1.memory_region[7].isShared            = true;
region1.memory_region[7].shared_cores        = ["r5fss0-1"];
region1.memory_region[8].type                = "CUSTOM";
region1.memory_region[8].$name               = "RTOS_NORTOS_IPC_SHM_MEM";
region1.memory_region[8].auto                = false;
region1.memory_region[8].manualStartAddress  = 0x72000000;
region1.memory_region[8].size                = 0x3E80;
region1.memory_region[8].isShared            = true;
region1.memory_region[8].shared_cores        = ["r5fss0-1"];
region1.memory_region[9].type                = "CUSTOM";
region1.memory_region[9].$name               = "MAILBOX_HSM";
region1.memory_region[9].auto                = false;
region1.memory_region[9].manualStartAddress  = 0x44000000;
region1.memory_region[9].size                = 0x3CE;
region1.memory_region[9].isShared            = true;
region1.memory_region[9].shared_cores        = ["r5fss0-1"];
region1.memory_region[10].type               = "CUSTOM";
region1.memory_region[10].$name              = "MAILBOX_R5F";
region1.memory_region[10].auto               = false;
region1.memory_region[10].manualStartAddress = 0x44000400;
region1.memory_region[10].size               = 0x3CE;
region1.memory_region[10].isShared           = true;
region1.memory_region[10].shared_cores       = ["r5fss0-1"];

section1.load_memory                  = "R5F_VECS";
section1.group                        = false;
section1.$name                        = "Vector Table";
section1.output_section.create(1);
section1.output_section[0].$name      = ".vectors";
section1.output_section[0].palignment = true;

section2.load_memory                  = "OCRAM";
section2.$name                        = "Text Segments";
section2.output_section.create(5);
section2.output_section[0].$name      = ".text.hwi";
section2.output_section[0].palignment = true;
section2.output_section[1].$name      = ".text.cache";
section2.output_section[1].palignment = true;
section2.output_section[2].$name      = ".text.mpu";
section2.output_section[2].palignment = true;
section2.output_section[3].$name      = ".text.boot";
section2.output_section[3].palignment = true;
section2.output_section[4].$name      = ".text:abort";
section2.output_section[4].palignment = true;

section3.load_memory                  = "OCRAM";
section3.$name                        = "Code and Read-Only Data";
section3.output_section.create(2);
section3.output_section[0].$name      = ".text";
section3.output_section[0].palignment = true;
section3.output_section[1].$name      = ".rodata";
section3.output_section[1].palignment = true;

section4.load_memory                  = "OCRAM";
section4.$name                        = "Data Segment";
section4.output_section.create(1);
section4.output_section[0].$name      = ".data";
section4.output_section[0].palignment = true;

section5.load_memory                             = "OCRAM";
section5.$name                                   = "Memory Segments";
section5.output_section.create(3);
section5.output_section[0].$name                 = ".bss";
section5.output_section[0].output_sections_start = "__BSS_START";
section5.output_section[0].output_sections_end   = "__BSS_END";
section5.output_section[0].palignment            = true;
section5.output_section[1].$name                 = ".sysmem";
section5.output_section[1].palignment            = true;
section5.output_section[2].$name                 = ".stack";
section5.output_section[2].palignment            = true;

section6.load_memory                              = "OCRAM";
section6.$name                                    = "Stack Segments";
section6.output_section.create(5);
section6.output_section[0].$name                  = ".irqstack";
section6.output_section[0].output_sections_start  = "__IRQ_STACK_START";
section6.output_section[0].output_sections_end    = "__IRQ_STACK_END";
section6.output_section[0].input_section.create(1);
section6.output_section[0].input_section[0].$name = ". = . + __IRQ_STACK_SIZE;";
section6.output_section[1].$name                  = ".fiqstack";
section6.output_section[1].output_sections_start  = "__FIQ_STACK_START";
section6.output_section[1].output_sections_end    = "__FIQ_STACK_END";
section6.output_section[1].input_section.create(1);
section6.output_section[1].input_section[0].$name = ". = . + __FIQ_STACK_SIZE;";
section6.output_section[2].$name                  = ".svcstack";
section6.output_section[2].output_sections_start  = "__SVC_STACK_START";
section6.output_section[2].output_sections_end    = "__SVC_STACK_END";
section6.output_section[2].input_section.create(1);
section6.output_section[2].input_section[0].$name = ". = . + __SVC_STACK_SIZE;";
section6.output_section[3].$name                  = ".abortstack";
section6.output_section[3].output_sections_start  = "__ABORT_STACK_START";
section6.output_section[3].output_sections_end    = "__ABORT_STACK_END";
section6.output_section[3].input_section.create(1);
section6.output_section[3].input_section[0].$name = ". = . + __ABORT_STACK_SIZE;";
section6.output_section[4].$name                  = ".undefinedstack";
section6.output_section[4].output_sections_start  = "__UNDEFINED_STACK_START";
section6.output_section[4].output_sections_end    = "__UNDEFINED_STACK_END";
section6.output_section[4].input_section.create(1);
section6.output_section[4].input_section[0].$name = ". = . + __UNDEFINED_STACK_SIZE;";

section7.load_memory                  = "OCRAM";
section7.$name                        = "Initialization and Exception Handling";
section7.output_section.create(3);
section7.output_section[0].$name      = ".ARM.exidx";
section7.output_section[0].palignment = true;
section7.output_section[1].$name      = ".init_array";
section7.output_section[1].palignment = true;
section7.output_section[2].$name      = ".fini_array";
section7.output_section[2].palignment = true;

section8.load_memory                 = "USER_SHM_MEM";
section8.type                        = "NOLOAD";
section8.$name                       = "User Shared Memory";
section8.group                       = false;
section8.output_section.create(1);
section8.output_section[0].$name     = ".bss.user_shared_mem";
section8.output_section[0].alignment = 0;

section9.load_memory                 = "LOG_SHM_MEM";
section9.$name                       = "Log Shared Memory";
section9.group                       = false;
section9.type                        = "NOLOAD";
section9.output_section.create(1);
section9.output_section[0].$name     = ".bss.log_shared_mem";
section9.output_section[0].alignment = 0;

section10.load_memory                 = "RTOS_NORTOS_IPC_SHM_MEM";
section10.type                        = "NOLOAD";
section10.$name                       = "IPC Shared Memory";
section10.group                       = false;
section10.output_section.create(1);
section10.output_section[0].$name     = ".bss.ipc_vring_mem";
section10.output_section[0].alignment = 0;

section11.load_memory                 = "MAILBOX_HSM";
section11.type                        = "NOLOAD";
section11.$name                       = "SIPC HSM Queue Memory";
section11.group                       = false;
section11.output_section.create(1);
section11.output_section[0].$name     = ".bss.sipc_hsm_queue_mem";
section11.output_section[0].alignment = 0;

section12.load_memory                 = "MAILBOX_R5F";
section12.$name                       = "SIPC R5F Queue Memory";
section12.group                       = false;
section12.type                        = "NOLOAD";
section12.output_section.create(1);
section12.output_section[0].$name     = ".bss.sipc_secure_host_queue_mem";
section12.output_section[0].alignment = 0;

section13.$name                             = "TCM_A_MEMORY";
section13.load_memory                       = "R5F_TCMA";
section13.output_section.create(1);
section13.output_section[0].$name           = ".tcm_a_mem";
section13.output_section[0].palignment      = true;
section13.output_section[0].include_defines = true;

int_xbar1.$name      = "CONFIG_INT_XBAR0";
int_xbar1.xbarOutput = ["EPWM31_INT"];

/**
 * Pinmux solution for unlocked pins/peripherals. This ensures that minor changes to the automatic solver in a future
 * version of the tool will not impact the pinmux you originally saw.  These lines can be completely deleted in order to
 * re-solve from scratch.
 */
epwm1.EPWM.A.$suggestSolution           = "GPIO43";
epwm1.EPWM.B.$suggestSolution           = "GPIO44";
epwm2.EPWM.A.$suggestSolution           = "GPIO45";
epwm2.EPWM.B.$suggestSolution           = "GPIO46";
epwm3.EPWM.A.$suggestSolution           = "GPIO47";
epwm3.EPWM.B.$suggestSolution           = "GPIO48";
epwm4.EPWM.A.$suggestSolution           = "GPIO49";
epwm4.EPWM.B.$suggestSolution           = "GPIO50";
epwm5.EPWM.A.$suggestSolution           = "GPIO51";
epwm5.EPWM.B.$suggestSolution           = "GPIO52";
epwm6.EPWM.A.$suggestSolution           = "GPIO105";
epwm6.EPWM.B.$suggestSolution           = "GPIO106";
debug_log.uartLog.UART.$suggestSolution = "UART0";
