/**
 * @cliArgs --device "AM64x" --package "ALV" --part "Default" --context "a53ss0-0" --product "MCU_PLUS_SDK@07.03.01"
 * @versions {"tool":"1.14.0+2667"}
 */

/**
 * Import the modules used in this configuration.
 */
const gpio       = scripting.addModule("/drivers/gpio/gpio", {}, false);
const gpio1      = gpio.addInstance();
const debug_log  = scripting.addModule("/kernel/dpl/debug_log");
const dpl_cfg = scripting.addModule("/kernel/dpl/dpl_cfg");
const mmu_armv8  = scripting.addModule("/kernel/dpl/mmu_armv8", {}, false);
const mmu_armv81 = mmu_armv8.addInstance();
const mmu_armv82 = mmu_armv8.addInstance();
const mmu_armv83 = mmu_armv8.addInstance();
const mmu_armv84 = mmu_armv8.addInstance();

/**
 * Write custom configuration values to the imported modules.
 */
gpio1.$name                = "GPIO_PUSH_BUTTON";
gpio1.trigType             = "RISE_EDGE";
gpio1.enableIntr           = true;
gpio1.GPIO.gpioPin.$assign = "ball.C13";

debug_log.enableCssLog         = false;
debug_log.enableUartLog        = true;
debug_log.uartLog.$name        = "CONFIG_UART_CONSOLE";
debug_log.uartLog.UART.$assign = "USART0";

mmu_armv81.$name = "CONFIG_MMU_REGION0";
mmu_armv81.size  = 0x80000000;

mmu_armv82.$name     = "CONFIG_MMU_REGION1";
mmu_armv82.vAddr     = 0x70000000;
mmu_armv82.pAddr     = 0x70000000;
mmu_armv82.size      = 0x200000;
mmu_armv82.attribute = "MAIR7";

mmu_armv83.$name     = "CONFIG_MMU_REGION2";
mmu_armv83.vAddr     = 0x701D0000;
mmu_armv83.pAddr     = 0x701D0000;
mmu_armv83.size      = 0x10000;
mmu_armv83.attribute = "MAIR4";

mmu_armv84.$name     = "CONFIG_MMU_REGION3";
mmu_armv84.vAddr     = 0x80000000;
mmu_armv84.pAddr     = 0x80000000;
mmu_armv84.size      = 0x80000000;
mmu_armv84.attribute = "MAIR7";

/**
 * Pinmux solution for unlocked pins/peripherals. This ensures that minor changes to the automatic solver in a future
 * version of the tool will not impact the pinmux you originally saw.  These lines can be completely deleted in order to
 * re-solve from scratch.
 */
gpio1.GPIO.$suggestSolution                 = "GPIO1";
debug_log.uartLog.UART.RXD.$suggestSolution = "ball.D15";
debug_log.uartLog.UART.TXD.$suggestSolution = "ball.C16";
