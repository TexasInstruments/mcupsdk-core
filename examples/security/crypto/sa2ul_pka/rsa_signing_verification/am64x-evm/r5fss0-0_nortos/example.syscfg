/**
 * @cliArgs --device "AM64x_beta" --package "ALV" --part "Default" --context "r5fss0-0" --product "MCU_PLUS_SDK@07.03.01"
 * @versions {"tool":"1.14.0+2667"}
 */

/**
 * Import the modules used in this configuration.
 */
const firewall   = scripting.addModule("/drivers/firewall/firewall", {}, false);
const firewall1  = firewall.addInstance();
const debug_log  = scripting.addModule("/kernel/dpl/debug_log");
const mpu_armv7  = scripting.addModule("/kernel/dpl/mpu_armv7", {}, false);
const mpu_armv71 = mpu_armv7.addInstance();
const mpu_armv72 = mpu_armv7.addInstance();
const mpu_armv73 = mpu_armv7.addInstance();
const mpu_armv74 = mpu_armv7.addInstance();
const mpu_armv75 = mpu_armv7.addInstance();
const mpu_armv76 = mpu_armv7.addInstance();
const crypto     = scripting.addModule("/security/crypto/crypto", {}, false);
const crypto1    = crypto.addInstance();

/**
 * Write custom configuration values to the imported modules.
 */
firewall1.$name               = "CONFIG_FIREWALL0";
firewall1.regCfg.create(2);
firewall1.regCfg[0].$name     = "FWL_REG_CFG0";
firewall1.regCfg[0].regIndex  = 1;
firewall1.regCfg[0].instName  = "SA2_UL0";
firewall1.regCfg[0].interName = "MMRA";
firewall1.regCfg[0].fwlCache  = true;
firewall1.regCfg[0].fwlPriv1  = "MAIN_0_R5_0_SECURE";
firewall1.regCfg[1].$name     = "FWL_REG_CFG1";
firewall1.regCfg[1].regIndex  = 4;
firewall1.regCfg[1].instName  = "SA2_UL0";
firewall1.regCfg[1].interName = "EIP_29T2";
firewall1.regCfg[1].fwlCache  = true;
firewall1.regCfg[1].fwlPriv1  = "MAIN_0_R5_0_SECURE";

debug_log.enableUartLog        = true;
debug_log.uartLog.$name        = "CONFIG_UART_CONSOLE";
debug_log.uartLog.UART.$assign = "USART0";

mpu_armv71.$name             = "CONFIG_MPU_REGION0";
mpu_armv71.size              = 31;
mpu_armv71.attributes        = "Device";
mpu_armv71.accessPermissions = "Supervisor RD+WR, User RD";
mpu_armv71.allowExecute      = false;

mpu_armv72.$name             = "CONFIG_MPU_REGION1";
mpu_armv72.size              = 15;
mpu_armv72.accessPermissions = "Supervisor RD+WR, User RD";

mpu_armv73.$name             = "CONFIG_MPU_REGION2";
mpu_armv73.baseAddr          = 0x41010000;
mpu_armv73.size              = 15;
mpu_armv73.accessPermissions = "Supervisor RD+WR, User RD";

mpu_armv74.$name             = "CONFIG_MPU_REGION3";
mpu_armv74.baseAddr          = 0x70000000;
mpu_armv74.size              = 21;
mpu_armv74.accessPermissions = "Supervisor RD+WR, User RD";

mpu_armv75.$name             = "CONFIG_MPU_REGION4";
mpu_armv75.baseAddr          = 0x60000000;
mpu_armv75.size              = 28;
mpu_armv75.accessPermissions = "Supervisor RD, User RD";

mpu_armv76.$name    = "CONFIG_MPU_REGION5";
mpu_armv76.baseAddr = 0x80000000;
mpu_armv76.size     = 31;

crypto1.$name       = "CONFIG_CRYPTO0";
crypto1.sa2ul.$name = "CONFIG_SA2UL0";

const udma               = scripting.addModule("/drivers/udma/udma", {}, false);
const udma1              = udma.addInstance({}, false);
udma1.$name              = "CONFIG_UDMA0";
crypto1.sa2ul.udmaPKTDMA = udma1;

/**
 * Pinmux solution for unlocked pins/peripherals. This ensures that minor changes to the automatic solver in a future
 * version of the tool will not impact the pinmux you originally saw.  These lines can be completely deleted in order to
 * re-solve from scratch.
 */
debug_log.uartLog.UART.RXD.$suggestSolution = "ball.D15";
debug_log.uartLog.UART.TXD.$suggestSolution = "ball.C16";
