/**
 * @cliArgs --device "AM263Px" --package "ZCZ_S" --part "AM263P1" --context "r5fss0-0" --product "MCU_PLUS_SDK@07.03.01"
 * @versions {"tool":"1.17.0+3128"}
 */

/**
 * Import the modules used in this configuration.
 */
const eeprom     = scripting.addModule("/board/eeprom/eeprom", {}, false);
const eeprom1    = eeprom.addInstance();
const i2c        = scripting.addModule("/drivers/i2c/i2c", {}, false);
const i2c1       = i2c.addInstance();
const i2c2       = i2c.addInstance();
const debug_log  = scripting.addModule("/kernel/dpl/debug_log");
const mpu_armv7  = scripting.addModule("/kernel/dpl/mpu_armv7", {}, false);
const mpu_armv71 = mpu_armv7.addInstance();
const mpu_armv72 = mpu_armv7.addInstance();
const mpu_armv73 = mpu_armv7.addInstance();
const mpu_armv74 = mpu_armv7.addInstance();
const mpu_armv75 = mpu_armv7.addInstance();
const enet_cpsw  = scripting.addModule("/networking/enet_cpsw/enet_cpsw", {}, false);
const enet_cpsw1 = enet_cpsw.addInstance();

/**
 * Write custom configuration values to the imported modules.
 */
eeprom1.$name = "CONFIG_EEPROM0";

i2c1.$name               = "CONFIG_I2C0";
eeprom1.peripheralDriver = i2c1;
i2c1.I2C.$assign         = "I2C0";
i2c1.I2C.SCL.$assign     = "I2C0_SCL";
i2c1.I2C.SDA.$assign     = "I2C0_SDA";

i2c2.$name           = "CONFIG_I2C1";
i2c2.I2C.$assign     = "I2C2";
i2c2.I2C.SCL.$assign = "UART0_RTSn";
i2c2.I2C.SDA.$assign = "UART0_CTSn";

debug_log.enableUartLog            = true;
debug_log.enableCssLog             = false;
debug_log.uartLog.$name            = "CONFIG_UART0";
debug_log.uartLog.UART.$assign     = "UART0";
debug_log.uartLog.UART.RXD.$assign = "UART0_RXD";
debug_log.uartLog.UART.TXD.$assign = "UART0_TXD";

mpu_armv71.$name             = "CONFIG_MPU_REGION0";
mpu_armv71.size              = 31;
mpu_armv71.attributes        = "Device";
mpu_armv71.accessPermissions = "Supervisor RD+WR, User RD";
mpu_armv71.allowExecute      = false;

mpu_armv72.$name             = "CONFIG_MPU_REGION1";
mpu_armv72.size              = 15;
mpu_armv72.accessPermissions = "Supervisor RD+WR, User RD";

mpu_armv73.$name             = "CONFIG_MPU_REGION2";
mpu_armv73.baseAddr          = 0x80000;
mpu_armv73.size              = 15;
mpu_armv73.accessPermissions = "Supervisor RD+WR, User RD";

mpu_armv74.$name             = "CONFIG_MPU_REGION3";
mpu_armv74.accessPermissions = "Supervisor RD+WR, User RD";
mpu_armv74.baseAddr          = 0x70000000;
mpu_armv74.size              = 21;

mpu_armv75.$name      = "CONFIG_MPU_REGION4";
mpu_armv75.baseAddr   = 0x70080000;
mpu_armv75.size       = 14;
mpu_armv75.attributes = "NonCached";

enet_cpsw1.$name                         = "CONFIG_ENET_CPSW0";
enet_cpsw1.LargePoolPktCount             = 32;
enet_cpsw1.PktInfoOnlyEnable             = true;
enet_cpsw1.RtosVariant                   = "NoRTOS";
enet_cpsw1.hostportRxCsumOffloadEn       = false;
enet_cpsw1.macOnlyEn_hostPort            = true;
enet_cpsw1.macOnlyEn_macPort1            = true;
enet_cpsw1.macOnlyEn_macPort2            = true;
enet_cpsw1.txDmaChannel[0].$name         = "ENET_DMA_TX_CH0";
enet_cpsw1.rxDmaChannel[0].$name         = "ENET_DMA_RX_CH0";
enet_cpsw1.pinmux[0].$name               = "ENET_CPSW_PINMUX0";
enet_cpsw1.pinmux[0].RGMII2.RD0.$used    = false;
enet_cpsw1.pinmux[0].RGMII2.RD1.$used    = false;
enet_cpsw1.pinmux[0].RGMII2.RD2.$used    = false;
enet_cpsw1.pinmux[0].RGMII2.RD3.$used    = false;
enet_cpsw1.pinmux[0].RGMII2.RX_CTL.$used = false;
enet_cpsw1.pinmux[0].RGMII2.RXC.$used    = false;
enet_cpsw1.pinmux[0].RGMII2.TD0.$used    = false;
enet_cpsw1.pinmux[0].RGMII2.TD1.$used    = false;
enet_cpsw1.pinmux[0].RGMII2.TD2.$used    = false;
enet_cpsw1.pinmux[0].RGMII2.TD3.$used    = false;
enet_cpsw1.pinmux[0].RGMII2.TX_CTL.$used = false;
enet_cpsw1.pinmux[0].RGMII2.TXC.$used    = false;
enet_cpsw1.netifInstance.create(1);
enet_cpsw1.netifInstance[0].$name        = "NETIF_INST_ID0";

/**
 * Pinmux solution for unlocked pins/peripherals. This ensures that minor changes to the automatic solver in a future
 * version of the tool will not impact the pinmux you originally saw.  These lines can be completely deleted in order to
 * re-solve from scratch.
 */
enet_cpsw1.pinmux[0].MDIO.$suggestSolution          = "MDIO";
enet_cpsw1.pinmux[0].MDIO.MDC.$suggestSolution      = "MDIO0_MDC";
enet_cpsw1.pinmux[0].MDIO.MDIO.$suggestSolution     = "MDIO0_MDIO";
enet_cpsw1.pinmux[0].RGMII1.$suggestSolution        = "RGMII2";
enet_cpsw1.pinmux[0].RGMII1.RD0.$suggestSolution    = "PR0_PRU0_GPIO0";
enet_cpsw1.pinmux[0].RGMII1.RD1.$suggestSolution    = "PR0_PRU0_GPIO1";
enet_cpsw1.pinmux[0].RGMII1.RD2.$suggestSolution    = "PR0_PRU0_GPIO2";
enet_cpsw1.pinmux[0].RGMII1.RD3.$suggestSolution    = "PR0_PRU0_GPIO3";
enet_cpsw1.pinmux[0].RGMII1.RX_CTL.$suggestSolution = "PR0_PRU0_GPIO4";
enet_cpsw1.pinmux[0].RGMII1.RXC.$suggestSolution    = "PR0_PRU0_GPIO6";
enet_cpsw1.pinmux[0].RGMII1.TD0.$suggestSolution    = "PR0_PRU0_GPIO11";
enet_cpsw1.pinmux[0].RGMII1.TD1.$suggestSolution    = "PR0_PRU0_GPIO12";
enet_cpsw1.pinmux[0].RGMII1.TD2.$suggestSolution    = "PR0_PRU0_GPIO13";
enet_cpsw1.pinmux[0].RGMII1.TD3.$suggestSolution    = "PR0_PRU0_GPIO14";
enet_cpsw1.pinmux[0].RGMII1.TX_CTL.$suggestSolution = "PR0_PRU0_GPIO15";
enet_cpsw1.pinmux[0].RGMII1.TXC.$suggestSolution    = "PR0_PRU0_GPIO16";
enet_cpsw1.pinmux[0].RGMII2.$suggestSolution        = "RGMII1";
