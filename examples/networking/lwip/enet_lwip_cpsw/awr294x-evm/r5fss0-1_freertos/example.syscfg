/**
 * @cliArgs --device "AWR294X" --package "ETS" --part "Default" --context "r5fss0-1" --product "MCU_PLUS_SDK@07.03.01"
 * @versions {"tool":"1.13.0+2553"}
 */

/**
 * Import the modules used in this configuration.
 */
const debug_log  = scripting.addModule("/kernel/dpl/debug_log");
const dpl_cfg = scripting.addModule("/kernel/dpl/dpl_cfg");
const mpu_armv7  = scripting.addModule("/kernel/dpl/mpu_armv7", {}, false);
const mpu_armv71 = mpu_armv7.addInstance();
const mpu_armv72 = mpu_armv7.addInstance();
const mpu_armv73 = mpu_armv7.addInstance();
const mpu_armv74 = mpu_armv7.addInstance();
const mpu_armv75 = mpu_armv7.addInstance();
const mpu_armv76 = mpu_armv7.addInstance();
const enet_cpsw  = scripting.addModule("/networking/enet_cpsw/enet_cpsw", {}, false);
const enet_cpsw1 = enet_cpsw.addInstance();

/**
 * Write custom configuration values to the imported modules.
 */
debug_log.enableUartLog           = true;
debug_log.enableCssLog            = false;
debug_log.uartLog.$name           = "CONFIG_UART0";
debug_log.uartLog.UART.$assign    = "UARTA";
debug_log.uartLog.UART.RX.$assign = "ball.B16";
debug_log.uartLog.UART.TX.$assign = "ball.C16";

const edma                         = scripting.addModule("/drivers/edma/edma", {}, false);
const edma1                        = edma.addInstance({}, false);
edma1.$name                        = "CONFIG_EDMA0";
debug_log.uartLog.edmaConfig       = edma1;
edma1.edmaRmDmaCh[0].$name         = "CONFIG_EDMA_RM0";
edma1.edmaRmQdmaCh[0].$name        = "CONFIG_EDMA_RM1";
edma1.edmaRmTcc[0].$name           = "CONFIG_EDMA_RM2";
edma1.edmaRmParam[0].$name         = "CONFIG_EDMA_RM3";
edma1.edmaRmReservedDmaCh[0].$name = "CONFIG_EDMA_RM4";

mpu_armv71.$name        = "CONFIG_MPU_REGION0";
mpu_armv71.attributes   = "Device";
mpu_armv71.allowExecute = false;

mpu_armv72.$name = "CONFIG_MPU_REGION1";
mpu_armv72.size  = 14;

mpu_armv73.$name    = "CONFIG_MPU_REGION2";
mpu_armv73.baseAddr = 0x80000;
mpu_armv73.size     = 14;

mpu_armv74.$name    = "CONFIG_MPU_REGION3";
mpu_armv74.baseAddr = 0x10200000;
mpu_armv74.size     = 20;

mpu_armv75.$name    = "CONFIG_MPU_REGION4";
mpu_armv75.baseAddr = 0x88000000;
mpu_armv75.size     = 22;

mpu_armv76.$name      = "CONFIG_MPU_REGION5";
mpu_armv76.baseAddr   = 0x1021C000;
mpu_armv76.size       = 14;
mpu_armv76.attributes = "NonCached";

enet_cpsw1.$name                           = "CONFIG_ENET_CPSW0";
enet_cpsw1.AppLinkUpPortMask               = "ALL_PORTS";
enet_cpsw1.LargePoolPktCount               = 32;
enet_cpsw1.PktInfoOnlyEnable               = true;
enet_cpsw1.cptsHostRxTsEn                  = false;
enet_cpsw1.txDmaChannel[0].$name           = "ENET_DMA_TX_CH0";
enet_cpsw1.rxDmaChannel[0].$name           = "ENET_DMA_RX_CH0";
enet_cpsw1.$name                 = "CONFIG_ENET_CPSW0";
enet_cpsw1.phyToMacInterfaceMode = "RGMII";
enet_cpsw1.netifInstance.create(1);
enet_cpsw1.netifInstance[0].$name          = "NETIF_INST_ID0";

/**
 * Pinmux solution for unlocked pins/peripherals. This ensures that minor changes to the automatic solver in a future
 * version of the tool will not impact the pinmux you originally saw.  These lines can be completely deleted in order to
 * re-solve from scratch.
 */
enet_cpsw1.MDIO.$suggestSolution       = "MDIO0";
enet_cpsw1.MDIO.DATA.$suggestSolution  = "ball.T5";
enet_cpsw1.MDIO.CLK.$suggestSolution   = "ball.R4";
enet_cpsw1.RGMII.$suggestSolution      = "RGMII0";
enet_cpsw1.RGMII.RD0.$suggestSolution  = "ball.V6";
enet_cpsw1.RGMII.RD1.$suggestSolution  = "ball.V4";
enet_cpsw1.RGMII.RD2.$suggestSolution  = "ball.V5";
enet_cpsw1.RGMII.RD3.$suggestSolution  = "ball.U10";
enet_cpsw1.RGMII.RCTL.$suggestSolution = "ball.T7";
enet_cpsw1.RGMII.RCLK.$suggestSolution = "ball.T9";
enet_cpsw1.RGMII.TD0.$suggestSolution  = "ball.U7";
enet_cpsw1.RGMII.TD1.$suggestSolution  = "ball.U5";
enet_cpsw1.RGMII.TD2.$suggestSolution  = "ball.U6";
enet_cpsw1.RGMII.TD3.$suggestSolution  = "ball.U4";
enet_cpsw1.RGMII.TCTL.$suggestSolution = "ball.R6";
enet_cpsw1.RGMII.TCLK.$suggestSolution = "ball.V3";
