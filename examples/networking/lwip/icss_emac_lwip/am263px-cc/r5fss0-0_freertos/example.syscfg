/**
 * @cliArgs --device "AM263Px" --package "ZCZ_S" --part "AM263P4" --context "r5fss0-0" --product "MCU_PLUS_SDK@07.03.01"
 * @versions {"tool":"1.20.0+3587"}
 */

/**
 * Import the modules used in this configuration.
 */
const eeprom     = scripting.addModule("/board/eeprom/eeprom", {}, false);
const eeprom1    = eeprom.addInstance();
const ethphy     = scripting.addModule("/board/ethphy/ethphy", {}, false);
const ethphy1    = ethphy.addInstance();
const ethphy2    = ethphy.addInstance();
const i2c        = scripting.addModule("/drivers/i2c/i2c", {}, false);
const i2c1       = i2c.addInstance();
const i2c2       = i2c.addInstance();
const pruicss    = scripting.addModule("/drivers/pruicss/pruicss", {}, false);
const pruicss1   = pruicss.addInstance();
const clock      = scripting.addModule("/kernel/dpl/clock");
const debug_log  = scripting.addModule("/kernel/dpl/debug_log");
const dpl_cfg = scripting.addModule("/kernel/dpl/dpl_cfg");
const mpu_armv7  = scripting.addModule("/kernel/dpl/mpu_armv7", {}, false);
const mpu_armv71 = mpu_armv7.addInstance();
const mpu_armv72 = mpu_armv7.addInstance();
const mpu_armv73 = mpu_armv7.addInstance();
const mpu_armv74 = mpu_armv7.addInstance();
const mpu_armv75 = mpu_armv7.addInstance();
const mpu_armv76 = mpu_armv7.addInstance();
const mpu_armv77 = mpu_armv7.addInstance();
const icss_emac  = scripting.addModule("/networking/icss_emac/icss_emac", {}, false);
const icss_emac1 = icss_emac.addInstance();

/**
 * Write custom configuration values to the imported modules.
 */
eeprom1.$name = "CONFIG_EEPROM0";

ethphy1.$name    = "CONFIG_ETHPHY0";
ethphy1.mdioPort = 0;

ethphy2.$name    = "CONFIG_ETHPHY1";
ethphy2.name     = "DP83826E";
ethphy2.mdioPort = 1;

i2c1.$name               = "CONFIG_I2C0";
eeprom1.peripheralDriver = i2c1;
i2c1.I2C.$assign         = "I2C0";
i2c1.I2C_child.$name     = "drivers_i2c_v1_i2c_v1_template1";

i2c2.$name           = "CONFIG_I2C1";
i2c2.I2C.$assign     = "I2C2";
i2c2.I2C.SCL.$assign = "UART0_RTSn";
i2c2.I2C.SDA.$assign = "UART0_CTSn";
i2c2.I2C_child.$name = "drivers_i2c_v1_i2c_v1_template2";

pruicss1.$name = "CONFIG_PRU_ICSS1";

debug_log.enableCssLog        = false;
debug_log.enableUartLog       = true;
debug_log.uartLog.$name       = "CONFIG_UART0";
debug_log.uartLog.child.$name = "drivers_uart_v2_uart_v2_template0";

mpu_armv71.$name             = "CONFIG_MPU_REGION0";
mpu_armv71.size              = 31;
mpu_armv71.accessPermissions = "Supervisor RD+WR, User RD";
mpu_armv71.attributes        = "Device";
mpu_armv71.allowExecute      = false;

mpu_armv72.$name             = "CONFIG_MPU_REGION1";
mpu_armv72.size              = 15;
mpu_armv72.accessPermissions = "Supervisor RD+WR, User RD";

mpu_armv73.$name             = "CONFIG_MPU_REGION2";
mpu_armv73.baseAddr          = 0x80000;
mpu_armv73.size              = 15;
mpu_armv73.accessPermissions = "Supervisor RD+WR, User RD";

mpu_armv74.$name             = "CONFIG_MPU_REGION3";
mpu_armv74.baseAddr          = 0x70000000;
mpu_armv74.size              = 21;
mpu_armv74.accessPermissions = "Supervisor RD+WR, User RD";

mpu_armv75.$name        = "CONFIG_MPU_REGION4";
mpu_armv75.baseAddr     = 0x50D00000;
mpu_armv75.size         = 14;
mpu_armv75.attributes   = "Device";
mpu_armv75.allowExecute = false;

mpu_armv76.$name        = "CONFIG_MPU_REGION5";
mpu_armv76.baseAddr     = 0x72000000;
mpu_armv76.size         = 14;
mpu_armv76.attributes   = "NonCached";
mpu_armv76.allowExecute = false;

mpu_armv77.$name      = "CONFIG_MPU_REGION6";
mpu_armv77.baseAddr   = 0x70000000;
mpu_armv77.size       = 16;
mpu_armv77.attributes = "Cached+Sharable";

icss_emac1.$name            = "CONFIG_ICSS_EMAC0";
icss_emac1.linkTaskPriority = 12;
icss_emac1.rxTaskPriority   = 10;
icss_emac1.txTaskPriority   = 10;
icss_emac1.phyAddr0         = 0;
icss_emac1.phyAddr1         = 1;
icss_emac1.queue            = "QUEUE4";
icss_emac1.learningEnable   = true;

/**
 * Pinmux solution for unlocked pins/peripherals. This ensures that minor changes to the automatic solver in a future
 * version of the tool will not impact the pinmux you originally saw.  These lines can be completely deleted in order to
 * re-solve from scratch.
 */
i2c1.I2C.SCL.$suggestSolution               = "I2C0_SCL";
i2c1.I2C.SDA.$suggestSolution               = "I2C0_SDA";
debug_log.uartLog.UART.$suggestSolution     = "UART0";
debug_log.uartLog.UART.RXD.$suggestSolution = "MMC_CLK";
debug_log.uartLog.UART.TXD.$suggestSolution = "MMC_CMD";
