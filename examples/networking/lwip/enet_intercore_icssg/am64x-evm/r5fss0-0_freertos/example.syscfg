/**
 * @cliArgs --device "AM64x" --package "ALV" --part "Default" --context "r5fss0-0" --product "MCU_PLUS_SDK@07.03.01"
 * @versions {"tool":"1.19.0+3426"}
 */

/**
 * Import the modules used in this configuration.
 */
const eeprom          = scripting.addModule("/board/eeprom/eeprom", {}, false);
const eeprom1         = eeprom.addInstance();
const i2c             = scripting.addModule("/drivers/i2c/i2c", {}, false);
const i2c1            = i2c.addInstance();
const ipc             = scripting.addModule("/drivers/ipc/ipc");
const pruicss         = scripting.addModule("/drivers/pruicss/pruicss", {}, false);
const pruicss1        = pruicss.addInstance();
const debug_log       = scripting.addModule("/kernel/dpl/debug_log");
const dpl_cfg = scripting.addModule("/kernel/dpl/dpl_cfg");
const mpu_armv7       = scripting.addModule("/kernel/dpl/mpu_armv7", {}, false);
const mpu_armv71      = mpu_armv7.addInstance();
const mpu_armv72      = mpu_armv7.addInstance();
const mpu_armv73      = mpu_armv7.addInstance();
const mpu_armv74      = mpu_armv7.addInstance();
const mpu_armv75      = mpu_armv7.addInstance();
const mpu_armv76      = mpu_armv7.addInstance();
const mpu_armv77      = mpu_armv7.addInstance();
const mpu_armv78      = mpu_armv7.addInstance();
const mpu_armv79      = mpu_armv7.addInstance();
const mpu_armv710     = mpu_armv7.addInstance();
const default_linker  = scripting.addModule("/memory_configurator/default_linker", {}, false);
const default_linker1 = default_linker.addInstance();
const general         = scripting.addModule("/memory_configurator/general", {}, false);
const general1        = general.addInstance();
const region          = scripting.addModule("/memory_configurator/region", {}, false);
const region1         = region.addInstance();
const section         = scripting.addModule("/memory_configurator/section", {}, false);
const section1        = section.addInstance();
const section2        = section.addInstance();
const section3        = section.addInstance();
const section4        = section.addInstance();
const section5        = section.addInstance();
const section6        = section.addInstance();
const section7        = section.addInstance();
const section8        = section.addInstance();
const section9        = section.addInstance();
const section10       = section.addInstance();
const section11       = section.addInstance();
const section12       = section.addInstance();
const section13       = section.addInstance();
const section14       = section.addInstance();
const section15       = section.addInstance();
const enet_icss       = scripting.addModule("/networking/enet_icss/enet_icss", {}, false);
const enet_icss1      = enet_icss.addInstance();

/**
 * Write custom configuration values to the imported modules.
 */
eeprom1.$name = "CONFIG_EEPROM0";

i2c1.$name               = "CONFIG_I2C0";
eeprom1.peripheralDriver = i2c1;
i2c1.I2C.$assign         = "I2C0";

ipc.r5fss1_0 = "NONE";
ipc.r5fss1_1 = "NONE";
ipc.m4fss0_0 = "NONE";

debug_log.enableUartLog        = true;
debug_log.enableCssLog         = false;
debug_log.uartLog.$name        = "CONFIG_UART0";
debug_log.uartLog.UART.$assign = "USART0";

const uart_v0_template  = scripting.addModule("/drivers/uart/v0/uart_v0_template", {}, false);
const uart_v0_template1 = uart_v0_template.addInstance({}, false);
uart_v0_template1.$name = "drivers_uart_v0_uart_v0_template0";
debug_log.uartLog.child = uart_v0_template1;

mpu_armv71.$name             = "CONFIG_MPU_REGION0";
mpu_armv71.size              = 31;
mpu_armv71.attributes        = "Device";
mpu_armv71.accessPermissions = "Supervisor RD+WR, User RD";
mpu_armv71.allowExecute      = false;

mpu_armv72.$name             = "CONFIG_MPU_REGION1";
mpu_armv72.size              = 15;
mpu_armv72.accessPermissions = "Supervisor RD+WR, User RD";

mpu_armv73.$name             = "CONFIG_MPU_REGION2";
mpu_armv73.baseAddr          = 0x41010000;
mpu_armv73.size              = 15;
mpu_armv73.accessPermissions = "Supervisor RD+WR, User RD";

mpu_armv74.$name             = "CONFIG_MPU_REGION3";
mpu_armv74.baseAddr          = 0x70000000;
mpu_armv74.size              = 21;
mpu_armv74.accessPermissions = "Supervisor RD+WR, User RD";

mpu_armv75.$name    = "CONFIG_MPU_REGION4";
mpu_armv75.size     = 31;
mpu_armv75.baseAddr = 0x80000000;

mpu_armv76.$name        = "CONFIG_MPU_REGION5";
mpu_armv76.baseAddr     = 0xA0000000;
mpu_armv76.size         = 20;
mpu_armv76.attributes   = "NonCached";
mpu_armv76.allowExecute = false;

mpu_armv77.$name        = "CONFIG_MPU_REGION6";
mpu_armv77.attributes   = "NonCached";
mpu_armv77.allowExecute = false;
mpu_armv77.baseAddr     = 0xA5000000;
mpu_armv77.size         = 16;

mpu_armv78.$name    = "CONFIG_MPU_REGION7";
mpu_armv78.baseAddr = 0xA0100000;
mpu_armv78.size     = 20;

mpu_armv79.$name    = "CONFIG_MPU_REGION8";
mpu_armv79.size     = 21;
mpu_armv79.baseAddr = 0xA0200000;

mpu_armv710.$name      = "CONFIG_MPU_REGION9";
mpu_armv710.size       = 22;
mpu_armv710.baseAddr   = 0xA0400000;
mpu_armv710.attributes = "NonCached";

default_linker1.$name = "memory_configurator_default_linker0";

general1.$name        = "CONFIG_GENERAL0";
general1.linker.$name = "TIARMCLANG0";

region1.$name                                = "MEMORY_REGION_CONFIGURATION0";
region1.memory_region.create(12);
region1.memory_region[0].type                = "TCMA_R5F";
region1.memory_region[0].$name               = "R5F_VECS";
region1.memory_region[0].size                = 0x40;
region1.memory_region[0].auto                = false;
region1.memory_region[1].type                = "TCMA_R5F";
region1.memory_region[1].$name               = "R5F_TCMA";
region1.memory_region[1].size                = 0x7FC0;
region1.memory_region[2].type                = "TCMB_R5F";
region1.memory_region[2].$name               = "R5F_TCMB0";
region1.memory_region[2].size                = 0x8000;
region1.memory_region[3].$name               = "MSRAM";
region1.memory_region[3].auto                = false;
region1.memory_region[3].manualStartAddress  = 0x70080000;
region1.memory_region[3].size                = 0x80000;
region1.memory_region[4].type                = "FLASH";
region1.memory_region[4].$name               = "FLASH";
region1.memory_region[4].auto                = false;
region1.memory_region[4].size                = 0x100000;
region1.memory_region[4].manualStartAddress  = 0x60200000;
region1.memory_region[5].auto                = false;
region1.memory_region[5].size                = 0x80;
region1.memory_region[5].type                = "DDR_ALL";
region1.memory_region[5].manualStartAddress  = 0xA5000000;
region1.memory_region[5].$name               = "USER_SHM_MEM";
region1.memory_region[5].isShared            = true;
region1.memory_region[5].shared_cores        = ["a53ss0-0","a53ss0-1","m4fss0-0","r5fss0-1","r5fss1-0","r5fss1-1"];
region1.memory_region[6].auto                = false;
region1.memory_region[6].size                = 0x3F80;
region1.memory_region[6].type                = "DDR_ALL";
region1.memory_region[6].$name               = "LOG_SHM_MEM";
region1.memory_region[6].manualStartAddress  = 0xA5000080;
region1.memory_region[6].isShared            = true;
region1.memory_region[6].shared_cores        = ["a53ss0-0","a53ss0-1","m4fss0-0","r5fss0-1","r5fss1-0","r5fss1-1"];
region1.memory_region[7].auto                = false;
region1.memory_region[7].size                = 0xC000;
region1.memory_region[7].type                = "DDR_ALL";
region1.memory_region[7].$name               = "RTOS_NORTOS_IPC_SHM_MEM";
region1.memory_region[7].manualStartAddress  = 0xA5004000;
region1.memory_region[7].isShared            = true;
region1.memory_region[7].shared_cores        = ["a53ss0-0","a53ss0-1","m4fss0-0","r5fss0-1","r5fss1-0","r5fss1-1"];
region1.memory_region[8].type                = "DDR_ALL";
region1.memory_region[8].$name               = "DDR_0";
region1.memory_region[8].auto                = false;
region1.memory_region[8].manualStartAddress  = 0xA0100000;
region1.memory_region[8].size                = 0x1000;
region1.memory_region[9].type                = "DDR_ALL";
region1.memory_region[9].auto                = false;
region1.memory_region[9].manualStartAddress  = 0xA0101000;
region1.memory_region[9].$name               = "DDR_1";
region1.memory_region[9].size                = 0x2FF000;
region1.memory_region[10].type               = "DDR_ALL";
region1.memory_region[10].$name              = "LINUX_IPC_SHM_MEM";
region1.memory_region[10].auto               = false;
region1.memory_region[10].manualStartAddress = 0xA0000000;
region1.memory_region[10].size               = 0x100000;
region1.memory_region[10].isShared           = true;
region1.memory_region[10].shared_cores       = ["a53ss0-0"];
region1.memory_region[11].type               = "DDR_ALL";
region1.memory_region[11].$name              = "ETHFW_SHM_MEM";
region1.memory_region[11].auto               = false;
region1.memory_region[11].isShared           = true;
region1.memory_region[11].shared_cores       = ["a53ss0-0","a53ss0-1","r5fss0-1","r5fss1-0","r5fss1-1"];
region1.memory_region[11].manualStartAddress = 0xA0400000;
region1.memory_region[11].size               = 0x100000;

section1.$name                        = "Vector Table";
section1.load_memory                  = "R5F_VECS";
section1.group                        = false;
section1.output_section.create(1);
section1.output_section[0].$name      = ".vectors";
section1.output_section[0].palignment = true;

section2.$name                        = "Text Segments";
section2.load_memory                  = "R5F_TCMA";
section2.output_section.create(5);
section2.output_section[0].$name      = ".text.hwi";
section2.output_section[0].palignment = true;
section2.output_section[1].$name      = ".text.cache";
section2.output_section[1].palignment = true;
section2.output_section[2].$name      = ".text.mpu";
section2.output_section[2].palignment = true;
section2.output_section[3].$name      = ".text.boot";
section2.output_section[3].palignment = true;
section2.output_section[4].$name      = ".text:abort";
section2.output_section[4].palignment = true;

section3.$name                        = "Code and Read-Only Data";
section3.load_memory                  = "DDR_1";
section3.output_section.create(2);
section3.output_section[0].$name      = ".text";
section3.output_section[0].palignment = true;
section3.output_section[1].$name      = ".rodata";
section3.output_section[1].palignment = true;

section4.$name                        = "Data Segment";
section4.load_memory                  = "DDR_1";
section4.output_section.create(1);
section4.output_section[0].$name      = ".data";
section4.output_section[0].palignment = true;

section5.$name                                   = "Memory Segments";
section5.load_memory                             = "DDR_1";
section5.output_section.create(3);
section5.output_section[0].$name                 = ".bss";
section5.output_section[0].palignment            = true;
section5.output_section[0].output_sections_start = "__BSS_START";
section5.output_section[0].output_sections_end   = "__BSS_END";
section5.output_section[1].$name                 = ".sysmem";
section5.output_section[1].palignment            = true;
section5.output_section[2].$name                 = ".stack";
section5.output_section[2].palignment            = true;

section6.$name                                    = "Stack Segments";
section6.load_memory                              = "DDR_1";
section6.output_section.create(5);
section6.output_section[0].$name                  = ".irqstack";
section6.output_section[0].output_sections_start  = "__IRQ_STACK_START";
section6.output_section[0].output_sections_end    = "__IRQ_STACK_END";
section6.output_section[0].input_section.create(1);
section6.output_section[0].input_section[0].$name = ". = . + __IRQ_STACK_SIZE;";
section6.output_section[1].$name                  = ".fiqstack";
section6.output_section[1].output_sections_start  = "__FIQ_STACK_START";
section6.output_section[1].output_sections_end    = "__FIQ_STACK_END";
section6.output_section[1].input_section.create(1);
section6.output_section[1].input_section[0].$name = ". = . + __FIQ_STACK_SIZE;";
section6.output_section[2].$name                  = ".svcstack";
section6.output_section[2].output_sections_start  = "__SVC_STACK_START";
section6.output_section[2].output_sections_end    = "__SVC_STACK_END";
section6.output_section[2].input_section.create(1);
section6.output_section[2].input_section[0].$name = ". = . + __SVC_STACK_SIZE;";
section6.output_section[3].$name                  = ".abortstack";
section6.output_section[3].output_sections_start  = "__ABORT_STACK_START";
section6.output_section[3].output_sections_end    = "__ABORT_STACK_END";
section6.output_section[3].input_section.create(1);
section6.output_section[3].input_section[0].$name = ". = . + __ABORT_STACK_SIZE;";
section6.output_section[4].$name                  = ".undefinedstack";
section6.output_section[4].output_sections_start  = "__UNDEFINED_STACK_START";
section6.output_section[4].output_sections_end    = "__UNDEFINED_STACK_END";
section6.output_section[4].input_section.create(1);
section6.output_section[4].input_section[0].$name = ". = . + __UNDEFINED_STACK_SIZE;";

section7.$name                        = "Initialization and Exception Handling";
section7.load_memory                  = "DDR_1";
section7.output_section.create(3);
section7.output_section[0].$name      = ".ARM.exidx";
section7.output_section[0].palignment = true;
section7.output_section[1].$name      = ".init_array";
section7.output_section[1].palignment = true;
section7.output_section[2].$name      = ".fini_array";
section7.output_section[2].palignment = true;

section8.$name                       = "User Shared Memory";
section8.type                        = "NOLOAD";
section8.load_memory                 = "USER_SHM_MEM";
section8.group                       = false;
section8.output_section.create(1);
section8.output_section[0].$name     = ".bss.user_shared_mem";
section8.output_section[0].alignment = 0;

section9.$name                       = "Log Shared Memory";
section9.load_memory                 = "LOG_SHM_MEM";
section9.type                        = "NOLOAD";
section9.group                       = false;
section9.output_section.create(1);
section9.output_section[0].$name     = ".bss.log_shared_mem";
section9.output_section[0].alignment = 0;

section10.$name                       = "IPC Shared Memory";
section10.type                        = "NOLOAD";
section10.load_memory                 = "RTOS_NORTOS_IPC_SHM_MEM";
section10.group                       = false;
section10.output_section.create(1);
section10.output_section[0].$name     = ".bss.ipc_vring_mem";
section10.output_section[0].alignment = 0;

section11.load_memory                  = "DDR_0";
section11.$name                        = "Resource Table";
section11.output_section.create(1);
section11.output_section[0].$name      = ".resource_table";
section11.output_section[0].alignment  = 4096;
section11.output_section[0].palignment = true;

section12.$name                       = "Ethfw Shared Memory";
section12.type                        = "NOLOAD";
section12.load_memory                 = "ETHFW_SHM_MEM";
section12.output_section.create(1);
section12.output_section[0].$name     = "intercore_eth_desc_mem";
section12.output_section[0].alignment = 128;

section13.$name                       = "ICSSG FW";
section13.type                        = "NOLOAD";
section13.load_memory                 = "DDR_1";
section13.output_section.create(1);
section13.output_section[0].$name     = ".icssfw";
section13.output_section[0].alignment = 128;

section14.$name                                    = "ICSS_MEM";
section14.type                                     = "NOLOAD";
section14.group                                    = false;
section14.load_memory                              = "MSRAM";
section14.output_section.create(1);
section14.output_section[0].$name                  = ".icss_mem";
section14.output_section[0].alignment              = 64;
section14.output_section[0].input_section.create(8);
section14.output_section[0].input_section[0].$name = "*(*gEnetSoc_icssg1PortPoolMem_0)";
section14.output_section[0].input_section[1].$name = "*(*gEnetSoc_icssg1PortPoolMem_1)";
section14.output_section[0].input_section[2].$name = "*(*gEnetSoc_icssg1HostPoolMem_0)";
section14.output_section[0].input_section[3].$name = "*(*gEnetSoc_icssg1HostPoolMem_1)";
section14.output_section[0].input_section[4].$name = "*(*gEnetSoc_icssg1HostQueueMem_0)";
section14.output_section[0].input_section[5].$name = "*(*gEnetSoc_icssg1HostQueueMem_1)";
section14.output_section[0].input_section[6].$name = "*(*gEnetSoc_icssg1ScratchMem_0)";
section14.output_section[0].input_section[7].$name = "*(*gEnetSoc_icssg1ScratchMem_1)";

section15.$name                                    = "Enet Dma mem";
section15.type                                     = "NOLOAD";
section15.load_memory                              = "DDR_1";
section15.output_section.create(1);
section15.output_section[0].$name                  = ".enet_dma_mem";
section15.output_section[0].alignment              = 128;
section15.output_section[0].input_section.create(3);
section15.output_section[0].input_section[0].$name = "*(*ENET_DMA_DESC_MEMPOOL)";
section15.output_section[0].input_section[1].$name = "*(*ENET_DMA_PKT_MEMPOOL)";
section15.output_section[0].input_section[2].$name = "*(*ENET_DMA_RING_MEMPOOL)";

enet_icss1.$name                        = "CONFIG_ENET_ICSS0";
enet_icss1.phyToMacInterfaceMode        = "RGMII";
enet_icss1.PktInfoOnlyEnable            = true;
enet_icss1.PktInfoOnlyCount             = 32;
enet_icss1.LargePoolPktCount            = 128;
enet_icss1.txDmaChannel[0].$name        = "ENET_DMA_TX_CH0";
enet_icss1.txDmaChannel[0].PacketsCount = 32;
enet_icss1.rxDmaChannel[0].$name        = "ENET_DMA_RX_CH0";
enet_icss1.rxDmaChannel[0].PacketsCount = 64;
enet_icss1.rxDmaChannel[1].$name        = "ENET_DMA_RX_CH1";
enet_icss1.rxDmaChannel[1].macAddrCount = 0;
enet_icss1.rxDmaChannel[1].chIdx        = 1;
enet_icss1.rxDmaChannel[1].PacketsCount = 64;
enet_icss1.netifInstance.create(1);
enet_icss1.netifInstance[0].$name       = "NETIF_INST_ID0";
enet_icss1.netifInstance[0].rxDmaChNum  = ["0","1"];

pruicss1.$name                           = "CONFIG_PRU_ICSS0";
enet_icss1.icss                          = pruicss1;
pruicss1.AdditionalICSSSettings[0].$name = "CONFIG_PRU_ICSS_IO0";
pruicss1.intcMapping.create(2);
pruicss1.intcMapping[0].$name            = "CONFIG_ICSS1_INTC_MAPPING0";
pruicss1.intcMapping[0].event            = "41";
pruicss1.intcMapping[0].channel          = "7";
pruicss1.intcMapping[1].$name            = "CONFIG_ICSS1_INTC_MAPPING1";
pruicss1.intcMapping[1].event            = "53";
pruicss1.intcMapping[1].channel          = "7";

const udma         = scripting.addModule("/drivers/udma/udma", {}, false);
const udma1        = udma.addInstance({}, false);
enet_icss1.udmaDrv = udma1;

/**
 * Pinmux solution for unlocked pins/peripherals. This ensures that minor changes to the automatic solver in a future
 * version of the tool will not impact the pinmux you originally saw.  These lines can be completely deleted in order to
 * re-solve from scratch.
 */
i2c1.I2C.SCL.$suggestSolution                            = "I2C0_SCL";
i2c1.I2C.SDA.$suggestSolution                            = "I2C0_SDA";
debug_log.uartLog.UART.RXD.$suggestSolution              = "UART0_RXD";
debug_log.uartLog.UART.TXD.$suggestSolution              = "UART0_TXD";
enet_icss1.PRU_ICSSG1_MDIO.$suggestSolution              = "PRU_ICSSG1_MDIO0";
enet_icss1.PRU_ICSSG1_MDIO.MDC.$suggestSolution          = "PRG1_MDIO0_MDC";
enet_icss1.PRU_ICSSG1_MDIO.MDIO.$suggestSolution         = "PRG1_MDIO0_MDIO";
enet_icss1.PRU_ICSSG1_IEP.$suggestSolution               = "PRU_ICSSG1_IEP0";
enet_icss1.PRU_ICSSG1_IEP.EDC_LATCH_IN0.$suggestSolution = "PRG1_PRU0_GPO18";
enet_icss1.PRU_ICSSG1_IEP.EDC_SYNC_OUT0.$suggestSolution = "PRG1_PRU0_GPO19";
enet_icss1.PRU_ICSSG1_RGMII1.$suggestSolution            = "PRU_ICSSG1_RGMII2";
enet_icss1.PRU_ICSSG1_RGMII1.RD0.$suggestSolution        = "PRG1_PRU1_GPO0";
enet_icss1.PRU_ICSSG1_RGMII1.RD1.$suggestSolution        = "PRG1_PRU1_GPO1";
enet_icss1.PRU_ICSSG1_RGMII1.RD2.$suggestSolution        = "PRG1_PRU1_GPO2";
enet_icss1.PRU_ICSSG1_RGMII1.RD3.$suggestSolution        = "PRG1_PRU1_GPO3";
enet_icss1.PRU_ICSSG1_RGMII1.RXC.$suggestSolution        = "PRG1_PRU1_GPO6";
enet_icss1.PRU_ICSSG1_RGMII1.RX_CTL.$suggestSolution     = "PRG1_PRU1_GPO4";
enet_icss1.PRU_ICSSG1_RGMII1.TD0.$suggestSolution        = "PRG1_PRU1_GPO11";
enet_icss1.PRU_ICSSG1_RGMII1.TD1.$suggestSolution        = "PRG1_PRU1_GPO12";
enet_icss1.PRU_ICSSG1_RGMII1.TD2.$suggestSolution        = "PRG1_PRU1_GPO13";
enet_icss1.PRU_ICSSG1_RGMII1.TD3.$suggestSolution        = "PRG1_PRU1_GPO14";
enet_icss1.PRU_ICSSG1_RGMII1.TXC.$suggestSolution        = "PRG1_PRU1_GPO16";
enet_icss1.PRU_ICSSG1_RGMII1.TX_CTL.$suggestSolution     = "PRG1_PRU1_GPO15";
enet_icss1.PRU_ICSSG1_RGMII2.$suggestSolution            = "PRU_ICSSG1_RGMII1";
enet_icss1.PRU_ICSSG1_RGMII2.RD0.$suggestSolution        = "PRG1_PRU0_GPO0";
enet_icss1.PRU_ICSSG1_RGMII2.RD1.$suggestSolution        = "PRG1_PRU0_GPO1";
enet_icss1.PRU_ICSSG1_RGMII2.RD2.$suggestSolution        = "PRG1_PRU0_GPO2";
enet_icss1.PRU_ICSSG1_RGMII2.RD3.$suggestSolution        = "PRG1_PRU0_GPO3";
enet_icss1.PRU_ICSSG1_RGMII2.RXC.$suggestSolution        = "PRG1_PRU0_GPO6";
enet_icss1.PRU_ICSSG1_RGMII2.RX_CTL.$suggestSolution     = "PRG1_PRU0_GPO4";
enet_icss1.PRU_ICSSG1_RGMII2.TD0.$suggestSolution        = "PRG1_PRU0_GPO11";
enet_icss1.PRU_ICSSG1_RGMII2.TD1.$suggestSolution        = "PRG1_PRU0_GPO12";
enet_icss1.PRU_ICSSG1_RGMII2.TD2.$suggestSolution        = "PRG1_PRU0_GPO13";
enet_icss1.PRU_ICSSG1_RGMII2.TD3.$suggestSolution        = "PRG1_PRU0_GPO14";
enet_icss1.PRU_ICSSG1_RGMII2.TXC.$suggestSolution        = "PRG1_PRU0_GPO16";
enet_icss1.PRU_ICSSG1_RGMII2.TX_CTL.$suggestSolution     = "PRG1_PRU0_GPO15";
