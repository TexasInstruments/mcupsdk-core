/**
 * @cliArgs --device "AM64x" --package "ALV" --part "Default" --context "r5fss0-0" --product "MCU_PLUS_SDK@07.03.01"
 * @versions {"tool":"1.18.0+3266"}
 */

/**
 * Import the modules used in this configuration.
 */
const eeprom     = scripting.addModule("/board/eeprom/eeprom", {}, false);
const eeprom1    = eeprom.addInstance();
const gpio       = scripting.addModule("/drivers/gpio/gpio", {}, false);
const gpio1      = gpio.addInstance();
const i2c        = scripting.addModule("/drivers/i2c/i2c", {}, false);
const i2c1       = i2c.addInstance();
const i2c2       = i2c.addInstance();
const debug_log  = scripting.addModule("/kernel/dpl/debug_log");
const dpl_cfg = scripting.addModule("/kernel/dpl/dpl_cfg");
const mpu_armv7  = scripting.addModule("/kernel/dpl/mpu_armv7", {}, false);
const mpu_armv71 = mpu_armv7.addInstance();
const mpu_armv72 = mpu_armv7.addInstance();
const mpu_armv73 = mpu_armv7.addInstance();
const mpu_armv74 = mpu_armv7.addInstance();
const mpu_armv75 = mpu_armv7.addInstance();
const mpu_armv76 = mpu_armv7.addInstance();
const mpu_armv77 = mpu_armv7.addInstance();
const enet_cpsw  = scripting.addModule("/networking/enet_cpsw/enet_cpsw", {}, false);
const enet_cpsw1 = enet_cpsw.addInstance();

/**
 * Write custom configuration values to the imported modules.
 */
eeprom1.$name      = "CONFIG_EEPROM0";
eeprom1.i2cAddress = 0x51;

gpio1.$name                    = "CONFIG_GPIO0";
gpio1.pinDir                   = "OUTPUT";
gpio1.useMcuDomainPeripherals  = true;
gpio1.MCU_GPIO.$assign         = "MCU_GPIO0";
gpio1.MCU_GPIO.gpioPin.$assign = "MCU_SPI1_CS0";

i2c1.$name               = "CONFIG_I2C0";
eeprom1.peripheralDriver = i2c1;
i2c1.I2C.$assign         = "I2C0";
i2c1.I2C.SCL.$assign     = "I2C0_SCL";
i2c1.I2C.SDA.$assign     = "I2C0_SDA";

i2c2.$name           = "CONFIG_I2C1";
i2c2.I2C.$assign     = "I2C1";
i2c2.I2C.SCL.$assign = "I2C1_SCL";
i2c2.I2C.SDA.$assign = "I2C1_SDA";

debug_log.enableUartLog = true;
debug_log.enableCssLog  = false;
debug_log.uartLog.$name = "CONFIG_UART0";

const uart_v0_template  = scripting.addModule("/drivers/uart/v0/uart_v0_template", {}, false);
const uart_v0_template1 = uart_v0_template.addInstance({}, false);
uart_v0_template1.$name = "drivers_uart_v0_uart_v0_template0";
debug_log.uartLog.child = uart_v0_template1;

mpu_armv71.$name             = "CONFIG_MPU_REGION0";
mpu_armv71.size              = 31;
mpu_armv71.attributes        = "Device";
mpu_armv71.accessPermissions = "Supervisor RD+WR, User RD";
mpu_armv71.allowExecute      = false;

mpu_armv72.$name             = "CONFIG_MPU_REGION1";
mpu_armv72.size              = 15;
mpu_armv72.accessPermissions = "Supervisor RD+WR, User RD";

mpu_armv73.$name             = "CONFIG_MPU_REGION2";
mpu_armv73.baseAddr          = 0x41010000;
mpu_armv73.size              = 15;
mpu_armv73.accessPermissions = "Supervisor RD+WR, User RD";

mpu_armv74.$name             = "CONFIG_MPU_REGION3";
mpu_armv74.accessPermissions = "Supervisor RD+WR, User RD";
mpu_armv74.baseAddr          = 0x70000000;
mpu_armv74.size              = 23;

mpu_armv75.$name             = "CONFIG_MPU_REGION4";
mpu_armv75.accessPermissions = "Supervisor RD+WR, User RD";
mpu_armv75.baseAddr          = 0x80000000;
mpu_armv75.size              = 31;

mpu_armv76.$name             = "CONFIG_MPU_REGION5";
mpu_armv76.accessPermissions = "Supervisor RD+WR, User RD";
mpu_armv76.baseAddr          = 0xA5000000;
mpu_armv76.size              = 23;
mpu_armv76.attributes        = "NonCached";

mpu_armv77.$name    = "CONFIG_MPU_REGION6";
mpu_armv77.size     = 27;
mpu_armv77.baseAddr = 0x60000000;

enet_cpsw1.$name                              = "CONFIG_ENET_CPSW0";
enet_cpsw1.mdioMode                           = "MDIO_MODE_MANUAL";
enet_cpsw1.phyAddr2                           = 1;
enet_cpsw1.LargePoolPktCount                   = 50;
enet_cpsw1.txDmaChannel.create(3);
enet_cpsw1.txDmaChannel[0].$name               = "ENET_DMA_TX_CH0";
enet_cpsw1.txDmaChannel[0].PacketsCount        = 1;
enet_cpsw1.txDmaChannel[0].useGlobalEvt        = true;
enet_cpsw1.txDmaChannel[1].$name               = "ENET_DMA_TX_CH_PTP";
enet_cpsw1.txDmaChannel[1].PacketsCount        = 2;
enet_cpsw1.txDmaChannel[1].useGlobalEvt        = true;
enet_cpsw1.txDmaChannel[2].$name               = "ENET_DMA_TX_CH_AVTP";
enet_cpsw1.txDmaChannel[2].useGlobalEvt        = true;
enet_cpsw1.txDmaChannel[2].PacketsCount        = 4;
enet_cpsw1.rxDmaChannel.create(3);
enet_cpsw1.rxDmaChannel[0].$name               = "ENET_DMA_RX_CH0";
enet_cpsw1.rxDmaChannel[0].PacketsCount        = 1;
enet_cpsw1.rxDmaChannel[0].useGlobalEvt        = true;
enet_cpsw1.rxDmaChannel[0].sizeThreshEn        = 0x0;
enet_cpsw1.rxDmaChannel[1].$name               = "ENET_DMA_RX_CH_PTP";
enet_cpsw1.rxDmaChannel[1].PacketsCount        = 2;
enet_cpsw1.rxDmaChannel[1].useDefaultFlow      = false;
enet_cpsw1.rxDmaChannel[1].useGlobalEvt        = true;
enet_cpsw1.rxDmaChannel[1].macAddrCount        = 0;
enet_cpsw1.rxDmaChannel[1].sizeThreshEn        = 0x0;
enet_cpsw1.rxDmaChannel[2].$name               = "ENET_DMA_RX_CH_AVTP";
enet_cpsw1.rxDmaChannel[2].useDefaultFlow      = false;
enet_cpsw1.rxDmaChannel[2].useGlobalEvt        = true;
enet_cpsw1.rxDmaChannel[2].macAddrCount        = 0;
enet_cpsw1.rxDmaChannel[2].sizeThreshEn        = 0x0;
enet_cpsw1.rxDmaChannel[2].PacketsCount        = 40;
enet_cpsw1.$name                    = "CONFIG_ENET_CPSW0";
enet_cpsw1.MDIO.$assign             = "MDIO0";
enet_cpsw1.MDIO.MDC.$assign         = "PRG0_PRU1_GPO19";
enet_cpsw1.MDIO.MDIO.$assign        = "PRG0_PRU1_GPO18";
enet_cpsw1.RGMII.$assign            = "CPSW";
enet_cpsw1.RGMII.RGMII1_RD0.$assign = "PRG1_PRU1_GPO5";

const udma         = scripting.addModule("/drivers/udma/udma", {}, false);
const udma1        = udma.addInstance({}, false);
enet_cpsw1.udmaDrv = udma1;

/**
 * Pinmux solution for unlocked pins/peripherals. This ensures that minor changes to the automatic solver in a future
 * version of the tool will not impact the pinmux you originally saw.  These lines can be completely deleted in order to
 * re-solve from scratch.
 */
debug_log.uartLog.UART.$suggestSolution                   = "USART0";
debug_log.uartLog.UART.RXD.$suggestSolution               = "UART0_RXD";
debug_log.uartLog.UART.TXD.$suggestSolution               = "UART0_TXD";
enet_cpsw1.RGMII.RGMII1_RD1.$suggestSolution    = "PRG1_PRU1_GPO8";
enet_cpsw1.RGMII.RGMII1_RD2.$suggestSolution    = "PRG1_PRU1_GPO18";
enet_cpsw1.RGMII.RGMII1_RD3.$suggestSolution    = "PRG1_PRU1_GPO19";
enet_cpsw1.RGMII.RGMII1_RX_CTL.$suggestSolution = "PRG1_PRU0_GPO5";
enet_cpsw1.RGMII.RGMII1_RXC.$suggestSolution    = "PRG1_PRU0_GPO8";
enet_cpsw1.RGMII.RGMII1_TD0.$suggestSolution    = "PRG1_PRU1_GPO7";
enet_cpsw1.RGMII.RGMII1_TD1.$suggestSolution    = "PRG1_PRU1_GPO9";
enet_cpsw1.RGMII.RGMII1_TD2.$suggestSolution    = "PRG1_PRU1_GPO10";
enet_cpsw1.RGMII.RGMII1_TD3.$suggestSolution    = "PRG1_PRU1_GPO17";
enet_cpsw1.RGMII.RGMII1_TX_CTL.$suggestSolution = "PRG1_PRU0_GPO9";
enet_cpsw1.RGMII.RGMII1_TXC.$suggestSolution    = "PRG1_PRU0_GPO10";
enet_cpsw1.RGMII.RGMII2_RD0.$suggestSolution    = "PRG1_PRU1_GPO0";
enet_cpsw1.RGMII.RGMII2_RD1.$suggestSolution    = "PRG1_PRU1_GPO1";
enet_cpsw1.RGMII.RGMII2_RD2.$suggestSolution    = "PRG1_PRU1_GPO2";
enet_cpsw1.RGMII.RGMII2_RD3.$suggestSolution    = "PRG1_PRU1_GPO3";
enet_cpsw1.RGMII.RGMII2_RX_CTL.$suggestSolution = "PRG1_PRU1_GPO4";
enet_cpsw1.RGMII.RGMII2_RXC.$suggestSolution    = "PRG1_PRU1_GPO6";
enet_cpsw1.RGMII.RGMII2_TD0.$suggestSolution    = "PRG1_PRU1_GPO11";
enet_cpsw1.RGMII.RGMII2_TD1.$suggestSolution    = "PRG1_PRU1_GPO12";
enet_cpsw1.RGMII.RGMII2_TD2.$suggestSolution    = "PRG1_PRU1_GPO13";
enet_cpsw1.RGMII.RGMII2_TD3.$suggestSolution    = "PRG1_PRU1_GPO14";
enet_cpsw1.RGMII.RGMII2_TX_CTL.$suggestSolution = "PRG1_PRU1_GPO15";
enet_cpsw1.RGMII.RGMII2_TXC.$suggestSolution    = "PRG1_PRU1_GPO16";
