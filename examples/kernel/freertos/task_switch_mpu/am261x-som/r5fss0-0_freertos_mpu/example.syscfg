/**
 * @cliArgs --device "AM261x_ZCZ" --package "ZCZ" --part "AM2611" --context "r5fss0-0" --product "MCU_PLUS_SDK@07.03.01"
 * @versions {"tool":"1.18.0+3266"}
 */

/**
 * Import the modules used in this configuration.
 */
const debug_log       = scripting.addModule("/kernel/dpl/debug_log");
const dpl_cfg = scripting.addModule("/kernel/dpl/dpl_cfg");
const mpu_armv7       = scripting.addModule("/kernel/dpl/mpu_armv7", {}, false);
const mpu_armv71      = mpu_armv7.addInstance();
const mpu_armv72      = mpu_armv7.addInstance();
const mpu_armv73      = mpu_armv7.addInstance();
const mpu_armv74      = mpu_armv7.addInstance();
const mpu_armv75      = mpu_armv7.addInstance();
const mpu_armv76      = mpu_armv7.addInstance();
const mpu_armv77      = mpu_armv7.addInstance();
const default_linker  = scripting.addModule("/memory_configurator/default_linker", {}, false);
const default_linker1 = default_linker.addInstance();
const general         = scripting.addModule("/memory_configurator/general", {}, false);
const general1        = general.addInstance();
const region          = scripting.addModule("/memory_configurator/region", {}, false);
const region1         = region.addInstance();
const section         = scripting.addModule("/memory_configurator/section", {}, false);
const section1        = section.addInstance();
const section2        = section.addInstance();
const section3        = section.addInstance();
const section4        = section.addInstance();
const section5        = section.addInstance();
const section6        = section.addInstance();
const section7        = section.addInstance();
const section8        = section.addInstance();
const section9        = section.addInstance();
const section10       = section.addInstance();
const section11       = section.addInstance();
const section12       = section.addInstance();
const section13       = section.addInstance();
const section14       = section.addInstance();
const section15       = section.addInstance();
const section16       = section.addInstance();
const section17       = section.addInstance();
const section18       = section.addInstance();

/**
 * Write custom configuration values to the imported modules.
 */
debug_log.enableUartLog            = true;
debug_log.uartLog.$name            = "CONFIG_UART0";
debug_log.uartLog.UART.$assign     = "UART0";
debug_log.uartLog.UART.RXD.$assign = "GPIO27";
debug_log.uartLog.UART.TXD.$assign = "GPIO28";
debug_log.uartLog.child.$name      = "drivers_uart_v2_uart_v2_template0";

mpu_armv71.size         = 31;
mpu_armv71.attributes   = "Device";
mpu_armv71.allowExecute = false;
mpu_armv71.$name        = "BACKGROUND_REGION_2GB";

mpu_armv72.size              = 15;
mpu_armv72.$name             = "ATCM_32KB";
mpu_armv72.accessPermissions = "Supervisor RD+WR, User BLOCK";

mpu_armv73.size              = 15;
mpu_armv73.baseAddr          = 0x80000;
mpu_armv73.$name             = "BTCM_32KB";
mpu_armv73.accessPermissions = "Supervisor RD+WR, User BLOCK";

mpu_armv74.baseAddr          = 0x70000000;
mpu_armv74.size              = 21;
mpu_armv74.allowExecute      = false;
mpu_armv74.accessPermissions = "Supervisor RD+WR, User BLOCK";
mpu_armv74.$name             = "OCRAM_BACKGROUND_2MB";

mpu_armv75.$name    = "OCRAM_UNPRIVILEGED_128KB";
mpu_armv75.baseAddr = 0x70040000;
mpu_armv75.size     = 17;

mpu_armv76.size              = 16;
mpu_armv76.accessPermissions = "Supervisor RD, User BLOCK";
mpu_armv76.$name             = "OCRAM_PRIVILEGED_TEXT_64KB";
mpu_armv76.baseAddr          = 0x70060000;

mpu_armv77.$name             = "FLASH_512KB";
mpu_armv77.baseAddr          = 0x60100000;
mpu_armv77.size              = 19;
mpu_armv77.accessPermissions = "Supervisor RD, User BLOCK";

default_linker1.$name = "memory_configurator_default_linker0";

general1.$name        = "CONFIG_GENERAL0";
general1.stack_size   = 4096;
general1.heap_size    = 4096;
general1.linker.$name = "TIARMCLANG0";

region1.$name                                = "MEMORY_REGION_CONFIGURATION0";
region1.memory_region.create(17);
region1.memory_region[0].type                = "TCMA";
region1.memory_region[0].$name               = "R5F_VECS";
region1.memory_region[0].size                = 0x40;
region1.memory_region[0].auto                = false;
region1.memory_region[1].type                = "TCMA";
region1.memory_region[1].$name               = "R5F_TCMA";
region1.memory_region[1].size                = 0x7FC0;
region1.memory_region[2].type                = "TCMB";
region1.memory_region[2].size                = 0x8000;
region1.memory_region[2].$name               = "R5F_TCMB";
region1.memory_region[3].$name               = "SBL";
region1.memory_region[3].auto                = false;
region1.memory_region[3].size                = 0x40000;
region1.memory_region[4].$name               = "OCRAM";
region1.memory_region[4].auto                = false;
region1.memory_region[4].manualStartAddress  = 0x70040000;
region1.memory_region[4].size                = 0x20000;
region1.memory_region[5].type                = "FLASH";
region1.memory_region[5].auto                = false;
region1.memory_region[5].manualStartAddress  = 0x60100000;
region1.memory_region[5].size                = 0x80000;
region1.memory_region[5].$name               = "FLASH";
region1.memory_region[6].$name               = "USER_SHM_MEM";
region1.memory_region[6].auto                = false;
region1.memory_region[6].manualStartAddress  = 0x70150000; 
region1.memory_region[6].size                = 0x4000;
region1.memory_region[6].isShared            = true;
region1.memory_region[6].shared_cores        = ["r5fss0-1"];
region1.memory_region[7].$name               = "LOG_SHM_MEM";
region1.memory_region[7].auto                = false;
region1.memory_region[7].manualStartAddress  = 0x70154000; 
region1.memory_region[7].size                = 0x4000;
region1.memory_region[7].isShared            = true;
region1.memory_region[7].shared_cores        = ["r5fss0-1"];
region1.memory_region[8].type                = "CUSTOM";
region1.memory_region[8].$name               = "RTOS_NORTOS_IPC_SHM_MEM";
region1.memory_region[8].auto                = false;
region1.memory_region[8].manualStartAddress  = 0x72000000;
region1.memory_region[8].size                = 0x3E80;
region1.memory_region[8].isShared            = true;
region1.memory_region[8].shared_cores        = ["r5fss0-1"];
region1.memory_region[9].type                = "CUSTOM";
region1.memory_region[9].$name               = "MAILBOX_HSM";
region1.memory_region[9].auto                = false;
region1.memory_region[9].manualStartAddress  = 0x44000000;
region1.memory_region[9].size                = 0x3CE;
region1.memory_region[9].isShared            = true;
region1.memory_region[9].shared_cores        = ["r5fss0-1"];
region1.memory_region[10].type               = "CUSTOM";
region1.memory_region[10].$name              = "MAILBOX_R5F";
region1.memory_region[10].auto               = false;
region1.memory_region[10].manualStartAddress = 0x44000400;
region1.memory_region[10].size               = 0x3CE;
region1.memory_region[10].isShared           = true;
region1.memory_region[10].shared_cores       = ["r5fss0-1"];
region1.memory_region[11].$name              = "PRIVILEGED_TEXT";
region1.memory_region[11].auto               = false;
region1.memory_region[11].size               = 0x10000;
region1.memory_region[11].manualStartAddress = 0x70060000;
region1.memory_region[12].$name              = "PRIVILEGED_DATA";
region1.memory_region[12].auto               = false;
region1.memory_region[12].manualStartAddress = 0x70070000;
region1.memory_region[12].size               = 0xE000;
region1.memory_region[13].auto               = false;
region1.memory_region[13].$name              = "PING_TEXT";
region1.memory_region[13].size               = 0x800;
region1.memory_region[13].manualStartAddress = 0x7007E000;
region1.memory_region[14].auto               = false;
region1.memory_region[14].$name              = "PING_DATA";
region1.memory_region[14].size               = 0x800;
region1.memory_region[14].manualStartAddress = 0x7007E800;
region1.memory_region[15].$name              = "PONG_TEXT";
region1.memory_region[15].auto               = false;
region1.memory_region[15].size               = 0x800;
region1.memory_region[15].manualStartAddress = 0x7007F000;
region1.memory_region[16].$name              = "PONG_DATA";
region1.memory_region[16].auto               = false;
region1.memory_region[16].size               = 0x800;
region1.memory_region[16].manualStartAddress = 0x7007F800;

section1.load_memory                  = "R5F_VECS";
section1.group                        = false;
section1.$name                        = "Vector Table";
section1.output_section.create(1);
section1.output_section[0].$name      = ".vectors";
section1.output_section[0].palignment = true;

section2.load_memory                  = "OCRAM";
section2.$name                        = "Text Segments";
section2.output_section.create(5);
section2.output_section[0].$name      = ".text.hwi";
section2.output_section[0].palignment = true;
section2.output_section[1].$name      = ".text.cache";
section2.output_section[1].palignment = true;
section2.output_section[2].$name      = ".text.mpu";
section2.output_section[2].palignment = true;
section2.output_section[3].$name      = ".text.boot";
section2.output_section[3].palignment = true;
section2.output_section[4].$name      = ".text:abort";
section2.output_section[4].palignment = true;

section3.load_memory                              = "OCRAM";
section3.$name                                    = "Code and Read-Only Data";
section3.output_section.create(3);
section3.output_section[0].$name                  = ".text";
section3.output_section[0].palignment             = true;
section3.output_section[1].$name                  = ".rodata";
section3.output_section[1].palignment             = true;
section3.output_section[2].$name                  = ".freertos_system_calls";
section3.output_section[2].output_sections_start  = "__syscalls_flash_start__";
section3.output_section[2].output_sections_end    = "__syscalls_flash_end__";
section3.output_section[2].palignment             = true;
section3.output_section[2].input_section.create(1);
section3.output_section[2].input_section[0].$name = "*(freertos_system_calls)";

section4.load_memory                  = "OCRAM";
section4.$name                        = "Data Segment";
section4.output_section.create(1);
section4.output_section[0].$name      = ".data";
section4.output_section[0].palignment = true;

section5.load_memory                             = "OCRAM";
section5.$name                                   = "Memory Segments";
section5.output_section.create(3);
section5.output_section[0].$name                 = ".bss";
section5.output_section[0].output_sections_start = "__BSS_START";
section5.output_section[0].output_sections_end   = "__BSS_END";
section5.output_section[0].palignment            = true;
section5.output_section[1].$name                 = ".sysmem";
section5.output_section[1].palignment            = true;
section5.output_section[2].$name                 = ".stack";
section5.output_section[2].palignment            = true;

section6.load_memory                              = "PRIVILEGED_DATA";
section6.group_start                              = "__privileged_stacks_start__";
section6.group_end                                = "__privileged_stacks_end__";
section6.$name                                    = "Privileged Stack Segments";
section6.output_section.create(5);
section6.output_section[0].$name                  = ".irqstack";
section6.output_section[0].output_sections_start  = "__IRQ_STACK_START";
section6.output_section[0].output_sections_end    = "__IRQ_STACK_END";
section6.output_section[0].input_section.create(1);
section6.output_section[0].input_section[0].$name = ". = . + __IRQ_STACK_SIZE;";
section6.output_section[1].$name                  = ".fiqstack";
section6.output_section[1].output_sections_start  = "__FIQ_STACK_START";
section6.output_section[1].output_sections_end    = "__FIQ_STACK_END";
section6.output_section[1].input_section.create(1);
section6.output_section[1].input_section[0].$name = ". = . + __FIQ_STACK_SIZE;";
section6.output_section[2].$name                  = ".svcstack";
section6.output_section[2].output_sections_start  = "__SVC_STACK_START";
section6.output_section[2].output_sections_end    = "__SVC_STACK_END";
section6.output_section[2].input_section.create(1);
section6.output_section[2].input_section[0].$name = ". = . + __SVC_STACK_SIZE;";
section6.output_section[3].$name                  = ".abortstack";
section6.output_section[3].output_sections_start  = "__ABORT_STACK_START";
section6.output_section[3].output_sections_end    = "__ABORT_STACK_END";
section6.output_section[3].input_section.create(1);
section6.output_section[3].input_section[0].$name = ". = . + __ABORT_STACK_SIZE;";
section6.output_section[4].$name                  = ".undefinedstack";
section6.output_section[4].output_sections_start  = "__UNDEFINED_STACK_START";
section6.output_section[4].output_sections_end    = "__UNDEFINED_STACK_END";
section6.output_section[4].input_section.create(1);
section6.output_section[4].input_section[0].$name = ". = . + __UNDEFINED_STACK_SIZE;";

section7.load_memory                  = "OCRAM";
section7.$name                        = "Initialization and Exception Handling";
section7.output_section.create(3);
section7.output_section[0].$name      = ".ARM.exidx";
section7.output_section[0].palignment = true;
section7.output_section[1].$name      = ".init_array";
section7.output_section[1].palignment = true;
section7.output_section[2].$name      = ".fini_array";
section7.output_section[2].palignment = true;

section8.load_memory                 = "USER_SHM_MEM";
section8.type                        = "NOLOAD";
section8.$name                       = "User Shared Memory";
section8.group                       = false;
section8.output_section.create(1);
section8.output_section[0].$name     = ".bss.user_shared_mem";
section8.output_section[0].alignment = 0;

section9.load_memory                 = "LOG_SHM_MEM";
section9.$name                       = "Log Shared Memory";
section9.group                       = false;
section9.type                        = "NOLOAD";
section9.output_section.create(1);
section9.output_section[0].$name     = ".bss.log_shared_mem";
section9.output_section[0].alignment = 0;

section10.load_memory                 = "RTOS_NORTOS_IPC_SHM_MEM";
section10.type                        = "NOLOAD";
section10.$name                       = "IPC Shared Memory";
section10.group                       = false;
section10.output_section.create(1);
section10.output_section[0].$name     = ".bss.ipc_vring_mem";
section10.output_section[0].alignment = 0;

section11.load_memory                 = "MAILBOX_HSM";
section11.type                        = "NOLOAD";
section11.$name                       = "SIPC HSM Queue Memory";
section11.group                       = false;
section11.output_section.create(1);
section11.output_section[0].$name     = ".bss.sipc_hsm_queue_mem";
section11.output_section[0].alignment = 0;

section12.load_memory                 = "MAILBOX_R5F";
section12.$name                       = "SIPC R5F Queue Memory";
section12.group                       = false;
section12.type                        = "NOLOAD";
section12.output_section.create(1);
section12.output_section[0].$name     = ".bss.sipc_secure_host_queue_mem";
section12.output_section[0].alignment = 0;

section13.load_memory                              = "PRIVILEGED_TEXT";
section13.$name                                    = "Privileged Text Segments";
section13.group_start                              = "__privileged_text_start__";
section13.group_end                                = "__privileged_text_end__";
section13.output_section.create(2);
section13.output_section[0].$name                  = ".privileged_functions";
section13.output_section[0].palignment             = true;
section13.output_section[0].input_section.create(1);
section13.output_section[0].input_section[0].$name = "*(privileged_functions)";
section13.output_section[1].$name                  = ".text.task_switch_mpu.privileged";
section13.output_section[1].palignment             = true;
section13.output_section[1].input_section.create(1);
section13.output_section[1].input_section[0].$name = "task_switch_mpu.o*(.text)";

section14.$name                                    = "Privileged Data Segments";
section14.load_memory                              = "PRIVILEGED_DATA";
section14.group_start                              = "__privileged_data_start__";
section14.group_end                                = "__privileged_data_end__";
section14.output_section.create(2);
section14.output_section[0].$name                  = ".privileged_data";
section14.output_section[0].palignment             = true;
section14.output_section[0].input_section.create(1);
section14.output_section[0].input_section[0].$name = "*(privileged_data)";
section14.output_section[1].$name                  = ".data.task_switch_mpu.privileged";
section14.output_section[1].palignment             = true;
section14.output_section[1].input_section.create(1);
section14.output_section[1].input_section[0].$name = "task_switch_mpu.o*(.data, .bss)";

section15.load_memory                              = "PING_TEXT";
section15.$name                                    = "Ping Task Text Sections ";
section15.group_start                              = "__TEXT_PING_START";
section15.group_end                                = "__TEXT_PING_END";
section15.output_section.create(1);
section15.output_section[0].$name                  = ".text.task_switch_mpu.ping";
section15.output_section[0].macro_name             = "TEXTTASK_SWITCH_MPUPING_SECTION";
section15.output_section[0].palignment             = true;
section15.output_section[0].input_section.create(1);
section15.output_section[0].input_section[0].$name = "task_switch_mpu_ping.o*(.text)";

section16.group_start                              = "__DATA_PING_START";
section16.group_end                                = "__DATA_PING_END";
section16.load_memory                              = "PING_DATA";
section16.$name                                    = "Ping Task Data Sections ";
section16.output_section.create(1);
section16.output_section[0].$name                  = ".data.task_switch_mpu.ping";
section16.output_section[0].palignment             = true;
section16.output_section[0].input_section.create(1);
section16.output_section[0].input_section[0].$name = "task_switch_mpu_ping.o*(.data, .bss)";

section17.$name                                    = "Pong Task Text Sections";
section17.group_start                              = "__TEXT_PONG_START";
section17.group_end                                = "__TEXT_PONG_END";
section17.load_memory                              = "PONG_TEXT";
section17.output_section.create(1);
section17.output_section[0].macro_name             = "TEXTTASK_SWITCH_MPUPING_SECTION";
section17.output_section[0].palignment             = true;
section17.output_section[0].$name                  = ".text.task_switch_mpu.pong";
section17.output_section[0].input_section.create(1);
section17.output_section[0].input_section[0].$name = "task_switch_mpu_pong.o*(.text)";

section18.group_start                              = "__DATA_PONG_START";
section18.group_end                                = "__DATA_PONG_END";
section18.load_memory                              = "PONG_DATA";
section18.$name                                    = "Pong Task Data Sections";
section18.output_section.create(1);
section18.output_section[0].palignment             = true;
section18.output_section[0].$name                  = ".data.task_switch_mpu.pong";
section18.output_section[0].input_section.create(1);
section18.output_section[0].input_section[0].$name = "task_switch_mpu_pong.o*(.data, .bss)";
