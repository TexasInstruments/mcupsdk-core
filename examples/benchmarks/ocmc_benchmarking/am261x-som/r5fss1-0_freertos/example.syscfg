/**
 * @cliArgs --device "AM261x_ZCZ" --package "ZCZ" --part "AM2611" --context "r5fss1-0" --product "MCU_PLUS_SDK@07.03.01"
 * @versions {"tool":"1.20.0+3587"}
 */

/**
 * Import the modules used in this configuration.
 */
const debug_log       = scripting.addModule("/kernel/dpl/debug_log");
const dpl_cfg = scripting.addModule("/kernel/dpl/dpl_cfg");
const mpu_armv7       = scripting.addModule("/kernel/dpl/mpu_armv7", {}, false);
const mpu_armv71      = mpu_armv7.addInstance();
const mpu_armv72      = mpu_armv7.addInstance();
const mpu_armv73      = mpu_armv7.addInstance();
const mpu_armv74      = mpu_armv7.addInstance();
const mpu_armv75      = mpu_armv7.addInstance();
const mpu_armv76      = mpu_armv7.addInstance();
const mpu_armv77      = mpu_armv7.addInstance();
const default_linker  = scripting.addModule("/memory_configurator/default_linker", {}, false);
const default_linker1 = default_linker.addInstance();
const general         = scripting.addModule("/memory_configurator/general", {}, false);
const general1        = general.addInstance();
const region          = scripting.addModule("/memory_configurator/region", {}, false);
const region1         = region.addInstance();
const section         = scripting.addModule("/memory_configurator/section", {}, false);
const section1        = section.addInstance();
const section2        = section.addInstance();
const section3        = section.addInstance();
const section4        = section.addInstance();
const section5        = section.addInstance();
const section6        = section.addInstance();
const section7        = section.addInstance();
const section8        = section.addInstance();
const section9        = section.addInstance();
const section10       = section.addInstance();
const section11       = section.addInstance();

/**
 * Write custom configuration values to the imported modules.
 */
mpu_armv71.$name             = "CONFIG_MPU_REGION0";
mpu_armv71.size              = 31;
mpu_armv71.attributes        = "Device";
mpu_armv71.accessPermissions = "Supervisor RD+WR, User RD";
mpu_armv71.allowExecute      = false;

mpu_armv72.$name             = "CONFIG_MPU_REGION1";
mpu_armv72.size              = 15;
mpu_armv72.accessPermissions = "Supervisor RD+WR, User RD";

mpu_armv73.$name             = "CONFIG_MPU_REGION2";
mpu_armv73.baseAddr          = 0x80000;
mpu_armv73.size              = 15;
mpu_armv73.accessPermissions = "Supervisor RD+WR, User RD";

mpu_armv74.$name             = "CONFIG_MPU_REGION3";
mpu_armv74.accessPermissions = "Supervisor RD+WR, User RD";
mpu_armv74.baseAddr          = 0x70000000;
mpu_armv74.size              = 22;

mpu_armv75.$name        = "CONFIG_MPU_REGION4";
mpu_armv75.baseAddr     = 0x50D00000;
mpu_armv75.size         = 14;
mpu_armv75.allowExecute = false;
mpu_armv75.attributes   = "Device";

mpu_armv76.$name        = "CONFIG_MPU_REGION5";
mpu_armv76.baseAddr     = 0x72000000;
mpu_armv76.size         = 14;
mpu_armv76.allowExecute = false;
mpu_armv76.attributes   = "NonCached";

mpu_armv77.$name    = "CONFIG_MPU_REGION6";
mpu_armv77.baseAddr = 0x60000000;
mpu_armv77.size     = 27;

default_linker1.$name = "memory_configurator_default_linker0";

general1.$name          = "CONFIG_GENERAL0";
general1.heap_size      = 16384;
general1.irq_stack_size = 1024;
general1.svc_stack_size = 1024;
general1.linker.$name   = "TIARMCLANG0";

region1.$name                               = "MEMORY_REGION_CONFIGURATION0";
region1.memory_region.create(6);
region1.memory_region[0].type               = "TCMA";
region1.memory_region[0].$name              = "R5F_VECS";
region1.memory_region[0].size               = 0x40;
region1.memory_region[0].auto               = false;
region1.memory_region[1].type               = "TCMA";
region1.memory_region[1].$name              = "R5F_TCMA";
region1.memory_region[1].size               = 0x7FC0;
region1.memory_region[2].type               = "TCMB";
region1.memory_region[2].size               = 0x8000;
region1.memory_region[2].$name              = "R5F_TCMB";
region1.memory_region[3].$name              = "MSRAM_STACK";
region1.memory_region[3].auto               = false;
region1.memory_region[3].manualStartAddress = 0x70020000;
region1.memory_region[3].size               = 0x10000;
region1.memory_region[4].$name              = "MSRAM";
region1.memory_region[4].size               = 0xEAAAA;
region1.memory_region[5].type               = "FLASH";
region1.memory_region[5].$name              = "FLASH";
region1.memory_region[5].size               = 0x200000;

section1.load_memory                  = "R5F_VECS";
section1.group                        = false;
section1.$name                        = "Vector Table";
section1.output_section.create(1);
section1.output_section[0].$name      = ".vectors";
section1.output_section[0].palignment = true;

section2.$name                                    = "Text Segments";
section2.load_memory                              = "MSRAM";
section2.output_section.create(7);
section2.output_section[0].$name                  = ".text.hwi";
section2.output_section[0].palignment             = true;
section2.output_section[1].$name                  = ".text.cache";
section2.output_section[1].palignment             = true;
section2.output_section[2].$name                  = ".text.mpu";
section2.output_section[2].palignment             = true;
section2.output_section[3].$name                  = ".text.boot";
section2.output_section[3].palignment             = true;
section2.output_section[4].palignment             = true;
section2.output_section[4].$name                  = ".text.main";
section2.output_section[5].$name                  = ".rodata.cfg";
section2.output_section[5].palignment             = true;
section2.output_section[6].palignment             = true;
section2.output_section[6].$name                  = "cio";
section2.output_section[6].input_section.create(1);
section2.output_section[6].input_section[0].$name = "-llibsysbm.a<trgmsg.c.obj> (.text)";

section3.$name                         = "Code and Read-Only Data";
section3.load_memory                   = "FLASH";
section3.output_section.create(18);
section3.output_section[0].$name       = ".text";
section3.output_section[0].palignment  = true;
section3.output_section[1].$name       = ".rodata";
section3.output_section[1].palignment  = true;
section3.output_section[2].$name       = ".task_0";
section3.output_section[2].palignment  = true;
section3.output_section[3].$name       = ".task_1";
section3.output_section[3].palignment  = true;
section3.output_section[4].$name       = ".task_2";
section3.output_section[4].palignment  = true;
section3.output_section[5].$name       = ".task_3";
section3.output_section[5].palignment  = true;
section3.output_section[6].$name       = ".task_4";
section3.output_section[6].palignment  = true;
section3.output_section[7].$name       = ".task_5";
section3.output_section[7].palignment  = true;
section3.output_section[8].$name       = ".task_6";
section3.output_section[8].palignment  = true;
section3.output_section[9].$name       = ".task_7";
section3.output_section[9].palignment  = true;
section3.output_section[10].$name      = ".task_8";
section3.output_section[10].palignment = true;
section3.output_section[11].$name      = ".task_9";
section3.output_section[11].palignment = true;
section3.output_section[12].$name      = ".task_10";
section3.output_section[12].palignment = true;
section3.output_section[13].$name      = ".task_11";
section3.output_section[13].palignment = true;
section3.output_section[14].$name      = ".task_12";
section3.output_section[14].palignment = true;
section3.output_section[15].$name      = ".task_13";
section3.output_section[15].palignment = true;
section3.output_section[16].$name      = ".task_14";
section3.output_section[16].palignment = true;
section3.output_section[17].$name      = ".task_15";
section3.output_section[17].palignment = true;

section4.$name                         = "Data Segment";
section4.load_memory                   = "MSRAM";
section4.output_section.create(18);
section4.output_section[0].$name       = ".data";
section4.output_section[0].palignment  = true;
section4.output_section[1].$name       = ".buf_0";
section4.output_section[1].palignment  = true;
section4.output_section[2].$name       = ".buf_1";
section4.output_section[2].palignment  = true;
section4.output_section[3].$name       = ".buf_2";
section4.output_section[3].palignment  = true;
section4.output_section[4].$name       = ".buf_3";
section4.output_section[4].palignment  = true;
section4.output_section[5].$name       = ".buf_4";
section4.output_section[5].palignment  = true;
section4.output_section[6].$name       = ".buf_5";
section4.output_section[6].palignment  = true;
section4.output_section[7].$name       = ".buf_6";
section4.output_section[7].palignment  = true;
section4.output_section[8].$name       = ".buf_7";
section4.output_section[9].$name       = ".buf_8";
section4.output_section[9].palignment  = true;
section4.output_section[10].$name      = ".buf_9";
section4.output_section[10].palignment = true;
section4.output_section[11].$name      = ".buf_10";
section4.output_section[11].palignment = true;
section4.output_section[12].$name      = ".buf_11";
section4.output_section[13].$name      = ".buf_12";
section4.output_section[13].palignment = true;
section4.output_section[14].$name      = ".buf_13";
section4.output_section[14].palignment = true;
section4.output_section[15].$name      = ".buf_14";
section4.output_section[15].palignment = true;
section4.output_section[16].$name      = ".buf_15";
section4.output_section[16].palignment = true;
section4.output_section[17].$name      = ".buf_cpy";
section4.output_section[17].palignment = true;

section5.$name                        = "Memory Segments";
section5.load_memory                  = "MSRAM_STACK";
section5.output_section.create(2);
section5.output_section[0].$name      = ".sysmem";
section5.output_section[0].palignment = true;
section5.output_section[1].$name      = ".stack";
section5.output_section[1].palignment = true;

section6.$name                                    = "Stack Segments";
section6.load_memory                              = "MSRAM_STACK";
section6.output_section.create(5);
section6.output_section[0].$name                  = ".irqstack";
section6.output_section[0].output_sections_start  = "__IRQ_STACK_START";
section6.output_section[0].output_sections_end    = "__IRQ_STACK_END";
section6.output_section[0].input_section.create(1);
section6.output_section[0].input_section[0].$name = ". = . + __IRQ_STACK_SIZE;";
section6.output_section[1].$name                  = ".fiqstack";
section6.output_section[1].output_sections_start  = "__FIQ_STACK_START";
section6.output_section[1].output_sections_end    = "__FIQ_STACK_END";
section6.output_section[1].input_section.create(1);
section6.output_section[1].input_section[0].$name = ". = . + __FIQ_STACK_SIZE;";
section6.output_section[2].$name                  = ".svcstack";
section6.output_section[2].output_sections_start  = "__SVC_STACK_START";
section6.output_section[2].output_sections_end    = "__SVC_STACK_END";
section6.output_section[2].input_section.create(1);
section6.output_section[2].input_section[0].$name = ". = . + __SVC_STACK_SIZE;";
section6.output_section[3].$name                  = ".abortstack";
section6.output_section[3].output_sections_start  = "__ABORT_STACK_START";
section6.output_section[3].output_sections_end    = "__ABORT_STACK_END";
section6.output_section[3].input_section.create(1);
section6.output_section[3].input_section[0].$name = ". = . + __ABORT_STACK_SIZE;";
section6.output_section[4].$name                  = ".undefinedstack";
section6.output_section[4].output_sections_start  = "__UNDEFINED_STACK_START";
section6.output_section[4].output_sections_end    = "__UNDEFINED_STACK_END";
section6.output_section[4].input_section.create(1);
section6.output_section[4].input_section[0].$name = ". = . + __UNDEFINED_STACK_SIZE;";

section7.$name                        = "Initialization and Exception Handling";
section7.load_memory                  = "MSRAM_STACK";
section7.output_section.create(3);
section7.output_section[0].$name      = ".ARM.exidx";
section7.output_section[0].palignment = true;
section7.output_section[1].$name      = ".init_array";
section7.output_section[1].palignment = true;
section7.output_section[2].$name      = ".fini_array";
section7.output_section[2].palignment = true;

section8.$name                        = "uninit";
section8.load_memory                  = "MSRAM";
section8.group_start                  = "__BSS_START";
section8.group_end                    = "__BSS_END";
section8.output_section.create(3);
section8.output_section[0].palignment = true;
section8.output_section[0].$name      = ".bss";
section8.output_section[1].$name      = "__llvm_prf_cnts";
section8.output_section[1].palignment = true;
section8.output_section[2].$name      = "__llvm_prf_bits";
section8.output_section[2].palignment = true;

section9.group                         = false;
section9.split_across_memories         = true;
section9.$name                         = "Smart Placement Local ";
section9.output_section.create(1);
section9.output_section[0].$name       = ".TI.local";
section9.output_section[0].palignment  = true;
section9.output_section[0].alignment   = 0;
section9.split_priority.create(4);
section9.split_priority[0].$name       = "Memory Region0";
section9.split_priority[0].load_memory = "R5F_TCMA";
section9.split_priority[1].$name       = "Memory Region1";
section9.split_priority[1].load_memory = "R5F_TCMB";
section9.split_priority[2].$name       = "Memory Region2";
section9.split_priority[2].load_memory = "MSRAM";
section9.split_priority[3].$name       = "Memory Region3";
section9.split_priority[3].load_memory = "FLASH";

section10.group                         = false;
section10.$name                         = "Smart Placement onchip";
section10.split_across_memories         = true;
section10.output_section.create(1);
section10.output_section[0].$name       = ".TI.onchip";
section10.output_section[0].palignment  = true;
section10.split_priority.create(2);
section10.split_priority[0].$name       = "Memory Region4";
section10.split_priority[0].load_memory = "MSRAM";
section10.split_priority[1].$name       = "Memory Region5";
section10.split_priority[1].load_memory = "FLASH";

section11.$name                        = "Smart Placement offchip";
section11.group                        = false;
section11.load_memory                  = "FLASH";
section11.output_section.create(1);
section11.output_section[0].palignment = true;
section11.output_section[0].$name      = ".TI.offchip";
