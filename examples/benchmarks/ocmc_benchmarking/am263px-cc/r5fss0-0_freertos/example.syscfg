/**
 * @cliArgs --device "AM263Px" --package "ZCZ_S" --part "AM263P1" --context "r5fss0-0" --product "MCU_PLUS_SDK@07.03.01"
 * @versions {"tool":"1.17.0+3128"}
 */

/**
 * Import the modules used in this configuration.
 */
const debug_log  = scripting.addModule("/kernel/dpl/debug_log");
const mpu_armv7  = scripting.addModule("/kernel/dpl/mpu_armv7", {}, false);
const mpu_armv71 = mpu_armv7.addInstance();
const mpu_armv72 = mpu_armv7.addInstance();
const mpu_armv73 = mpu_armv7.addInstance();
const mpu_armv74 = mpu_armv7.addInstance();
const mpu_armv75 = mpu_armv7.addInstance();
const mpu_armv76 = mpu_armv7.addInstance();
const mpu_armv77 = mpu_armv7.addInstance();
const general    = scripting.addModule("/memory_configurator/general", {}, false);
const general1   = general.addInstance();
const region     = scripting.addModule("/memory_configurator/region", {}, false);
const region1    = region.addInstance();
const section    = scripting.addModule("/memory_configurator/section", {}, false);
const section1   = section.addInstance();
const section2   = section.addInstance();
const section3   = section.addInstance();
const section4   = section.addInstance();
const section5   = section.addInstance();
const section6   = section.addInstance();
const section7   = section.addInstance();
const section8   = section.addInstance();
const section9   = section.addInstance();
const section10  = section.addInstance();
const section11  = section.addInstance();

/**
 * Write custom configuration values to the imported modules.
 */
debug_log.enableUartLog            = true;
debug_log.uartLog.$name            = "CONFIG_UART0";
debug_log.uartLog.UART.$assign     = "UART0";
debug_log.uartLog.UART.RXD.$assign = "UART0_RXD";
debug_log.uartLog.UART.TXD.$assign = "UART0_TXD";

mpu_armv71.$name             = "CONFIG_MPU_REGION0";
mpu_armv71.size              = 31;
mpu_armv71.attributes        = "Device";
mpu_armv71.accessPermissions = "Supervisor RD+WR, User RD";
mpu_armv71.allowExecute      = false;

mpu_armv72.$name             = "CONFIG_MPU_REGION1";
mpu_armv72.size              = 15;
mpu_armv72.accessPermissions = "Supervisor RD+WR, User RD";

mpu_armv73.$name             = "CONFIG_MPU_REGION2";
mpu_armv73.baseAddr          = 0x80000;
mpu_armv73.size              = 15;
mpu_armv73.accessPermissions = "Supervisor RD+WR, User RD";

mpu_armv74.$name             = "CONFIG_MPU_REGION3";
mpu_armv74.accessPermissions = "Supervisor RD+WR, User RD";
mpu_armv74.baseAddr          = 0x70000000;
mpu_armv74.size              = 21;

mpu_armv75.$name        = "CONFIG_MPU_REGION4";
mpu_armv75.baseAddr     = 0x50D00000;
mpu_armv75.size         = 14;
mpu_armv75.allowExecute = false;
mpu_armv75.attributes   = "Device";

mpu_armv76.$name        = "CONFIG_MPU_REGION5";
mpu_armv76.baseAddr     = 0x72000000;
mpu_armv76.size         = 14;
mpu_armv76.allowExecute = false;
mpu_armv76.attributes   = "NonCached";

mpu_armv77.$name    = "CONFIG_MPU_REGION6";
mpu_armv77.baseAddr = 0x60000000;
mpu_armv77.size     = 27;

general1.$name           = "CONFIG_GENERAL0";
general1.additional_data = "#define TASK_SIZE\t0x8000\n#define TEXT_SIZE\t0x26000\n#define BUF_SIZE\t0x4000\n\n#define MSRAM_START\t0x70080000\n#define XIP_MCU1_0_START 0x60100000";
general1.linker.$name    = "TIARMCLANG0";

region1.$name                               = "MEMORY_REGION_CONFIGURATION0";
region1.memory_region.create(7);
region1.memory_region[0].type               = "TCMA";
region1.memory_region[0].$name              = "R5F_VECS";
region1.memory_region[0].auto               = false;
region1.memory_region[0].size               = 0x40;
region1.memory_region[1].type               = "TCMA";
region1.memory_region[1].$name              = "R5F_TCMA";
region1.memory_region[1].size               = 0x7FC0;
region1.memory_region[2].type               = "TCMB";
region1.memory_region[2].$name              = "R5F_TCMB0";
region1.memory_region[2].size               = 0x8000;
region1.memory_region[3].$name              = "MSRAM_STACK";
region1.memory_region[3].size               = 0x60000;
region1.memory_region[4].$name              = "NON_CACHE_MEM";
region1.memory_region[4].size               = 0x8000;
region1.memory_region[5].auto               = false;
region1.memory_region[5].manualStartAddress = 0x70080000;
region1.memory_region[5].$name              = "MSRAM";
region1.memory_region[5].size               = 0x160000;
region1.memory_region[6].type               = "FLASH";
region1.memory_region[6].$name              = "FLASH";
region1.memory_region[6].auto               = false;
region1.memory_region[6].manualStartAddress = 0x60100000;
region1.memory_region[6].size               = 0x150000;

section1.$name                   = "Vector Table";
section1.load_memory             = ["R5F_VECS"];
section1.group                   = false;
section1.output_section.create(1);
section1.output_section[0].$name = ".vectors";

section2.$name                   = "Text Segments";
section2.load_memory             = ["MSRAM"];
section2.output_section.create(5);
section2.output_section[0].$name = ".text.hwi";
section2.output_section[1].$name = ".text.cache";
section2.output_section[2].$name = ".text.mpu";
section2.output_section[3].$name = ".text.boot";
section2.output_section[4].$name = ".text:abort";

section3.$name                         = "TI Local";
section3.split_across_memories         = true;
section3.group                         = false;
section3.output_section.create(1);
section3.output_section[0].$name       = ".TI.local";
section3.output_section[0].alignment   = 0;
section3.split_priority.create(4);
section3.split_priority[0].$name       = "Memory Region0";
section3.split_priority[0].load_memory = "R5F_TCMA";
section3.split_priority[1].$name       = "Memory Region1";
section3.split_priority[1].load_memory = "R5F_TCMB0";
section3.split_priority[2].$name       = "Memory Region2";
section3.split_priority[2].load_memory = "MSRAM";
section3.split_priority[3].$name       = "Memory Region3";
section3.split_priority[3].load_memory = "FLASH";

section4.$name                         = "TI Onchip";
section4.split_across_memories         = true;
section4.group                         = false;
section4.output_section.create(1);
section4.output_section[0].$name       = ".TI.onchip";
section4.output_section[0].alignment   = 0;
section4.split_priority.create(2);
section4.split_priority[0].$name       = "Memory Region4";
section4.split_priority[0].load_memory = "MSRAM";
section4.split_priority[1].$name       = "Memory Region5";
section4.split_priority[1].load_memory = "FLASH";

section5.$name                       = "TI Offchip";
section5.load_memory                 = ["FLASH"];
section5.group                       = false;
section5.output_section.create(1);
section5.output_section[0].$name     = ".TI.offchip";
section5.output_section[0].alignment = 0;

section6.$name                    = "Task";
section6.load_memory              = ["MSRAM"];
section6.output_section.create(17);
section6.output_section[0].$name  = ".task_0";
section6.output_section[1].$name  = ".task_1";
section6.output_section[2].$name  = ".task_2";
section6.output_section[3].$name  = ".task_4";
section6.output_section[4].$name  = ".task_5";
section6.output_section[5].$name  = ".task_6";
section6.output_section[6].$name  = ".task_7";
section6.output_section[7].$name  = ".task_8";
section6.output_section[8].$name  = ".task_9";
section6.output_section[9].$name  = ".task_10";
section6.output_section[10].$name = ".task_11";
section6.output_section[11].$name = ".task_12";
section6.output_section[12].$name = ".task_13";
section6.output_section[13].$name = ".task_14";
section6.output_section[14].$name = ".task_15";
section6.output_section[15].$name = ".text";
section6.output_section[16].$name = ".rodata";

section7.$name                        = "Buffer";
section7.load_memory                  = ["MSRAM"];
section7.output_section.create(18);
section7.output_section[0].$name      = ".buf_0";
section7.output_section[0].alignment  = 4;
section7.output_section[1].$name      = ".buf_1";
section7.output_section[1].alignment  = 4;
section7.output_section[2].$name      = ".buf_2";
section7.output_section[2].alignment  = 4;
section7.output_section[3].$name      = ".buf_3";
section7.output_section[3].alignment  = 4;
section7.output_section[4].$name      = ".buf_4";
section7.output_section[5].$name      = ".buf_5";
section7.output_section[5].alignment  = 4;
section7.output_section[6].$name      = ".buf_6";
section7.output_section[6].alignment  = 4;
section7.output_section[7].$name      = ".buf_7";
section7.output_section[7].alignment  = 4;
section7.output_section[8].$name      = ".buf_8";
section7.output_section[8].alignment  = 4;
section7.output_section[9].$name      = ".buf_9";
section7.output_section[9].alignment  = 4;
section7.output_section[10].$name     = ".buf_10";
section7.output_section[10].alignment = 4;
section7.output_section[11].$name     = ".buf_11";
section7.output_section[11].alignment = 4;
section7.output_section[12].$name     = ".buf_12";
section7.output_section[12].alignment = 4;
section7.output_section[13].$name     = ".buf_13";
section7.output_section[13].alignment = 4;
section7.output_section[14].$name     = ".buf_14";
section7.output_section[14].alignment = 4;
section7.output_section[15].$name     = ".buf_15";
section7.output_section[15].alignment = 4;
section7.output_section[16].$name     = ".buf_cpy";
section7.output_section[16].alignment = 4;
section7.output_section[17].$name     = ".data";

section8.$name                   = "Memory Segments";
section8.load_memory             = ["MSRAM_STACK"];
section8.output_section.create(2);
section8.output_section[0].$name = ".sysmem";
section8.output_section[1].$name = ".stack";

section9.$name                                    = "Stack Segments";
section9.load_memory                              = ["MSRAM"];
section9.output_section.create(5);
section9.output_section[0].$name                  = ".irqstack";
section9.output_section[0].output_sections_start  = "__IRQ_STACK_START";
section9.output_section[0].output_sections_end    = "__IRQ_STACK_END";
section9.output_section[0].input_section.create(1);
section9.output_section[0].input_section[0].$name = ". = . + __IRQ_STACK_SIZE;";
section9.output_section[1].$name                  = ".fiqstack";
section9.output_section[1].output_sections_start  = "__FIQ_STACK_START";
section9.output_section[1].output_sections_end    = "__FIQ_STACK_END";
section9.output_section[1].input_section.create(1);
section9.output_section[1].input_section[0].$name = ". = . + __FIQ_STACK_SIZE;";
section9.output_section[2].$name                  = ".svcstack";
section9.output_section[2].output_sections_start  = "__SVC_STACK_START";
section9.output_section[2].output_sections_end    = "__SVC_STACK_END";
section9.output_section[2].input_section.create(1);
section9.output_section[2].input_section[0].$name = ". = . + __SVC_STACK_SIZE;";
section9.output_section[3].$name                  = ".abortstack";
section9.output_section[3].output_sections_start  = "__ABORT_STACK_START";
section9.output_section[3].output_sections_end    = "__ABORT_STACK_END";
section9.output_section[3].input_section.create(1);
section9.output_section[3].input_section[0].$name = ". = . + __ABORT_STACK_SIZE;";
section9.output_section[4].$name                  = ".undefinedstack";
section9.output_section[4].output_sections_start  = "__UNDEFINED_STACK_START";
section9.output_section[4].output_sections_end    = "__UNDEFINED_STACK_END";
section9.output_section[4].input_section.create(1);
section9.output_section[4].input_section[0].$name = ". = . + __UNDEFINED_STACK_SIZE;";

section10.load_memory             = ["MSRAM"];
section10.$name                   = "Initialization and Exception Handling";
section10.output_section.create(3);
section10.output_section[0].$name = ".ARM.exidx";
section10.output_section[1].$name = ".init_array";
section10.output_section[2].$name = ".fini_array";

section11.load_memory             = ["MSRAM"];
section11.$name                   = "uninit";
section11.group_start             = "__BSS_START";
section11.group_end               = "__BSS_END";
section11.output_section.create(3);
section11.output_section[0].$name = ".bss";
section11.output_section[1].$name = "__llvm_prf_cnts";
section11.output_section[2].$name = "__llvm_prf_bits";
