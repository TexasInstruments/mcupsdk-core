/**
 * @cliArgs --device "AM64x_beta" --package "ALV" --part "Default" --context "r5fss0-0" --product "MCU_PLUS_SDK@07.03.01"
 * @versions {"tool":"1.14.0+2667"}
 */

/**
 * Import the modules used in this configuration.
 */
const eeprom     = scripting.addModule("/board/eeprom/eeprom", {}, false);
const eeprom1    = eeprom.addInstance();
const led        = scripting.addModule("/board/led/led", {}, false);
const led1       = led.addInstance();
const led2       = led.addInstance();
const led3       = led.addInstance();
const gpio       = scripting.addModule("/drivers/gpio/gpio", {}, false);
const gpio1      = gpio.addInstance();
const gpio2      = gpio.addInstance();
const i2c        = scripting.addModule("/drivers/i2c/i2c", {}, false);
const i2c1       = i2c.addInstance();
const pruicss    = scripting.addModule("/drivers/pruicss/pruicss", {}, false);
const pruicss1   = pruicss.addInstance();
const hsr_prp    = scripting.addModule("/industrial_comms/hsr_prp/hsr_prp", {}, false);
const hsr_prp1   = hsr_prp.addInstance();
const debug_log  = scripting.addModule("/kernel/dpl/debug_log");
const mpu_armv7  = scripting.addModule("/kernel/dpl/mpu_armv7", {}, false);
const mpu_armv71 = mpu_armv7.addInstance();
const mpu_armv72 = mpu_armv7.addInstance();
const mpu_armv73 = mpu_armv7.addInstance();
const mpu_armv74 = mpu_armv7.addInstance();
const mpu_armv75 = mpu_armv7.addInstance();
const mpu_armv76 = mpu_armv7.addInstance();
const mpu_armv77 = mpu_armv7.addInstance();

/**
 * Write custom configuration values to the imported modules.
 */
eeprom1.$name = "CONFIG_EEPROM0";

led1.$name = "CONFIG_LED0";

led2.$name = "CONFIG_LED1";

led3.$name = "CONFIG_LED2";
led3.name  = "TPIC2810";

gpio1.$name           = "CONFIG_GPIO0";
led1.peripheralDriver = gpio1;
gpio1.pinDir          = "OUTPUT";
gpio1.GPIO.$assign    = "GPIO0";

gpio2.$name           = "CONFIG_GPIO1";
led2.peripheralDriver = gpio2;
gpio2.GPIO.$assign    = "GPIO1";

led3.peripheralDriver    = i2c1;
i2c1.$name               = "CONFIG_I2C0";
eeprom1.peripheralDriver = i2c1;
i2c1.I2C.$assign         = "I2C0";

hsr_prp1.$name                         = "CONFIG_HSR_PRP0";
hsr_prp1.phyToMacInterfaceMode         = "RGMII";
hsr_prp1.icss_emac[0].$name            = "CONFIG_ICSS_EMAC0";
hsr_prp1.icss_emac[0].mode             = scripting.forceWrite("SWITCH");
hsr_prp1.icss_emac[0].phyAddr0         = scripting.forceWrite(15);
hsr_prp1.icss_emac[0].queue            = "QUEUE2";
hsr_prp1.icss_emac[0].linkTaskPriority = 12;
hsr_prp1.icss_emac[0].txTaskPriority   = 10;
hsr_prp1.icss_emac[0].splitQueue       = true;
hsr_prp1.icss_emac[0].rxTaskPriority   = 6;
hsr_prp1.ethphy1[0].$name              = "CONFIG_ETHPHY0";
hsr_prp1.ethphy2[0].$name              = "CONFIG_ETHPHY1";

hsr_prp1.icss                            = pruicss1;
pruicss1.$name                           = "CONFIG_PRU_ICSS1";
pruicss1.AdditionalICSSSettings[0].$name = "CONFIG_PRU_ICSS_IO0";

debug_log.enableUartLog        = true;
debug_log.enableCssLog         = false;
debug_log.uartLog.$name        = "CONFIG_UART_CONSOLE";
debug_log.uartLog.UART.$assign = "USART0";

mpu_armv71.$name             = "CONFIG_MPU_REGION0";
mpu_armv71.size              = 31;
mpu_armv71.attributes        = "Device";
mpu_armv71.accessPermissions = "Supervisor RD+WR, User RD";
mpu_armv71.allowExecute      = false;

mpu_armv72.$name             = "CONFIG_MPU_REGION1";
mpu_armv72.size              = 15;
mpu_armv72.accessPermissions = "Supervisor RD+WR, User RD";

mpu_armv73.$name             = "CONFIG_MPU_REGION2";
mpu_armv73.baseAddr          = 0x41010000;
mpu_armv73.size              = 15;
mpu_armv73.accessPermissions = "Supervisor RD+WR, User RD";

mpu_armv74.$name             = "CONFIG_MPU_REGION3";
mpu_armv74.accessPermissions = "Supervisor RD+WR, User RD";
mpu_armv74.baseAddr          = 0x70000000;
mpu_armv74.size              = 21;

mpu_armv75.$name             = "CONFIG_MPU_REGION4";
mpu_armv75.baseAddr          = 0x60000000;
mpu_armv75.size              = 28;
mpu_armv75.accessPermissions = "Supervisor RD, User RD";

mpu_armv76.$name    = "CONFIG_MPU_REGION5";
mpu_armv76.baseAddr = 0x80000000;
mpu_armv76.size     = 31;

mpu_armv77.$name      = "CONFIG_MPU_REGION6";
mpu_armv77.baseAddr   = 0x70000000;
mpu_armv77.size       = 16;
mpu_armv77.attributes = "Cached+Sharable";

/**
 * Pinmux solution for unlocked pins/peripherals. This ensures that minor changes to the automatic solver in a future
 * version of the tool will not impact the pinmux you originally saw.  These lines can be completely deleted in order to
 * re-solve from scratch.
 */
gpio1.GPIO.gpioPin.$suggestSolution                    = "OSPI0_CLK";
gpio2.GPIO.gpioPin.$suggestSolution                    = "PRG0_PRU0_GPO0";
i2c1.I2C.SCL.$suggestSolution                          = "I2C0_SCL";
i2c1.I2C.SDA.$suggestSolution                          = "I2C0_SDA";
hsr_prp1.PRU_ICSSG1_MDIO.$suggestSolution              = "PRU_ICSSG1_MDIO0";
hsr_prp1.PRU_ICSSG1_MDIO.MDC.$suggestSolution          = "PRG1_MDIO0_MDC";
hsr_prp1.PRU_ICSSG1_MDIO.MDIO.$suggestSolution         = "PRG1_MDIO0_MDIO";
hsr_prp1.PRU_ICSSG1_IEP.$suggestSolution               = "PRU_ICSSG1_IEP0";
hsr_prp1.PRU_ICSSG1_IEP.EDC_LATCH_IN0.$suggestSolution = "PRG1_PRU0_GPO18";
hsr_prp1.PRU_ICSSG1_IEP.EDC_SYNC_OUT0.$suggestSolution = "PRG1_PRU0_GPO19";
hsr_prp1.PRU_ICSSG1_RGMII1.$suggestSolution            = "PRU_ICSSG1_RGMII2";
hsr_prp1.PRU_ICSSG1_RGMII1.RD0.$suggestSolution        = "PRG1_PRU1_GPO0";
hsr_prp1.PRU_ICSSG1_RGMII1.RD1.$suggestSolution        = "PRG1_PRU1_GPO1";
hsr_prp1.PRU_ICSSG1_RGMII1.RD2.$suggestSolution        = "PRG1_PRU1_GPO2";
hsr_prp1.PRU_ICSSG1_RGMII1.RD3.$suggestSolution        = "PRG1_PRU1_GPO3";
hsr_prp1.PRU_ICSSG1_RGMII1.RXC.$suggestSolution        = "PRG1_PRU1_GPO6";
hsr_prp1.PRU_ICSSG1_RGMII1.RX_CTL.$suggestSolution     = "PRG1_PRU1_GPO4";
hsr_prp1.PRU_ICSSG1_RGMII1.TD0.$suggestSolution        = "PRG1_PRU1_GPO11";
hsr_prp1.PRU_ICSSG1_RGMII1.TD1.$suggestSolution        = "PRG1_PRU1_GPO12";
hsr_prp1.PRU_ICSSG1_RGMII1.TD2.$suggestSolution        = "PRG1_PRU1_GPO13";
hsr_prp1.PRU_ICSSG1_RGMII1.TD3.$suggestSolution        = "PRG1_PRU1_GPO14";
hsr_prp1.PRU_ICSSG1_RGMII1.TXC.$suggestSolution        = "PRG1_PRU1_GPO16";
hsr_prp1.PRU_ICSSG1_RGMII1.TX_CTL.$suggestSolution     = "PRG1_PRU1_GPO15";
hsr_prp1.PRU_ICSSG1_RGMII2.$suggestSolution            = "PRU_ICSSG1_RGMII1";
hsr_prp1.PRU_ICSSG1_RGMII2.RD0.$suggestSolution        = "PRG1_PRU0_GPO0";
hsr_prp1.PRU_ICSSG1_RGMII2.RD1.$suggestSolution        = "PRG1_PRU0_GPO1";
hsr_prp1.PRU_ICSSG1_RGMII2.RD2.$suggestSolution        = "PRG1_PRU0_GPO2";
hsr_prp1.PRU_ICSSG1_RGMII2.RD3.$suggestSolution        = "PRG1_PRU0_GPO3";
hsr_prp1.PRU_ICSSG1_RGMII2.RXC.$suggestSolution        = "PRG1_PRU0_GPO6";
hsr_prp1.PRU_ICSSG1_RGMII2.RX_CTL.$suggestSolution     = "PRG1_PRU0_GPO4";
hsr_prp1.PRU_ICSSG1_RGMII2.TD0.$suggestSolution        = "PRG1_PRU0_GPO11";
hsr_prp1.PRU_ICSSG1_RGMII2.TD1.$suggestSolution        = "PRG1_PRU0_GPO12";
hsr_prp1.PRU_ICSSG1_RGMII2.TD2.$suggestSolution        = "PRG1_PRU0_GPO13";
hsr_prp1.PRU_ICSSG1_RGMII2.TD3.$suggestSolution        = "PRG1_PRU0_GPO14";
hsr_prp1.PRU_ICSSG1_RGMII2.TXC.$suggestSolution        = "PRG1_PRU0_GPO16";
hsr_prp1.PRU_ICSSG1_RGMII2.TX_CTL.$suggestSolution     = "PRG1_PRU0_GPO15";
debug_log.uartLog.UART.RXD.$suggestSolution            = "UART0_RXD";
debug_log.uartLog.UART.TXD.$suggestSolution            = "UART0_TXD";
