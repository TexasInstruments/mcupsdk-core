/**
 * @cliArgs --device "AM243x_ALX_beta" --package "ALX" --part "ALX" --context "r5fss0-0" --product "MCU_PLUS_SDK@07.03.01"
 * @versions {"tool":"1.13.0+2553"}
 */

/**
 * Import the modules used in this configuration.
 */
const eeprom      = scripting.addModule("/board/eeprom/eeprom", {}, false);
const eeprom1     = eeprom.addInstance();
const flash       = scripting.addModule("/board/flash/flash", {}, false);
const flash1      = flash.addInstance();
const led         = scripting.addModule("/board/led/led", {}, false);
const led1        = led.addInstance();
const i2c         = scripting.addModule("/drivers/i2c/i2c", {}, false);
const i2c1        = i2c.addInstance();
const pruicss     = scripting.addModule("/drivers/pruicss/pruicss", {}, false);
const pruicss1    = pruicss.addInstance();
const uart        = scripting.addModule("/drivers/uart/uart", {}, false);
const uart1       = uart.addInstance();
const ethernetip  = scripting.addModule("/industrial_comms/ethernetip/ethernetip", {}, false);
const ethernetip1 = ethernetip.addInstance();
const clock       = scripting.addModule("/kernel/dpl/clock");
const debug_log   = scripting.addModule("/kernel/dpl/debug_log");
const mpu_armv7   = scripting.addModule("/kernel/dpl/mpu_armv7", {}, false);
const mpu_armv71  = mpu_armv7.addInstance();
const mpu_armv72  = mpu_armv7.addInstance();
const mpu_armv73  = mpu_armv7.addInstance();
const mpu_armv74  = mpu_armv7.addInstance();
const mpu_armv75  = mpu_armv7.addInstance();
const timer       = scripting.addModule("/kernel/dpl/timer", {}, false);
const timer1      = timer.addInstance();

/**
 * Write custom configuration values to the imported modules.
 */
eeprom1.$name = "CONFIG_EEPROM0";

flash1.$name                         = "CONFIG_FLASH0";
flash1.peripheralDriver.$name        = "CONFIG_OSPI0";
flash1.peripheralDriver.OSPI.$assign = "OSPI0";

led1.$name = "CONFIG_LED0";
led1.name  = "TPIC2810";

i2c1.$name               = "CONFIG_I2C0";
led1.peripheralDriver    = i2c1;
eeprom1.peripheralDriver = i2c1;
i2c1.I2C.$assign         = "I2C0";

uart1.$name                   = "CONFIG_UART1";
uart1.intrEnable              = "USER_INTR";
uart1.rxTrigLvl               = "1";
uart1.useMcuDomainPeripherals = true;
uart1.MCU_UART.$assign        = "MCU_USART0";

ethernetip1.$name                              = "CONFIG_ETHERNETIP0";
ethernetip1.phyAddr0                           = 3;
ethernetip1.phyAddr1                           = 15;
ethernetip1.manualMode                         = false;
ethernetip1.icss_emac[0].$name                 = "CONFIG_ICSS_EMAC0";
ethernetip1.icss_emac[0].mode                  = scripting.forceWrite("SWITCH");
ethernetip1.icss_emac[0].phyToMacInterfaceMode = scripting.forceWrite("MII");
ethernetip1.icss_emac[0].learningEnable        = true;
ethernetip1.icss_emac[0].linkTaskPriority      = 24;
ethernetip1.icss_emac[0].rxTaskPriority        = 20;
ethernetip1.icss_emac[0].txTaskPriority        = 20;
ethernetip1.ethphy1[0].$name                   = "CONFIG_ETHPHY0";
ethernetip1.ethphy1[0].name                    = "CUSTOM";
ethernetip1.ethphy1[0].customDeviceName        = "DP83869_0";
ethernetip1.ethphy2[0].$name                   = "CONFIG_ETHPHY1";
ethernetip1.ethphy2[0].name                    = "CUSTOM";
ethernetip1.ethphy2[0].customDeviceName        = "DP83869_1";

ethernetip1.icss = pruicss1;
pruicss1.$name   = "CONFIG_PRU_ICSS1";

debug_log.enableUartLog        = true;
debug_log.uartLog.$name        = "CONFIG_UART_CONSOLE";
debug_log.uartLog.UART.$assign = "USART0";

mpu_armv71.$name        = "CONFIG_MPU_REGION0";
mpu_armv71.size         = 31;
mpu_armv71.attributes   = "Device";
mpu_armv71.allowExecute = false;

mpu_armv72.$name             = "CONFIG_MPU_REGION1";
mpu_armv72.size              = 15;
mpu_armv72.accessPermissions = "Supervisor RD+WR, User RD";

mpu_armv73.$name             = "CONFIG_MPU_REGION2";
mpu_armv73.baseAddr          = 0x41010000;
mpu_armv73.size              = 15;
mpu_armv73.accessPermissions = "Supervisor RD+WR, User RD";

mpu_armv74.$name             = "CONFIG_MPU_REGION3";
mpu_armv74.baseAddr          = 0x70000000;
mpu_armv74.size              = 21;
mpu_armv74.accessPermissions = "Supervisor RD+WR, User RD";

mpu_armv75.$name      = "CONFIG_MPU_REGION4";
mpu_armv75.size       = 16;
mpu_armv75.baseAddr   = 0x70000000;
mpu_armv75.attributes = "Cached+Sharable";

timer1.$name         = "CONFIG_TIMER0";
timer1.startTimer    = true;
timer1.timerCallback = "OSAL_FREERTOS_callbackTimer";
timer1.TIMER.$assign = "DMTIMER4";

/**
 * Pinmux solution for unlocked pins/peripherals. This ensures that minor changes to the automatic solver in a future
 * version of the tool will not impact the pinmux you originally saw.  These lines can be completely deleted in order to
 * re-solve from scratch.
 */
flash1.peripheralDriver.OSPI.CLK.$suggestSolution            = "ball.P20";
flash1.peripheralDriver.OSPI.CSn0.$suggestSolution           = "ball.L20";
flash1.peripheralDriver.OSPI.D3.$suggestSolution             = "ball.N19";
flash1.peripheralDriver.OSPI.D2.$suggestSolution             = "ball.L21";
flash1.peripheralDriver.OSPI.D1.$suggestSolution             = "ball.N20";
flash1.peripheralDriver.OSPI.D0.$suggestSolution             = "ball.L19";
i2c1.I2C.SCL.$suggestSolution                                = "ball.B16";
i2c1.I2C.SDA.$suggestSolution                                = "ball.B15";
uart1.MCU_UART.RXD.$suggestSolution                          = "ball.D6";
uart1.MCU_UART.TXD.$suggestSolution                          = "ball.B2";
ethernetip1.PRU_ICSSG1_MDIO.$suggestSolution                 = "PRU_ICSSG1_MDIO0";
ethernetip1.PRU_ICSSG1_MDIO.MDC.$suggestSolution             = "ball.W1";
ethernetip1.PRU_ICSSG1_MDIO.MDIO.$suggestSolution            = "ball.V2";
ethernetip1.PRU_ICSSG1_IEP.$suggestSolution                  = "PRU_ICSSG1_IEP0";
ethernetip1.PRU_ICSSG1_IEP.EDC_LATCH_IN0.$suggestSolution    = "ball.Y4";
ethernetip1.PRU_ICSSG1_IEP.EDC_SYNC_OUT0.$suggestSolution    = "ball.U3";
ethernetip1.PRU_ICSSG1_MII_G_RT.$suggestSolution             = "PRU_ICSSG1_MII_G_RT";
ethernetip1.PRU_ICSSG1_MII_G_RT.MII0_RXD0.$suggestSolution   = "ball.V4";
ethernetip1.PRU_ICSSG1_MII_G_RT.MII0_RXD1.$suggestSolution   = "ball.W5";
ethernetip1.PRU_ICSSG1_MII_G_RT.MII0_RXD2.$suggestSolution   = "ball.AA4";
ethernetip1.PRU_ICSSG1_MII_G_RT.MII0_RXD3.$suggestSolution   = "ball.Y5";
ethernetip1.PRU_ICSSG1_MII_G_RT.MII0_RXDV.$suggestSolution   = "ball.AA5";
ethernetip1.PRU_ICSSG1_MII_G_RT.MII0_TXD0.$suggestSolution   = "ball.V5";
ethernetip1.PRU_ICSSG1_MII_G_RT.MII0_TXD1.$suggestSolution   = "ball.W2";
ethernetip1.PRU_ICSSG1_MII_G_RT.MII0_TXD2.$suggestSolution   = "ball.V6";
ethernetip1.PRU_ICSSG1_MII_G_RT.MII0_TXD3.$suggestSolution   = "ball.AA7";
ethernetip1.PRU_ICSSG1_MII_G_RT.MII0_TXEN.$suggestSolution   = "ball.Y7";
ethernetip1.PRU_ICSSG1_MII_G_RT.MII1_RXD0.$suggestSolution   = "ball.AA10";
ethernetip1.PRU_ICSSG1_MII_G_RT.MII1_RXD1.$suggestSolution   = "ball.Y10";
ethernetip1.PRU_ICSSG1_MII_G_RT.MII1_RXD2.$suggestSolution   = "ball.Y11";
ethernetip1.PRU_ICSSG1_MII_G_RT.MII1_RXD3.$suggestSolution   = "ball.V12";
ethernetip1.PRU_ICSSG1_MII_G_RT.MII1_RXDV.$suggestSolution   = "ball.Y12";
ethernetip1.PRU_ICSSG1_MII_G_RT.MII1_TXD0.$suggestSolution   = "ball.Y6";
ethernetip1.PRU_ICSSG1_MII_G_RT.MII1_TXD1.$suggestSolution   = "ball.AA8";
ethernetip1.PRU_ICSSG1_MII_G_RT.MII1_TXD2.$suggestSolution   = "ball.Y9";
ethernetip1.PRU_ICSSG1_MII_G_RT.MII1_TXD3.$suggestSolution   = "ball.W9";
ethernetip1.PRU_ICSSG1_MII_G_RT.MII1_TXEN.$suggestSolution   = "ball.V9";
ethernetip1.PRU_ICSSG1_MII_G_RT.MII_MR0_CLK.$suggestSolution = "ball.Y2";
ethernetip1.PRU_ICSSG1_MII_G_RT.MII_MR1_CLK.$suggestSolution = "ball.V10";
ethernetip1.PRU_ICSSG1_MII_G_RT.MII_MT0_CLK.$suggestSolution = "ball.W6";
ethernetip1.PRU_ICSSG1_MII_G_RT.MII_MT1_CLK.$suggestSolution = "ball.Y8";
debug_log.uartLog.UART.RXD.$suggestSolution                  = "ball.B10";
debug_log.uartLog.UART.TXD.$suggestSolution                  = "ball.B11";
