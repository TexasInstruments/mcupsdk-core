/**
 * @cliArgs --device "AM64x_beta" --package "ALV" --part "Default" --context "r5fss0-0" --product "MCU_PLUS_SDK@07.03.01"
 * @versions {"tool":"1.13.0+2553"}
 */

/**
 * Import the modules used in this configuration.
 */
const eeprom      = scripting.addModule("/board/eeprom/eeprom", {}, false);
const eeprom1     = eeprom.addInstance();
const flash       = scripting.addModule("/board/flash/flash", {}, false);
const flash1      = flash.addInstance();
const led         = scripting.addModule("/board/led/led", {}, false);
const led1        = led.addInstance();
const i2c         = scripting.addModule("/drivers/i2c/i2c", {}, false);
const i2c1        = i2c.addInstance();
const i2c2        = i2c.addInstance();
const pruicss     = scripting.addModule("/drivers/pruicss/pruicss", {}, false);
const pruicss1    = pruicss.addInstance();
const uart        = scripting.addModule("/drivers/uart/uart", {}, false);
const uart1       = uart.addInstance();
const ethernetip  = scripting.addModule("/industrial_comms/ethernetip/ethernetip", {}, false);
const ethernetip1 = ethernetip.addInstance();
const debug_log   = scripting.addModule("/kernel/dpl/debug_log");
const mpu_armv7   = scripting.addModule("/kernel/dpl/mpu_armv7", {}, false);
const mpu_armv71  = mpu_armv7.addInstance();
const mpu_armv72  = mpu_armv7.addInstance();
const mpu_armv73  = mpu_armv7.addInstance();
const mpu_armv74  = mpu_armv7.addInstance();
const mpu_armv75  = mpu_armv7.addInstance();
const timer       = scripting.addModule("/kernel/dpl/timer", {}, false);
const timer1      = timer.addInstance();

/**
 * Write custom configuration values to the imported modules.
 */
eeprom1.$name = "CONFIG_EEPROM0";

flash1.$name                         = "CONFIG_FLASH0";
flash1.peripheralDriver.$name        = "CONFIG_OSPI0";
flash1.peripheralDriver.phyEnable    = true;
flash1.peripheralDriver.inputClkFreq = 166666666;

led1.$name = "CONFIG_LED0";
led1.name  = "TPIC2810";

i2c1.$name               = "CONFIG_I2C0";
eeprom1.peripheralDriver = i2c1;
i2c1.I2C.$assign         = "I2C0";

i2c2.$name            = "CONFIG_I2C1";
led1.peripheralDriver = i2c2;

uart1.useMcuDomainPeripherals = true;
uart1.rxTrigLvl               = "1";
uart1.intrEnable              = "USER_INTR";
uart1.hwFlowControlThr        = "1";
uart1.$name                   = "CONFIG_UART1";
uart1.MCU_UART.$assign        = "MCU_USART0";

ethernetip1.$name                         = "CONFIG_ETHERNETIP0";
ethernetip1.manualMode                    = false;
ethernetip1.icss_emac[0].$name            = "CONFIG_ICSS_EMAC0";
ethernetip1.icss_emac[0].learningEnable   = true;
ethernetip1.icss_emac[0].linkTaskPriority = 24;
ethernetip1.icss_emac[0].rxTaskPriority   = 20;
ethernetip1.icss_emac[0].txTaskPriority   = 20;
ethernetip1.ethphy1[0].$name              = "CONFIG_ETHPHY0";
ethernetip1.ethphy1[0].mdioPort           = scripting.forceWrite(15);
ethernetip1.ethphy1[0].name               = "CUSTOM";
ethernetip1.ethphy1[0].customDeviceName   = "DP83869_0";
ethernetip1.ethphy2[0].$name              = "CONFIG_ETHPHY1";
ethernetip1.ethphy2[0].name               = "CUSTOM";
ethernetip1.ethphy2[0].customDeviceName   = "DP83869_1";

ethernetip1.icss = pruicss1;
pruicss1.$name   = "CONFIG_PRU_ICSS1";

debug_log.enableUartLog        = true;
debug_log.uartLog.$name        = "CONFIG_UART_CONSOLE";
debug_log.uartLog.UART.$assign = "USART0";

mpu_armv71.$name             = "CONFIG_MPU_REGION0";
mpu_armv71.size              = 31;
mpu_armv71.attributes        = "Device";
mpu_armv71.accessPermissions = "Supervisor RD+WR, User RD";
mpu_armv71.allowExecute      = false;

mpu_armv72.$name             = "CONFIG_MPU_REGION1";
mpu_armv72.size              = 15;
mpu_armv72.accessPermissions = "Supervisor RD+WR, User RD";

mpu_armv73.$name             = "CONFIG_MPU_REGION2";
mpu_armv73.baseAddr          = 0x41010000;
mpu_armv73.size              = 15;
mpu_armv73.accessPermissions = "Supervisor RD+WR, User RD";

mpu_armv74.$name             = "CONFIG_MPU_REGION3";
mpu_armv74.accessPermissions = "Supervisor RD+WR, User RD";
mpu_armv74.baseAddr          = 0x70000000;
mpu_armv74.size              = 21;

mpu_armv75.$name      = "CONFIG_MPU_REGION4";
mpu_armv75.baseAddr   = 0x70000000;
mpu_armv75.attributes = "Cached+Sharable";
mpu_armv75.size       = 16;

timer1.$name         = "CONFIG_TIMER0";
timer1.startTimer    = true;
timer1.timerCallback = "OSAL_FREERTOS_callbackTimer";
timer1.TIMER.$assign = "DMTIMER4";

/**
 * Pinmux solution for unlocked pins/peripherals. This ensures that minor changes to the automatic solver in a future
 * version of the tool will not impact the pinmux you originally saw.  These lines can be completely deleted in order to
 * re-solve from scratch.
 */
flash1.peripheralDriver.OSPI.$suggestSolution                = "OSPI0";
flash1.peripheralDriver.OSPI.CLK.$suggestSolution            = "ball.N20";
flash1.peripheralDriver.OSPI.CSn0.$suggestSolution           = "ball.L19";
flash1.peripheralDriver.OSPI.DQS.$suggestSolution            = "ball.N19";
flash1.peripheralDriver.OSPI.D7.$suggestSolution             = "ball.M17";
flash1.peripheralDriver.OSPI.D6.$suggestSolution             = "ball.N18";
flash1.peripheralDriver.OSPI.D5.$suggestSolution             = "ball.P20";
flash1.peripheralDriver.OSPI.D4.$suggestSolution             = "ball.P21";
flash1.peripheralDriver.OSPI.D3.$suggestSolution             = "ball.M21";
flash1.peripheralDriver.OSPI.D2.$suggestSolution             = "ball.M20";
flash1.peripheralDriver.OSPI.D1.$suggestSolution             = "ball.M18";
flash1.peripheralDriver.OSPI.D0.$suggestSolution             = "ball.M19";
i2c1.I2C.SCL.$suggestSolution                                = "ball.A18";
i2c1.I2C.SDA.$suggestSolution                                = "ball.B18";
i2c2.I2C.$suggestSolution                                    = "I2C1";
i2c2.I2C.SCL.$suggestSolution                                = "ball.C18";
i2c2.I2C.SDA.$suggestSolution                                = "ball.B19";
uart1.MCU_UART.RXD.$suggestSolution                          = "ball.A9";
uart1.MCU_UART.TXD.$suggestSolution                          = "ball.A8";
ethernetip1.PRU_ICSSG1_MDIO.$suggestSolution                 = "PRU_ICSSG1_MDIO0";
ethernetip1.PRU_ICSSG1_MDIO.MDC.$suggestSolution             = "ball.Y6";
ethernetip1.PRU_ICSSG1_MDIO.MDIO.$suggestSolution            = "ball.AA6";
ethernetip1.PRU_ICSSG1_IEP.$suggestSolution                  = "PRU_ICSSG1_IEP0";
ethernetip1.PRU_ICSSG1_IEP.EDC_LATCH_IN0.$suggestSolution    = "ball.V7";
ethernetip1.PRU_ICSSG1_IEP.EDC_SYNC_OUT0.$suggestSolution    = "ball.W7";
ethernetip1.PRU_ICSSG1_MII_G_RT.$suggestSolution             = "PRU_ICSSG1_MII_G_RT";
ethernetip1.PRU_ICSSG1_MII_G_RT.MII0_RXD0.$suggestSolution   = "ball.Y7";
ethernetip1.PRU_ICSSG1_MII_G_RT.MII0_RXD1.$suggestSolution   = "ball.U8";
ethernetip1.PRU_ICSSG1_MII_G_RT.MII0_RXD2.$suggestSolution   = "ball.W8";
ethernetip1.PRU_ICSSG1_MII_G_RT.MII0_RXD3.$suggestSolution   = "ball.V8";
ethernetip1.PRU_ICSSG1_MII_G_RT.MII0_RXDV.$suggestSolution   = "ball.Y8";
ethernetip1.PRU_ICSSG1_MII_G_RT.MII0_RXER.$suggestSolution   = "ball.V13";
ethernetip1.PRU_ICSSG1_MII_G_RT.MII0_TXD0.$suggestSolution   = "ball.AA8";
ethernetip1.PRU_ICSSG1_MII_G_RT.MII0_TXD1.$suggestSolution   = "ball.U9";
ethernetip1.PRU_ICSSG1_MII_G_RT.MII0_TXD2.$suggestSolution   = "ball.W9";
ethernetip1.PRU_ICSSG1_MII_G_RT.MII0_TXD3.$suggestSolution   = "ball.AA9";
ethernetip1.PRU_ICSSG1_MII_G_RT.MII0_TXEN.$suggestSolution   = "ball.Y9";
ethernetip1.PRU_ICSSG1_MII_G_RT.MII1_RXD0.$suggestSolution   = "ball.W11";
ethernetip1.PRU_ICSSG1_MII_G_RT.MII1_RXD1.$suggestSolution   = "ball.V11";
ethernetip1.PRU_ICSSG1_MII_G_RT.MII1_RXD2.$suggestSolution   = "ball.AA12";
ethernetip1.PRU_ICSSG1_MII_G_RT.MII1_RXD3.$suggestSolution   = "ball.Y12";
ethernetip1.PRU_ICSSG1_MII_G_RT.MII1_RXDV.$suggestSolution   = "ball.W12";
ethernetip1.PRU_ICSSG1_MII_G_RT.MII1_RXER.$suggestSolution   = "ball.AA13";
ethernetip1.PRU_ICSSG1_MII_G_RT.MII1_TXD0.$suggestSolution   = "ball.AA10";
ethernetip1.PRU_ICSSG1_MII_G_RT.MII1_TXD1.$suggestSolution   = "ball.V10";
ethernetip1.PRU_ICSSG1_MII_G_RT.MII1_TXD2.$suggestSolution   = "ball.U10";
ethernetip1.PRU_ICSSG1_MII_G_RT.MII1_TXD3.$suggestSolution   = "ball.AA11";
ethernetip1.PRU_ICSSG1_MII_G_RT.MII1_TXEN.$suggestSolution   = "ball.Y11";
ethernetip1.PRU_ICSSG1_MII_G_RT.MII_MR0_CLK.$suggestSolution = "ball.AA7";
ethernetip1.PRU_ICSSG1_MII_G_RT.MII_MR1_CLK.$suggestSolution = "ball.U11";
ethernetip1.PRU_ICSSG1_MII_G_RT.MII_MT0_CLK.$suggestSolution = "ball.V9";
ethernetip1.PRU_ICSSG1_MII_G_RT.MII_MT1_CLK.$suggestSolution = "ball.Y10";
debug_log.uartLog.UART.RXD.$suggestSolution                  = "ball.D15";
debug_log.uartLog.UART.TXD.$suggestSolution                  = "ball.C16";
