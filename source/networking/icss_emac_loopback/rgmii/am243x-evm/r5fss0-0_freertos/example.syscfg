/**
 * @cliArgs --device "AM243x_ALV_beta" --package "ALV" --part "ALV" --context "r5fss0-0" --product "MCU_PLUS_SDK@07.03.01"
 * @versions {"tool":"1.12.0+2406"}
 */

/**
 * Import the modules used in this configuration.
 */
const ethphy     = scripting.addModule("/board/ethphy/ethphy", {}, false);
const ethphy1    = ethphy.addInstance();
const ethphy2    = ethphy.addInstance();
const pruicss    = scripting.addModule("/drivers/pruicss/pruicss", {}, false);
const pruicss1   = pruicss.addInstance();
const clock      = scripting.addModule("/kernel/dpl/clock");
const debug_log  = scripting.addModule("/kernel/dpl/debug_log");
const mpu_armv7  = scripting.addModule("/kernel/dpl/mpu_armv7", {}, false);
const mpu_armv71 = mpu_armv7.addInstance();
const mpu_armv72 = mpu_armv7.addInstance();
const mpu_armv73 = mpu_armv7.addInstance();
const mpu_armv74 = mpu_armv7.addInstance();
const mpu_armv75 = mpu_armv7.addInstance();
const mpu_armv76 = mpu_armv7.addInstance();
const mpu_armv77 = mpu_armv7.addInstance();
const icss_emac  = scripting.addModule("/networking/icss_emac/icss_emac", {}, false);
const icss_emac1 = icss_emac.addInstance();
const icss_emac2 = icss_emac.addInstance();

/**
 * Write custom configuration values to the imported modules.
 */
ethphy1.$name        = "CONFIG_ETHPHY0";
ethphy1.mdioInstance = "ICSSG1";

ethphy2.$name        = "CONFIG_ETHPHY1";
ethphy2.mdioInstance = "ICSSG1";
ethphy2.mdioPort     = 3;

pruicss1.$name    = "CONFIG_PRU_ICSS1";
pruicss1.instance = "ICSSG1";

debug_log.enableUartLog        = true;
debug_log.uartLog.$name        = "CONFIG_UART_CONSOLE";
debug_log.uartLog.UART.$assign = "USART0";

mpu_armv71.$name             = "CONFIG_MPU_REGION0";
mpu_armv71.size              = 31;
mpu_armv71.attributes        = "Device";
mpu_armv71.accessPermissions = "Supervisor RD+WR, User RD";
mpu_armv71.allowExecute      = false;

mpu_armv72.$name             = "CONFIG_MPU_REGION1";
mpu_armv72.size              = 15;
mpu_armv72.accessPermissions = "Supervisor RD+WR, User RD";

mpu_armv73.$name             = "CONFIG_MPU_REGION2";
mpu_armv73.baseAddr          = 0x41010000;
mpu_armv73.size              = 15;
mpu_armv73.accessPermissions = "Supervisor RD+WR, User RD";

mpu_armv74.$name             = "CONFIG_MPU_REGION3";
mpu_armv74.accessPermissions = "Supervisor RD+WR, User RD";
mpu_armv74.baseAddr          = 0x70000000;
mpu_armv74.size              = 21;

mpu_armv75.$name             = "CONFIG_MPU_REGION4";
mpu_armv75.baseAddr          = 0x60000000;
mpu_armv75.size              = 28;
mpu_armv75.accessPermissions = "Supervisor RD, User RD";

mpu_armv76.$name    = "CONFIG_MPU_REGION5";
mpu_armv76.baseAddr = 0x80000000;
mpu_armv76.size     = 31;

mpu_armv77.$name        = "CONFIG_MPU_REGION6";
mpu_armv77.baseAddr     = 0x70000000;
mpu_armv77.size         = 16;
mpu_armv77.attributes   = "Cached+Sharable";
mpu_armv77.allowExecute = false;

icss_emac1.$name                 = "CONFIG_ICSS_EMAC0";
icss_emac1.mode                  = "DUAL MAC | MAC1";
icss_emac1.phyAddr1              = 0;
icss_emac1.phyToMacInterfaceMode = "RGMII";
icss_emac1.instance              = "ICSSG1";
icss_emac1.linkTaskPriority      = 12;
icss_emac1.rxTaskPriority        = 10;
icss_emac1.txTaskPriority        = 10;

icss_emac2.$name                 = "CONFIG_ICSS_EMAC1";
icss_emac2.mode                  = "DUAL MAC | MAC2";
icss_emac2.phyAddr1              = 0;
icss_emac2.phyAddr0              = 3;
icss_emac2.phyToMacInterfaceMode = "RGMII";
icss_emac2.instance              = "ICSSG1";
icss_emac2.rxTaskPriority        = 10;
icss_emac2.txTaskPriority        = 10;
icss_emac2.linkTaskPriority      = 12;

/**
 * Pinmux solution for unlocked pins/peripherals. This ensures that minor changes to the automatic solver in a future
 * version of the tool will not impact the pinmux you originally saw.  These lines can be completely deleted in order to
 * re-solve from scratch.
 */
debug_log.uartLog.UART.RXD.$suggestSolution = "ball.D15";
debug_log.uartLog.UART.TXD.$suggestSolution = "ball.C16";
